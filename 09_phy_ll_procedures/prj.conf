## CMakeLists.txt
```
# SPDX-License-Identifier: Apache-2.0

cmake_minimum_required(VERSION 3.20.0)
find_package(Zephyr REQUIRED HINTS $ENV{ZEPHYR_BASE})
project(ble_phy_ll_procedures)

target_sources(app PRIVATE
  src/main.c
  src/hal_radio.c
  src/ll_pdu.c
  src/adv.c
  src/conn.c
  src/l2cap.c
)
```

## prj.conf
```kconfig
# BLE PHY LL Procedures Demo
# 演示链路层控制过程与 Instant 机制

CONFIG_GPIO=y
CONFIG_SERIAL=y
CONFIG_CONSOLE=y
CONFIG_UART_CONSOLE=y
CONFIG_PRINTK=y

# 直接操作 RADIO (nRF54L15)
CONFIG_BT=n
CONFIG_CLOCK_CONTROL=y
```

## src/main.c
```c
/*
 * BLE PHY LL Procedures (链路层过程 + Instant 机制) Demo
 *
 * 本 Demo 在 08_phy_slave_latency 基础上增加了 LL Procedures 支持:
 *
 * ┌─────────────────────────────────────────────────────────────────┐
 * │  Instant 机制是什么?                                            │
 * │                                                                 │
 * │  BLE 中某些链路层操作需要 Master/Slave 同步切换参数。           │
 * │  Master 发送 LL Control PDU 时携带一个 instant 值,             │
 * │  表示 "在 connEventCounter == instant 时, 新参数生效"。         │
 * │                                                                 │
 * │  本 Demo 实现两个使用 Instant 的过程:                           │
 * │    1. LL_CONNECTION_UPDATE_IND — 更新 interval/latency/timeout  │
 * │    2. LL_CHANNEL_MAP_IND       — 更新 channel map              │
 * │                                                                 │
 * │  关键约束:                                                      │
 * │    - 在 Instant 到达之前, 继续使用旧参数通信                   │
 * │    - 有 pending procedure 时, 禁止 Slave Latency              │
 * │    - Instant 过期 → 断开连接 (协议错误)                        │
 * └─────────────────────────────────────────────────────────────────┘
 *
 * SPDX-License-Identifier: Apache-2.0
 */

#include "ble_common.h"
#include "hal_radio.h"
#include "ll_pdu.h"
#include "adv.h"
#include "conn.h"
#include "l2cap.h"

/*===========================================================================
 * 全局变量定义
 *===========================================================================*/

const uint8_t adv_addr[BDADDR_SIZE] = {
	0x11, 0x22, 0x33, 0x44, 0x55, 0x66
};

const uint8_t adv_data[] = {
	0x02, 0x01, 0x06,
	0x08, 0x09, 'L', 'L', 'P', 'r', 'o', 'c'
};

struct conn_param conn_params;

uint8_t tx_sn;
uint8_t rx_nesn;
uint16_t conn_event_counter;
uint8_t last_unmapped_chan;
volatile bool conn_terminated;

struct pdu_data tx_pdu_buf __aligned(4);
bool tx_pdu_pending;

struct pdu_adv pdu_adv_ind __aligned(4);
struct pdu_adv pdu_adv_rx __aligned(4);
struct pdu_data pdu_data_rx __aligned(4);

uint32_t connect_end_rtc;
const uint16_t sca_ppm_table[] = {500, 250, 150, 100, 75, 50, 30, 20};

struct anchor_tracker anchor;
struct latency_tracker lat;

/* ★ LL Procedure 追踪全局变量 */
struct ll_proc_conn_update proc_conn_update;
struct ll_proc_chan_map_update proc_chan_map;

volatile uint32_t adv_event_count;
volatile uint32_t conn_event_rx_ok;
volatile uint32_t conn_event_rx_timeout;
volatile uint32_t conn_event_rx_crc_err;

uint32_t last_rx_aa_us;
uint32_t last_rx_ready_us;

struct l2cap_reassembly l2cap_reasm;
struct tx_queue data_tx_q;
uint32_t l2cap_rx_count;
uint32_t l2cap_tx_count;

int main(void)
{
	printk("\n");
	printk("===================================================\n");
	printk("  BLE PHY LL Procedures Demo\n");
	printk("  演示链路层过程 + Instant 机制\n");
	printk("  (Connection Update / Channel Map Update)\n");
	printk("===================================================\n");
	printk("Device: %s  Addr: %02X:%02X:%02X:%02X:%02X:%02X\n",
	       ADV_NAME,
	       adv_addr[5], adv_addr[4], adv_addr[3],
	       adv_addr[2], adv_addr[1], adv_addr[0]);
	printk("\n");

	hfclk_start();
	rtc0_start();
	sw_switch_timer_configure();
	dppi_configure();

	while (1) {
		printk("[STATE] Entering ADVERTISING state\n");
		adv_event_count = 0;

		radio_configure_adv();
		build_adv_ind_pdu();

		bool connected = false;
		while (!connected) {
			int ret = adv_event();
			if (ret == 1) {
				connected = true;
			} else {
				k_msleep(ADV_INTERVAL_MS);
			}
		}

		conn_loop();

		printk("[STATE] Connection lost, returning to advertising...\n\n");
		radio_ensure_disabled();
		k_msleep(100);
	}

	return 0;
}
```

## src/adv.c
```c
/*
 * BLE PHY Data Channel Demo — 广播态: ADV_IND 发送与 CONNECT_IND 接收
 * (与 06_phy_anchor 相同)
 *
 * SPDX-License-Identifier: Apache-2.0
 */

#include "adv.h"
#include "hal_radio.h"
#include "ll_pdu.h"

int adv_on_channel(uint32_t channel)
{
	uint32_t freq;

	switch (channel) {
	case 37: freq = 2;  break;
	case 38: freq = 26; break;
	case 39: freq = 80; break;
	default: return 0;
	}

	radio_freq_chan_set(freq);
	radio_whiten_iv_set(channel);

	radio_irq_disable();

	radio_pkt_tx_set(&pdu_adv_ind);
	radio_status_reset();
	NRF_RADIO->EVENTS_DISABLED = 0;
	radio_event_end_clear();
	NRF_RADIO->EVENTS_ADDRESS = 0;

	radio_shorts_trx_set();

	sw_timer_cc_set(CC_IDX_RXEN, T_IFS_US - RX_RAMP_US);
	dppi_disable_switch();

	sw_timer_start();

	NRF_RADIO->TASKS_TXEN = 1;

	while (!radio_event_end_check()) {
	}
	radio_event_end_clear();

	sw_timer_clear_compare(CC_IDX_RXEN);

	radio_pkt_rx_set(&pdu_adv_rx);
	dppi_enable_rxen();

	while (NRF_RADIO->EVENTS_DISABLED == 0) {
	}
	NRF_RADIO->EVENTS_DISABLED = 0;

	NRF_RADIO->EVENTS_ADDRESS = 0;

	uint32_t timeout_loops = ADV_RX_TIMEOUT_US * 16;
	bool rx_done = false;

	while (timeout_loops > 0) {
		if (NRF_RADIO->EVENTS_DISABLED) {
			rx_done = true;
			break;
		}
		timeout_loops--;
	}

	uint32_t rx_end_rtc = ticker_now() & HAL_TICKER_CNTR_MASK;

	if (!rx_done) {
		radio_ensure_disabled();
		return 0;
	}

	dppi_disable_switch();
	NRF_RADIO->SHORTS = 0;

	if (!radio_crc_is_valid()) {
		return 0;
	}

	if (validate_connect_ind(&pdu_adv_rx)) {
		connect_end_rtc = rx_end_rtc;
		parse_connect_ind(&pdu_adv_rx);
		return 1;
	}

	return 0;
}

int adv_event(void)
{
	static const uint32_t adv_channels[] = {37, 38, 39};

	for (int i = 0; i < 3; i++) {
		int ret = adv_on_channel(adv_channels[i]);
		if (ret == 1) {
			return 1;
		}
	}

	adv_event_count++;
	if (adv_event_count <= 3 || adv_event_count % 50 == 0) {
		printk("[ADV] events: %u (waiting for connection...)\n",
		       adv_event_count);
	}
	return 0;
}
```

## src/ble_common.h
```c
/*
 * BLE PHY LL Procedures Demo — 公共类型、常量与全局变量声明
 *
 * SPDX-License-Identifier: Apache-2.0
 */

#ifndef BLE_COMMON_H
#define BLE_COMMON_H

#include <zephyr/kernel.h>
#include <zephyr/sys/printk.h>
#include <zephyr/sys/byteorder.h>
#include <string.h>
#include <stdint.h>
#include <stdbool.h>
#include <soc.h>

/*
 * nRF54L15 没有 nRF52 的 PPI / RTC0，也不使用 Zephyr LL 内部头文件。
 * 硬件路径与 02_active_scan 相同: TIMER10 + DPPIC10 做软件 TIFS，
 * TIMER20 (1 MHz) 做连接时基。
 */

#define BDADDR_SIZE                 6
#define PDU_AC_LEG_DATA_SIZE_MAX    31
#define PDU_AC_LEG_PAYLOAD_SIZE_MAX 37
#define PDU_DC_PAYLOAD_SIZE_MIN     27
#define PDU_AC_ACCESS_ADDR          0x8e89bed6
#define PDU_AC_CRC_IV               0x555555
#define PDU_CRC_POLYNOMIAL          0x00065b
#define PDU_CHANNEL_MAP_SIZE        5

enum pdu_adv_type {
	PDU_ADV_TYPE_ADV_IND = 0x00,
	PDU_ADV_TYPE_DIRECT_IND = 0x01,
	PDU_ADV_TYPE_NONCONN_IND = 0x02,
	PDU_ADV_TYPE_SCAN_REQ = 0x03,
	PDU_ADV_TYPE_SCAN_RSP = 0x04,
	PDU_ADV_TYPE_CONNECT_IND = 0x05,
	PDU_ADV_TYPE_SCAN_IND = 0x06,
};

struct pdu_adv_adv_ind {
	uint8_t addr[BDADDR_SIZE];
	uint8_t data[PDU_AC_LEG_DATA_SIZE_MAX];
} __packed;

struct pdu_adv_connect_ind {
	uint8_t init_addr[BDADDR_SIZE];
	uint8_t adv_addr[BDADDR_SIZE];
	struct {
		uint8_t  access_addr[4];
		uint8_t  crc_init[3];
		uint8_t  win_size;
		uint16_t win_offset;
		uint16_t interval;
		uint16_t latency;
		uint16_t timeout;
		uint8_t  chan_map[PDU_CHANNEL_MAP_SIZE];
		uint8_t  hop:5;
		uint8_t  sca:3;
	} __packed;
} __packed;

struct pdu_adv {
	uint8_t type:4;
	uint8_t rfu:1;
	uint8_t chan_sel:1;
	uint8_t tx_addr:1;
	uint8_t rx_addr:1;
	uint8_t len;
	union {
		uint8_t payload[PDU_AC_LEG_PAYLOAD_SIZE_MAX];
		struct pdu_adv_adv_ind adv_ind;
		struct pdu_adv_connect_ind connect_ind;
	} __packed;
} __packed;

enum pdu_data_llid {
	PDU_DATA_LLID_RESV = 0x00,
	PDU_DATA_LLID_DATA_CONTINUE = 0x01,
	PDU_DATA_LLID_DATA_START = 0x02,
	PDU_DATA_LLID_CTRL = 0x03,
};

enum pdu_data_llctrl_type {
	PDU_DATA_LLCTRL_TYPE_CONN_UPDATE_IND = 0x00,
	PDU_DATA_LLCTRL_TYPE_CHAN_MAP_IND = 0x01,
	PDU_DATA_LLCTRL_TYPE_TERMINATE_IND = 0x02,
	PDU_DATA_LLCTRL_TYPE_UNKNOWN_RSP = 0x07,
	PDU_DATA_LLCTRL_TYPE_FEATURE_REQ = 0x08,
	PDU_DATA_LLCTRL_TYPE_FEATURE_RSP = 0x09,
	PDU_DATA_LLCTRL_TYPE_VERSION_IND = 0x0C,
	PDU_DATA_LLCTRL_TYPE_PER_INIT_FEAT_XCHG = 0x0E,
	PDU_DATA_LLCTRL_TYPE_PING_REQ = 0x12,
	PDU_DATA_LLCTRL_TYPE_PING_RSP = 0x13,
	PDU_DATA_LLCTRL_TYPE_LENGTH_REQ = 0x14,
	PDU_DATA_LLCTRL_TYPE_LENGTH_RSP = 0x15,
};

struct pdu_data_llctrl_conn_update_ind {
	uint8_t  win_size;
	uint16_t win_offset;
	uint16_t interval;
	uint16_t latency;
	uint16_t timeout;
	uint16_t instant;
} __packed;

struct pdu_data_llctrl_chan_map_ind {
	uint8_t  chm[PDU_CHANNEL_MAP_SIZE];
	uint16_t instant;
} __packed;

struct pdu_data_llctrl_unknown_rsp {
	uint8_t type;
} __packed;

struct pdu_data_llctrl_feature_rsp {
	uint8_t features[8];
} __packed;

struct pdu_data_llctrl_version_ind {
	uint8_t  version_number;
	uint16_t company_id;
	uint16_t sub_version_number;
} __packed;

struct pdu_data_llctrl_length_rsp {
	uint16_t max_rx_octets;
	uint16_t max_rx_time;
	uint16_t max_tx_octets;
	uint16_t max_tx_time;
} __packed;

struct pdu_data_llctrl {
	uint8_t opcode;
	union {
		struct pdu_data_llctrl_conn_update_ind conn_update_ind;
		struct pdu_data_llctrl_chan_map_ind chan_map_ind;
		struct pdu_data_llctrl_unknown_rsp unknown_rsp;
		struct pdu_data_llctrl_feature_rsp feature_rsp;
		struct pdu_data_llctrl_version_ind version_ind;
		struct pdu_data_llctrl_length_rsp length_rsp;
	} __packed;
} __packed;

struct pdu_data {
	uint8_t ll_id:2;
	uint8_t nesn:1;
	uint8_t sn:1;
	uint8_t md:1;
	uint8_t rfu:3;
	uint8_t len;
	union {
		struct pdu_data_llctrl llctrl;
		uint8_t lldata[PDU_DC_PAYLOAD_SIZE_MIN];
	} __packed;
} __packed;

/* TIMER20 @ 1 MHz: 1 tick = 1 us, 32-bit */
#define HAL_TICKER_CNTR_CLK_UNIT_FSEC 1000000000UL
#define HAL_TICKER_CNTR_MASK          0xFFFFFFFFUL
#define HAL_TICKER_FSEC_PER_USEC      1000000000UL
#define HAL_TICKER_PSEC_PER_USEC      1000000UL
#define HAL_TICKER_FSEC_PER_PSEC      1000UL

#define HAL_TICKER_US_TO_TICKS(x) (((uint32_t)(x)) & HAL_TICKER_CNTR_MASK)
#define HAL_TICKER_TICKS_TO_US(x) ((uint32_t)(x))
#define HAL_TICKER_REMAINDER(x)   (0U)


/*===========================================================================
 * 配置参数
 *===========================================================================*/

#define ADV_INTERVAL_MS  100
#define T_IFS_US         150
#define ADV_RX_TIMEOUT_US  600

#define WIN_DELAY_LEGACY            1250
#define CONN_INT_UNIT_US            1250
#define EVENT_JITTER_US             16
#define EVENT_TICKER_RES_MARGIN_US  31
#define ADDR_US_1M                  40
#define RTC0_CMP_OFFSET_MIN         3

#define ADV_NAME         "LLProc"

#define RX_RAMP_US       40
#define TX_RAMP_US       40

#define RX_CHAIN_DELAY_1M_US  10
#define TX_CHAIN_DELAY_US      1

#define DPPI_CH_TIMER_CLEAR  0   /* RADIO PHYEND -> TIMER CLEAR */
#define DPPI_CH_RXEN         1   /* TIMER CC[0] -> RADIO RXEN */
#define DPPI_CH_TXEN         2   /* TIMER CC[1] -> RADIO TXEN */

#define CC_IDX_RXEN  0
#define CC_IDX_TXEN  1

#define LOCAL_SCA_PPM 50

/* L2CAP */
#define L2CAP_CID_ATT       0x0004
#define L2CAP_CID_SIG       0x0005
#define L2CAP_CID_SMP       0x0006
#define L2CAP_HDR_SIZE      4
#define L2CAP_MAX_PAYLOAD   512
#define LL_DATA_MTU_DEFAULT 27

/*===========================================================================
 * 连接参数结构体
 *===========================================================================*/
struct conn_param {
	uint8_t  access_addr[4];
	uint8_t  crc_init[3];
	uint8_t  win_size;
	uint16_t win_offset;
	uint16_t interval;
	uint16_t latency;
	uint16_t timeout;
	uint8_t  chan_map[PDU_CHANNEL_MAP_SIZE];
	uint8_t  hop;
	uint8_t  sca;
	uint8_t  chan_count;
	uint8_t  peer_addr[BDADDR_SIZE];
};

struct anchor_tracker {
	uint32_t initial_anchor_rtc;
	uint32_t initial_anchor_us;
	uint32_t current_anchor_rtc;
	uint32_t last_rx_anchor_rtc;
	uint32_t ww_current_us;
	uint32_t ww_periodic_us;
	uint32_t ww_max_us;
	uint32_t win_size_event_us;
	uint32_t anchor_update_count;
	uint32_t consecutive_misses;
	uint32_t max_consecutive_misses;
};

struct latency_tracker {
	uint16_t latency_max;
	uint16_t latency_used;
	uint32_t events_skipped;
	uint32_t events_listened;
};

/*===========================================================================
 * LL Procedure 追踪 — Instant 机制
 *
 * BLE Core Spec Vol 6, Part B, 5.1.1:
 *   某些 LL Control PDU 携带一个 "Instant" 字段(uint16_t),
 *   表示新参数将在 connEventCounter == Instant 时生效。
 *   在 Instant 到达之前, 继续使用旧参数。
 *===========================================================================*/
struct ll_proc_conn_update {
	bool     pending;
	uint16_t instant;
	uint8_t  win_size;
	uint16_t win_offset;
	uint16_t interval;
	uint16_t latency;
	uint16_t timeout;
};

struct ll_proc_chan_map_update {
	bool     pending;
	uint16_t instant;
	uint8_t  chan_map[PDU_CHANNEL_MAP_SIZE];
};

/*===========================================================================
 * L2CAP
 *===========================================================================*/
struct l2cap_reassembly {
	uint8_t  buf[L2CAP_MAX_PAYLOAD + L2CAP_HDR_SIZE];
	uint16_t expected_len;
	uint16_t received_len;
	bool     in_progress;
};

#define TX_QUEUE_SIZE  4

struct tx_frag {
	uint8_t  data[LL_DATA_MTU_DEFAULT];
	uint8_t  len;
	uint8_t  llid;
};

struct tx_queue {
	struct tx_frag frags[TX_QUEUE_SIZE];
	uint8_t head;
	uint8_t tail;
	uint8_t count;
};

/*===========================================================================
 * 全局变量声明
 *===========================================================================*/

extern const uint8_t adv_addr[BDADDR_SIZE];
extern const uint8_t adv_data[];
#define ADV_DATA_LEN 11

extern struct conn_param conn_params;

extern uint8_t tx_sn;
extern uint8_t rx_nesn;
extern uint16_t conn_event_counter;
extern uint8_t last_unmapped_chan;
extern volatile bool conn_terminated;

extern struct pdu_data tx_pdu_buf;
extern bool tx_pdu_pending;

extern struct pdu_adv pdu_adv_ind;
extern struct pdu_adv pdu_adv_rx;
extern struct pdu_data pdu_data_rx;

extern uint32_t connect_end_rtc;
extern const uint16_t sca_ppm_table[];
extern struct anchor_tracker anchor;
extern struct latency_tracker lat;

/* LL Procedure 状态 */
extern struct ll_proc_conn_update proc_conn_update;
extern struct ll_proc_chan_map_update proc_chan_map;

extern volatile uint32_t adv_event_count;
extern volatile uint32_t conn_event_rx_ok;
extern volatile uint32_t conn_event_rx_timeout;
extern volatile uint32_t conn_event_rx_crc_err;

extern uint32_t last_rx_aa_us;
extern uint32_t last_rx_ready_us;

extern struct l2cap_reassembly l2cap_reasm;
extern struct tx_queue data_tx_q;
extern uint32_t l2cap_rx_count;
extern uint32_t l2cap_tx_count;

#endif /* BLE_COMMON_H */
```

## src/conn.c
```c
/*
 * BLE PHY LL Procedures Demo — 连接态: Instant 机制演示
 *
 * 相比 08_phy_slave_latency 的核心变化:
 *
 *  ┌─────────────────────────────────────────────────────────────────┐
 *  │  Instant 机制:                                                  │
 *  │                                                                 │
 *  │  当 Master 发送 LL_CONNECTION_UPDATE_IND 或 LL_CHANNEL_MAP_IND │
 *  │  时, PDU 中携带一个 instant (uint16_t) 值。                     │
 *  │                                                                 │
 *  │  含义: 新参数在 connEventCounter == instant 时生效。            │
 *  │                                                                 │
 *  │  在 Instant 到达之前, 继续使用旧参数正常通信。                 │
 *  │  在 Instant 到达的那个事件, 切换为新参数。                     │
 *  │                                                                 │
 *  │  如果 Slave 收到 Instant 已经过去, 则视为协议错误,             │
 *  │  应断开连接。                                                   │
 *  │                                                                 │
 *  │  ★ 重要: 当有 pending procedure 且 Instant 还未到达时,        │
 *  │    Slave 不得使用 Slave Latency 跳过事件!                      │
 *  │    必须每个事件都监听, 以确保不会错过 Instant。                │
 *  └─────────────────────────────────────────────────────────────────┘
 *
 * SPDX-License-Identifier: Apache-2.0
 */

#include "conn.h"
#include "hal_radio.h"
#include "ll_pdu.h"
#include "l2cap.h"

/*===========================================================================
 * Instant 有效性检查
 *
 * BLE Core Spec Vol 6, Part B, 5.1.1:
 *   instant 必须在 (connEventCounter, connEventCounter + 32767) 之间,
 *   即: (instant - connEventCounter) 以 uint16 算术应落在 [1, 32767]。
 *   如果不满足, 说明 Instant 已经过去, 协议错误。
 *===========================================================================*/
static bool instant_passed(uint16_t instant)
{
	uint16_t diff = instant - conn_event_counter;
	/* diff == 0 表示正好是当前事件 — 不算过去 */
	/* diff > 32767 (即高位为1) 表示 instant 在 counter 之前 */
	return (diff > 0x7FFF) && (diff != 0);
}

/*===========================================================================
 * Instant 检查与参数应用
 *
 * 在每个连接事件结束后 (conn_event_counter 已递增) 调用。
 * 如果当前 counter == pending instant, 应用新参数。
 *===========================================================================*/

/*
 * 应用连接更新: 替换 interval, latency, timeout
 * 同时需要重新计算 WW 周期值和 supervision timeout
 *
 * 返回 true 如果本事件触发了更新
 */
static bool check_apply_conn_update(uint32_t *conn_interval_us,
				    uint32_t *interval_ticks,
				    uint32_t *interval_remainder_ps,
				    uint32_t *supervision_timeout_us,
				    uint32_t combined_sca_ppm)
{
	if (!proc_conn_update.pending) {
		return false;
	}

	if (conn_event_counter != proc_conn_update.instant) {
		/* 检查是否已过期 */
		if (instant_passed(proc_conn_update.instant)) {
			printk("[LL] ERROR: Connection Update instant "
			       "passed! (instant=%u counter=%u)\n",
			       proc_conn_update.instant,
			       conn_event_counter);
			conn_terminated = true;
		}
		return false;
	}

	/* ★ Instant 到达! 应用新参数 */
	printk("[LL] ★ Connection Update applied at event #%u\n",
	       conn_event_counter);
	printk("       interval: %u → %u\n",
	       conn_params.interval, proc_conn_update.interval);
	printk("       latency:  %u → %u\n",
	       conn_params.latency, proc_conn_update.latency);
	printk("       timeout:  %u → %u\n",
	       conn_params.timeout, proc_conn_update.timeout);

	conn_params.win_size   = proc_conn_update.win_size;
	conn_params.win_offset = proc_conn_update.win_offset;
	conn_params.interval   = proc_conn_update.interval;
	conn_params.latency    = proc_conn_update.latency;
	conn_params.timeout    = proc_conn_update.timeout;

	/* 更新 slave latency */
	lat.latency_max = conn_params.latency;
	lat.latency_used = 0;

	/* 重新计算 interval 相关参数 */
	*conn_interval_us = (uint32_t)conn_params.interval * CONN_INT_UNIT_US;
	*interval_ticks = HAL_TICKER_US_TO_TICKS(*conn_interval_us);
	*interval_remainder_ps = HAL_TICKER_REMAINDER(*conn_interval_us);
	*supervision_timeout_us = (uint32_t)conn_params.timeout * 10000;

	anchor.ww_periodic_us = DIV_ROUND_UP(
		combined_sca_ppm * (*conn_interval_us), 1000000);

	uint32_t new_ww_max = ((*conn_interval_us) >> 1) - T_IFS_US;
	anchor.ww_max_us = new_ww_max;

	/* win_size 和 win_offset 用于 Instant 事件的接收窗口 */
	anchor.win_size_event_us =
		(uint32_t)proc_conn_update.win_size * CONN_INT_UNIT_US;

	proc_conn_update.pending = false;
	return true;
}

/*
 * 应用 Channel Map 更新: 替换 chan_map 和 chan_count
 *
 * 返回 true 如果本事件触发了更新
 */
static bool check_apply_chan_map_update(void)
{
	if (!proc_chan_map.pending) {
		return false;
	}

	if (conn_event_counter != proc_chan_map.instant) {
		if (instant_passed(proc_chan_map.instant)) {
			printk("[LL] ERROR: Channel Map instant "
			       "passed! (instant=%u counter=%u)\n",
			       proc_chan_map.instant,
			       conn_event_counter);
			conn_terminated = true;
		}
		return false;
	}

	uint8_t new_count = count_ones(proc_chan_map.chan_map,
				       PDU_CHANNEL_MAP_SIZE);

	printk("[LL] ★ Channel Map Update applied at event #%u\n",
	       conn_event_counter);
	printk("       chan_count: %u → %u\n",
	       conn_params.chan_count, new_count);

	memcpy(conn_params.chan_map, proc_chan_map.chan_map,
	       PDU_CHANNEL_MAP_SIZE);
	conn_params.chan_count = new_count;

	proc_chan_map.pending = false;
	return true;
}

/*===========================================================================
 * Slave Latency 判断 (继承自 05)
 *
 * ★ 新增约束: 当有 pending procedure 时, 不允许跳过事件!
 *   因为 Slave 必须每个事件都监听, 以便在 Instant 到达时
 *   及时应用新参数。
 *===========================================================================*/
static bool can_skip_event(void)
{
	if (lat.latency_used >= lat.latency_max) {
		return false;
	}

	if (data_tx_q.count > 0 || tx_pdu_pending) {
		return false;
	}

	/* ★ 有 pending procedure → 禁止跳过 */
	if (proc_conn_update.pending || proc_chan_map.pending) {
		return false;
	}

	return true;
}

/*===========================================================================
 * 单个连接事件 (与 05 相同)
 *===========================================================================*/
static bool conn_event(uint32_t ticks_at_start, uint32_t remainder_ps,
		       uint32_t hcto_add)
{
	uint32_t ahead = (ticks_at_start - ticker_now()) &
			 HAL_TICKER_CNTR_MASK;
	if (ahead > (HAL_TICKER_CNTR_MASK >> 1) ||
	    ahead < RTC0_CMP_OFFSET_MIN) {
		(void)chan_sel_1();
		conn_event_rx_timeout++;
		conn_event_counter++;
		return false;
	}

	uint8_t chan = chan_sel_1();
	data_chan_set(chan);

	radio_irq_disable();
	radio_status_reset();
	radio_tmr_status_reset();

	radio_shorts_trx_set();

	dppi_disable_switch();

	sw_timer_cc_set(CC_IDX_TXEN, T_IFS_US - TX_RAMP_US - RX_CHAIN_DELAY_1M_US);

	sw_timer_start();

	radio_pkt_rx_set(&pdu_data_rx);


	uint32_t remainder_us = radio_tmr_start(0, ticks_at_start,
						remainder_ps);

	radio_tmr_aa_capture();
	radio_tmr_aa_save(0);

	uint32_t hcto = remainder_us + hcto_add +
			radio_rx_ready_delay_get(0, 0) +
			ADDR_US_1M +
			radio_rx_chain_delay_get(0, 0);
	radio_tmr_hcto_configure(hcto);
	radio_tmr_end_capture();

	{
		uint32_t safety = 0;
		while (NRF_RADIO->EVENTS_DISABLED == 0) {
			radio_tmr_stamp_poll();
			if (radio_hcto_expired() || ++safety > 5000000) {
				NRF_RADIO->TASKS_DISABLE = 1;
				while (NRF_RADIO->EVENTS_DISABLED == 0) {
				}
				conn_event_rx_timeout++;
				conn_event_counter++;
				return false;
			}
		}
	}
	NRF_RADIO->EVENTS_DISABLED = 0;

	if (!radio_is_done()) {
		radio_ensure_disabled();
		conn_event_rx_timeout++;
		conn_event_counter++;
		return false;
	}

	if (!radio_crc_is_valid()) {
		radio_ensure_disabled();
		conn_event_rx_crc_err++;
		conn_event_counter++;
		return false;
	}

	conn_event_rx_ok++;

	last_rx_aa_us = radio_tmr_aa_get();
	last_rx_ready_us = radio_tmr_ready_get();

	/* RX→TX */
	sw_timer_clear_compare(CC_IDX_TXEN);
	sw_timer_clear_compare(CC_IDX_RXEN);

	if (pdu_data_rx.nesn != tx_sn) {
		tx_sn = pdu_data_rx.nesn;
	}
	bool new_packet = false;
	if (pdu_data_rx.sn == rx_nesn) {
		new_packet = true;
		rx_nesn ^= 1;
	}

	tx_pdu_pending = false;
	if (new_packet && pdu_data_rx.len > 0) {
		if (pdu_data_rx.ll_id == PDU_DATA_LLID_CTRL) {
			tx_pdu_pending = handle_ll_control(&pdu_data_rx);
		} else if (pdu_data_rx.ll_id == PDU_DATA_LLID_DATA_START ||
			   pdu_data_rx.ll_id == PDU_DATA_LLID_DATA_CONTINUE) {
			bool complete = l2cap_rx_fragment(
				pdu_data_rx.ll_id,
				pdu_data_rx.lldata,
				pdu_data_rx.len);
			if (complete) {
				l2cap_process_complete();
			}
		}
	}

	if (tx_pdu_pending) {
		tx_pdu_buf.nesn = rx_nesn;
		tx_pdu_buf.sn   = tx_sn;
		radio_pkt_tx_set(&tx_pdu_buf);
	} else if (l2cap_tx_dequeue(&tx_pdu_buf)) {
		tx_pdu_buf.nesn = rx_nesn;
		tx_pdu_buf.sn   = tx_sn;
		tx_pdu_pending = true;
		radio_pkt_tx_set(&tx_pdu_buf);
	} else {
		build_empty_pdu(&tx_pdu_buf);
		radio_pkt_tx_set(&tx_pdu_buf);
	}

	dppi_enable_txen();

	radio_event_end_clear();
	NRF_RADIO->EVENTS_DISABLED = 0;

	{
		uint32_t safety = 0;
		while (NRF_RADIO->EVENTS_DISABLED == 0) {
			if (++safety > 2000000) {
				NRF_RADIO->TASKS_DISABLE = 1;
				while (NRF_RADIO->EVENTS_DISABLED == 0) {
				}
				break;
			}
		}
	}
	NRF_RADIO->EVENTS_DISABLED = 0;

	dppi_disable_switch();
	NRF_RADIO->SHORTS = 0;

	if (tx_pdu_pending) {
		tx_sn ^= 1;
	}

	conn_event_counter++;
	return true;
}

/*===========================================================================
 * 连接态主循环 — LL Procedures + Instant 演示
 *
 * ★ 与 05 的关键差异:
 *
 *   1. 每个连接事件结束后, 检查是否有 pending procedure 到达 Instant:
 *      - check_apply_conn_update()  → 替换 interval/latency/timeout
 *      - check_apply_chan_map_update() → 替换 channel map
 *
 *   2. 当有 pending procedure 时, Slave Latency 被禁止:
 *      can_skip_event() 在检测到 proc pending 时返回 false
 *
 *   3. Connection Update 生效时, 需要重新计算:
 *      - interval_ticks / interval_remainder_ps (锚点递推步长)
 *      - ww_periodic_us (WW 周期增量)
 *      - ww_max_us (WW 上限)
 *      - supervision_timeout_us
 *      - latency_max
 *===========================================================================*/
void conn_loop(void)
{
	tx_sn = 0;
	rx_nesn = 0;
	conn_event_counter = 0;
	last_unmapped_chan = 0;
	conn_terminated = false;
	tx_pdu_pending = false;
	conn_event_rx_ok = 0;
	conn_event_rx_timeout = 0;
	conn_event_rx_crc_err = 0;

	memset(&anchor, 0, sizeof(anchor));
	memset(&lat, 0, sizeof(lat));
	memset(&proc_conn_update, 0, sizeof(proc_conn_update));
	memset(&proc_chan_map, 0, sizeof(proc_chan_map));
	l2cap_init();

	lat.latency_max = conn_params.latency;

	radio_configure_conn();
	print_connect_ind();

	printk("[PROC] Ready for LL Procedures (Instant mechanism)\n");
	printk("[LATENCY] connSlaveLatency = %u\n", lat.latency_max);

	uint32_t conn_interval_us = (uint32_t)conn_params.interval * CONN_INT_UNIT_US;
	uint32_t win_size_us = (uint32_t)conn_params.win_size * CONN_INT_UNIT_US;

	uint16_t master_sca_ppm = sca_ppm_table[conn_params.sca & 0x07];
	uint32_t combined_sca_ppm = (uint32_t)master_sca_ppm + LOCAL_SCA_PPM;
	uint32_t ww_periodic_us = DIV_ROUND_UP(
		combined_sca_ppm * conn_interval_us, 1000000);
	uint32_t ww_max_us = (conn_interval_us >> 1) - T_IFS_US;

	anchor.ww_periodic_us = ww_periodic_us;
	anchor.ww_max_us = ww_max_us;

	uint32_t ww_event_us = 0;
	uint32_t win_size_event_us = win_size_us;
	anchor.win_size_event_us = win_size_us;

	uint32_t conn_offset_us = (uint32_t)conn_params.win_offset * CONN_INT_UNIT_US
				+ WIN_DELAY_LEGACY
				- EVENT_TICKER_RES_MARGIN_US
				- EVENT_JITTER_US
				- radio_rx_ready_delay_get(0, 0)
				- ww_periodic_us;

	uint32_t offset_ticks = HAL_TICKER_US_TO_TICKS(conn_offset_us);
	uint32_t offset_remainder_ps = HAL_TICKER_REMAINDER(conn_offset_us);

	uint32_t interval_ticks = HAL_TICKER_US_TO_TICKS(conn_interval_us);
	uint32_t interval_remainder_ps = HAL_TICKER_REMAINDER(conn_interval_us);

	uint32_t ps_per_tick = HAL_TICKER_CNTR_CLK_UNIT_FSEC /
			       HAL_TICKER_FSEC_PER_PSEC;

	uint32_t next_event_rtc = (connect_end_rtc + offset_ticks) &
				  HAL_TICKER_CNTR_MASK;
	uint32_t next_event_remainder_ps = offset_remainder_ps;

	anchor.initial_anchor_rtc = next_event_rtc;
	anchor.current_anchor_rtc = next_event_rtc;
	anchor.last_rx_anchor_rtc = connect_end_rtc;

	uint32_t supervision_timeout_us = (uint32_t)conn_params.timeout * 10000;
	uint32_t last_rx_rtc = connect_end_rtc;

	uint32_t conn_updates_applied = 0;
	uint32_t chan_map_updates_applied = 0;

	while (!conn_terminated) {
		/* ★ 检查 Instant 到达: 是否需要应用新参数? */
		if (check_apply_conn_update(&conn_interval_us,
					    &interval_ticks,
					    &interval_remainder_ps,
					    &supervision_timeout_us,
					    combined_sca_ppm)) {
			conn_updates_applied++;
			ww_event_us = 0;
			win_size_event_us = anchor.win_size_event_us;
		}

		if (check_apply_chan_map_update()) {
			chan_map_updates_applied++;
		}

		/* Slave Latency 判断 */
		bool skip_this_event = false;

		if (lat.latency_max > 0 && can_skip_event()) {
			skip_this_event = true;
			lat.latency_used++;
			lat.events_skipped++;

			(void)chan_sel_1();
			conn_event_counter++;
		} else {
			lat.latency_used = 0;
			lat.events_listened++;
		}

		if (!skip_this_event) {
			ww_event_us += ww_periodic_us;
			if (ww_event_us > ww_max_us) {
				ww_event_us = ww_max_us;
			}
			anchor.ww_current_us = ww_event_us;

			uint32_t hcto_add = ((EVENT_JITTER_US +
					      EVENT_TICKER_RES_MARGIN_US +
					      ww_event_us) << 1) +
					    win_size_event_us;

			anchor.current_anchor_rtc = next_event_rtc;

			bool rx_ok = conn_event(next_event_rtc,
						next_event_remainder_ps,
						hcto_add);

			if (rx_ok) {
				uint32_t actual_s2a = last_rx_aa_us -
						      last_rx_ready_us;
				int32_t drift_us = (int32_t)actual_s2a -
					(int32_t)(EVENT_JITTER_US +
						  EVENT_TICKER_RES_MARGIN_US +
						  ADDR_US_1M);

				int64_t adj_ps = (int64_t)next_event_remainder_ps +
						 (int64_t)drift_us * 1000000LL;

				while (adj_ps >= (int64_t)ps_per_tick) {
					adj_ps -= ps_per_tick;
					next_event_rtc = (next_event_rtc + 1) &
							 HAL_TICKER_CNTR_MASK;
				}
				while (adj_ps < 0) {
					adj_ps += ps_per_tick;
					next_event_rtc = (next_event_rtc - 1) &
							 HAL_TICKER_CNTR_MASK;
				}
				next_event_remainder_ps = (uint32_t)adj_ps;

				last_rx_rtc = next_event_rtc;
				anchor.last_rx_anchor_rtc = next_event_rtc;
				anchor.anchor_update_count++;
				anchor.consecutive_misses = 0;

				ww_event_us = 0;
				win_size_event_us = 0;
			} else {
				anchor.consecutive_misses++;
				if (anchor.consecutive_misses >
				    anchor.max_consecutive_misses) {
					anchor.max_consecutive_misses =
						anchor.consecutive_misses;
				}

				uint32_t elapsed_ticks =
					(next_event_rtc - last_rx_rtc) &
					HAL_TICKER_CNTR_MASK;
				uint32_t elapsed_us =
					HAL_TICKER_TICKS_TO_US(elapsed_ticks);

				if (elapsed_us >= supervision_timeout_us) {
					printk("[CONN] Supervision timeout!\n");
					break;
				}
			}
		} else {
			ww_event_us += ww_periodic_us;
			if (ww_event_us > ww_max_us) {
				ww_event_us = ww_max_us;
			}
		}

		/* 锚点递推 */
		next_event_rtc = (next_event_rtc + interval_ticks) &
				 HAL_TICKER_CNTR_MASK;
		next_event_remainder_ps += interval_remainder_ps;
		if (next_event_remainder_ps >= ps_per_tick) {
			next_event_remainder_ps -= ps_per_tick;
			next_event_rtc = (next_event_rtc + 1) &
					 HAL_TICKER_CNTR_MASK;
		}

		uint32_t current_event = conn_event_counter;

		if (current_event <= 10 ||
		    current_event % 50 == 0 ||
		    anchor.consecutive_misses > 3 ||
		    proc_conn_update.pending ||
		    proc_chan_map.pending) {
			printk("[CONN] #%u %s | ww=%u lat=%u/%u | "
			       "pending: cu=%u cm=%u\n",
			       current_event,
			       skip_this_event ? "SKIP" :
			       (conn_event_rx_ok == current_event ? "OK" : "MISS"),
			       anchor.ww_current_us,
			       lat.latency_used, lat.latency_max,
			       proc_conn_update.pending ? 1 : 0,
			       proc_chan_map.pending ? 1 : 0);
		}
	}

	NRF_RADIO->SHORTS = 0;
	radio_irq_disable();

	printk("\n========== Connection Summary ==========\n");
	printk("  Total events:      %u\n", conn_event_counter);
	printk("  Events listened:   %u\n", lat.events_listened);
	printk("  Events skipped:    %u\n", lat.events_skipped);
	printk("  RX OK:             %u\n", conn_event_rx_ok);
	printk("  RX timeout:        %u\n", conn_event_rx_timeout);
	printk("  RX CRC error:      %u\n", conn_event_rx_crc_err);
	printk("  Anchor updates:    %u\n", anchor.anchor_update_count);
	printk("  Max consec miss:   %u\n", anchor.max_consecutive_misses);
	printk("  Conn Updates:      %u\n", conn_updates_applied);
	printk("  Chan Map Updates:  %u\n", chan_map_updates_applied);
	printk("=========================================\n");
}
```
