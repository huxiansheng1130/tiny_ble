## CMakeLists.txt
```
# SPDX-License-Identifier: Apache-2.0

cmake_minimum_required(VERSION 3.20.0)
find_package(Zephyr REQUIRED HINTS $ENV{ZEPHYR_BASE})
project(ble_phy_first_anchor)

target_sources(app PRIVATE
  src/main.c
  src/hal_radio.c
  src/ll_pdu.c
  src/adv.c
  src/conn.c
)
```

## prj.conf
```kconfig
# BLE PHY First Anchor Demo
# 首次锚点计算与硬件调度链: RTC0 → TIMER0 → PPI → Radio RXEN

CONFIG_GPIO=y
CONFIG_SERIAL=y
CONFIG_CONSOLE=y
CONFIG_UART_CONSOLE=y
CONFIG_PRINTK=y

# 直接操作 RADIO (nRF54L15)
CONFIG_BT=n
CONFIG_CLOCK_CONTROL=y
```

## src/main.c
```c
/*
 * BLE PHY First Anchor (首次锚点) Demo
 *
 * 本 Demo 在 03_phy_connect_ind 基础上, 实现了:
 *   1. 从 CONNECT_IND 参数计算首次锚点 A0
 *   2. 通过 RTC0→TIMER0→PPI→RXEN 硬件链在精确时刻启动 RX
 *   3. 执行一个连接事件 (RX Master 数据包 + TX 空 PDU)
 *   4. 打印锚点计算 6 步详细过程
 *
 * 锚点公式:
 *
 *   A0 = T0 + winOffset × 1.25ms + transmitWindowDelay(1.25ms) - margins
 *
 *   其中 margins = TICKER_RES_MARGIN + JITTER + rx_ready_delay + ww_periodic
 *   (提前开 RX, 宁早勿迟)
 *
 * 硬件调度链 (零 CPU 延迟):
 *
 *   NRF_RTC0 ──CC[2]match──> PPI ──> NRF_TIMER0 START
 *   NRF_TIMER0 ──CC[0]=remainder──> PPI ──> RADIO RXEN
 *   RADIO RXEN → 40μs ramp-up → RX START
 *
 * 代码结构:
 *   ble_common.h  — 公共类型 (新增 anchor_tracker, 锚点常量)
 *   hal_radio.c/h — HAL 层 (新增 radio_configure_conn, data_chan_set)
 *   ll_pdu.c/h    — PDU (新增 build_empty_pdu, chan_sel_1, print_anchor_calculation)
 *   adv.c/h       — 广播态 (同 03)
 *   conn.c/h      — 连接态 (新增! conn_first_event: 锚点计算 + 单次事件)
 *   main.c        — 主状态机
 *
 * SPDX-License-Identifier: Apache-2.0
 */

#include "ble_common.h"
#include "hal_radio.h"
#include "ll_pdu.h"
#include "adv.h"
#include "conn.h"

/*===========================================================================
 * 全局变量定义
 *===========================================================================*/

const uint8_t adv_addr[BDADDR_SIZE] = {
	0x11, 0x22, 0x33, 0x44, 0x55, 0x66
};

const uint8_t adv_data[] = {
	0x02, 0x01, 0x06,
	0x08, 0x09, '1', 's', 't', 'A', 'n', 'c', 'h'
};

struct conn_param conn_params;

/* 连接态变量 */
uint8_t tx_sn;
uint8_t rx_nesn;
uint16_t conn_event_counter;
uint8_t last_unmapped_chan;

struct pdu_data tx_pdu_buf __aligned(4);

/* PDU 缓冲区 */
struct pdu_adv pdu_adv_ind __aligned(4);
struct pdu_adv pdu_adv_rx __aligned(4);
struct pdu_data pdu_data_rx __aligned(4);

/* CONNECT_IND 接收时刻 */
uint32_t connect_end_rtc;

/* SCA PPM 映射表 */
const uint16_t sca_ppm_table[] = {500, 250, 150, 100, 75, 50, 30, 20};

/* 锚点追踪 */
struct anchor_tracker anchor;

/* 统计 */
volatile uint32_t adv_event_count;
volatile uint32_t conn_event_rx_ok;
volatile uint32_t conn_event_rx_timeout;

/*===========================================================================
 * 主函数
 *===========================================================================*/
int main(void)
{
	printk("\n");
	printk("===================================================\n");
	printk("  BLE PHY First Anchor Demo\n");
	printk("  计算首次锚点 A0 并执行一个连接事件\n");
	printk("===================================================\n");
	printk("Device: %s  Addr: %02X:%02X:%02X:%02X:%02X:%02X\n",
	       ADV_NAME,
	       adv_addr[5], adv_addr[4], adv_addr[3],
	       adv_addr[2], adv_addr[1], adv_addr[0]);
	printk("\n");

	hfclk_start();
	rtc0_start();
	sw_switch_timer_configure();
	dppi_configure();

	while (1) {
		printk("[STATE] Entering ADVERTISING state\n");
		adv_event_count = 0;

		radio_configure_adv();
		build_adv_ind_pdu();

		bool connected = false;

		while (!connected) {
			int ret = adv_event();

			if (ret == 1) {
				connected = true;
			} else {
				k_msleep(ADV_INTERVAL_MS);
			}
		}

		/* ★ 收到 CONNECT_IND! 执行首次连接事件 */
		conn_first_event();

		printk("[STATE] First event done, returning to advertising...\n\n");
		radio_ensure_disabled();
		k_msleep(100);
	}

	return 0;
}
```

## src/adv.c
```c
/*
 * BLE PHY First Anchor Demo — 广播态: ADV_IND 发送与 CONNECT_IND 接收
 *
 * (与 03_phy_connect_ind 的 adv.c 相同)
 *
 * SPDX-License-Identifier: Apache-2.0
 */

#include "adv.h"
#include "hal_radio.h"
#include "ll_pdu.h"

/*===========================================================================
 * 广播信道处理
 *===========================================================================*/
int adv_on_channel(uint32_t channel)
{
	uint32_t freq;

	switch (channel) {
	case 37: freq = 2;  break;
	case 38: freq = 26; break;
	case 39: freq = 80; break;
	default: return 0;
	}

	radio_freq_chan_set(freq);
	radio_whiten_iv_set(channel);

	radio_irq_disable();

	/*==============================================================
	 * 第 1 阶段: TX ADV_IND (SW TIFS)
	 *==============================================================*/

	radio_pkt_tx_set(&pdu_adv_ind);

	radio_status_reset();
	NRF_RADIO->EVENTS_DISABLED = 0;
	radio_event_end_clear();
	NRF_RADIO->EVENTS_ADDRESS = 0;

	radio_shorts_trx_set();

	sw_timer_cc_set(CC_IDX_RXEN, T_IFS_US - RX_RAMP_US);
	dppi_disable_switch();

	sw_timer_start();

	NRF_RADIO->TASKS_TXEN = 1;

	while (!radio_event_end_check()) {
	}
	radio_event_end_clear();

	/*==============================================================
	 * TX→RX 转换 (SW TIFS)
	 *==============================================================*/

	sw_timer_clear_compare(CC_IDX_RXEN);

	radio_pkt_rx_set(&pdu_adv_rx);

	dppi_enable_rxen();

	while (NRF_RADIO->EVENTS_DISABLED == 0) {
	}
	NRF_RADIO->EVENTS_DISABLED = 0;

	/*==============================================================
	 * 第 2 阶段: RX 等待 CONNECT_IND
	 *==============================================================*/

	NRF_RADIO->EVENTS_ADDRESS = 0;

	uint32_t timeout_loops = ADV_RX_TIMEOUT_US * 16;
	bool rx_done = false;

	while (timeout_loops > 0) {
		if (NRF_RADIO->EVENTS_DISABLED) {
			rx_done = true;
			break;
		}
		timeout_loops--;
	}

	/* ★ 立即捕获 T0 */
	uint32_t rx_end_rtc = ticker_now() & HAL_TICKER_CNTR_MASK;

	if (!rx_done) {
		radio_ensure_disabled();
		return 0;
	}

	dppi_disable_switch();
	NRF_RADIO->SHORTS = 0;

	if (!radio_crc_is_valid()) {
		return 0;
	}

	if (validate_connect_ind(&pdu_adv_rx)) {
		connect_end_rtc = rx_end_rtc;
		parse_connect_ind(&pdu_adv_rx);
		return 1;
	}

	return 0;
}

/*===========================================================================
 * 广播事件
 *===========================================================================*/
int adv_event(void)
{
	static const uint32_t adv_channels[] = {37, 38, 39};

	for (int i = 0; i < 3; i++) {
		int ret = adv_on_channel(adv_channels[i]);

		if (ret == 1) {
			return 1;
		}
	}

	adv_event_count++;
	if (adv_event_count <= 3 || adv_event_count % 50 == 0) {
		printk("[ADV] events: %u (waiting for connection...)\n",
		       adv_event_count);
	}
	return 0;
}
```

## src/ble_common.h
```c
/*
 * BLE PHY First Anchor Demo — 公共类型、常量与全局变量声明
 *
 * 相比 03_phy_connect_ind 新增:
 *   - struct anchor_tracker: 锚点追踪
 *   - 锚点计算相关常量 (WIN_DELAY, EVENT_JITTER, ...)
 *   - 连接态变量 (tx_sn, rx_nesn, conn_event_counter, ...)
 *   - 数据 PDU 缓冲区
 *
 * SPDX-License-Identifier: Apache-2.0
 */

#ifndef BLE_COMMON_H
#define BLE_COMMON_H

#include <zephyr/kernel.h>
#include <zephyr/sys/printk.h>
#include <zephyr/sys/byteorder.h>
#include <string.h>
#include <stdint.h>
#include <stdbool.h>
#include <soc.h>

/*
 * nRF54L15 没有 nRF52 的 PPI / RTC0，也不使用 Zephyr LL 内部头文件。
 * 硬件路径与 02_active_scan 相同: TIMER10 + DPPIC10 做软件 TIFS，
 * TIMER20 (1 MHz) 做连接时基。
 */

#define BDADDR_SIZE                 6
#define PDU_AC_LEG_DATA_SIZE_MAX    31
#define PDU_AC_LEG_PAYLOAD_SIZE_MAX 37
#define PDU_DC_PAYLOAD_SIZE_MIN     27
#define PDU_AC_ACCESS_ADDR          0x8e89bed6
#define PDU_AC_CRC_IV               0x555555
#define PDU_CRC_POLYNOMIAL          0x00065b
#define PDU_CHANNEL_MAP_SIZE        5

enum pdu_adv_type {
	PDU_ADV_TYPE_ADV_IND = 0x00,
	PDU_ADV_TYPE_DIRECT_IND = 0x01,
	PDU_ADV_TYPE_NONCONN_IND = 0x02,
	PDU_ADV_TYPE_SCAN_REQ = 0x03,
	PDU_ADV_TYPE_SCAN_RSP = 0x04,
	PDU_ADV_TYPE_CONNECT_IND = 0x05,
	PDU_ADV_TYPE_SCAN_IND = 0x06,
};

struct pdu_adv_adv_ind {
	uint8_t addr[BDADDR_SIZE];
	uint8_t data[PDU_AC_LEG_DATA_SIZE_MAX];
} __packed;

struct pdu_adv_connect_ind {
	uint8_t init_addr[BDADDR_SIZE];
	uint8_t adv_addr[BDADDR_SIZE];
	struct {
		uint8_t  access_addr[4];
		uint8_t  crc_init[3];
		uint8_t  win_size;
		uint16_t win_offset;
		uint16_t interval;
		uint16_t latency;
		uint16_t timeout;
		uint8_t  chan_map[PDU_CHANNEL_MAP_SIZE];
		uint8_t  hop:5;
		uint8_t  sca:3;
	} __packed;
} __packed;

struct pdu_adv {
	uint8_t type:4;
	uint8_t rfu:1;
	uint8_t chan_sel:1;
	uint8_t tx_addr:1;
	uint8_t rx_addr:1;
	uint8_t len;
	union {
		uint8_t payload[PDU_AC_LEG_PAYLOAD_SIZE_MAX];
		struct pdu_adv_adv_ind adv_ind;
		struct pdu_adv_connect_ind connect_ind;
	} __packed;
} __packed;

enum pdu_data_llid {
	PDU_DATA_LLID_RESV = 0x00,
	PDU_DATA_LLID_DATA_CONTINUE = 0x01,
	PDU_DATA_LLID_DATA_START = 0x02,
	PDU_DATA_LLID_CTRL = 0x03,
};

enum pdu_data_llctrl_type {
	PDU_DATA_LLCTRL_TYPE_CONN_UPDATE_IND = 0x00,
	PDU_DATA_LLCTRL_TYPE_CHAN_MAP_IND = 0x01,
	PDU_DATA_LLCTRL_TYPE_TERMINATE_IND = 0x02,
	PDU_DATA_LLCTRL_TYPE_UNKNOWN_RSP = 0x07,
	PDU_DATA_LLCTRL_TYPE_FEATURE_REQ = 0x08,
	PDU_DATA_LLCTRL_TYPE_FEATURE_RSP = 0x09,
	PDU_DATA_LLCTRL_TYPE_VERSION_IND = 0x0C,
	PDU_DATA_LLCTRL_TYPE_PER_INIT_FEAT_XCHG = 0x0E,
	PDU_DATA_LLCTRL_TYPE_PING_REQ = 0x12,
	PDU_DATA_LLCTRL_TYPE_PING_RSP = 0x13,
	PDU_DATA_LLCTRL_TYPE_LENGTH_REQ = 0x14,
	PDU_DATA_LLCTRL_TYPE_LENGTH_RSP = 0x15,
};

struct pdu_data_llctrl_conn_update_ind {
	uint8_t  win_size;
	uint16_t win_offset;
	uint16_t interval;
	uint16_t latency;
	uint16_t timeout;
	uint16_t instant;
} __packed;

struct pdu_data_llctrl_chan_map_ind {
	uint8_t  chm[PDU_CHANNEL_MAP_SIZE];
	uint16_t instant;
} __packed;

struct pdu_data_llctrl_unknown_rsp {
	uint8_t type;
} __packed;

struct pdu_data_llctrl_feature_rsp {
	uint8_t features[8];
} __packed;

struct pdu_data_llctrl_version_ind {
	uint8_t  version_number;
	uint16_t company_id;
	uint16_t sub_version_number;
} __packed;

struct pdu_data_llctrl_length_rsp {
	uint16_t max_rx_octets;
	uint16_t max_rx_time;
	uint16_t max_tx_octets;
	uint16_t max_tx_time;
} __packed;

struct pdu_data_llctrl {
	uint8_t opcode;
	union {
		struct pdu_data_llctrl_conn_update_ind conn_update_ind;
		struct pdu_data_llctrl_chan_map_ind chan_map_ind;
		struct pdu_data_llctrl_unknown_rsp unknown_rsp;
		struct pdu_data_llctrl_feature_rsp feature_rsp;
		struct pdu_data_llctrl_version_ind version_ind;
		struct pdu_data_llctrl_length_rsp length_rsp;
	} __packed;
} __packed;

struct pdu_data {
	uint8_t ll_id:2;
	uint8_t nesn:1;
	uint8_t sn:1;
	uint8_t md:1;
	uint8_t rfu:3;
	uint8_t len;
	union {
		struct pdu_data_llctrl llctrl;
		uint8_t lldata[PDU_DC_PAYLOAD_SIZE_MIN];
	} __packed;
} __packed;

/* TIMER20 @ 1 MHz: 1 tick = 1 us, 32-bit */
#define HAL_TICKER_CNTR_CLK_UNIT_FSEC 1000000000UL
#define HAL_TICKER_CNTR_MASK          0xFFFFFFFFUL
#define HAL_TICKER_FSEC_PER_USEC      1000000000UL
#define HAL_TICKER_PSEC_PER_USEC      1000000UL
#define HAL_TICKER_FSEC_PER_PSEC      1000UL

#define HAL_TICKER_US_TO_TICKS(x) (((uint32_t)(x)) & HAL_TICKER_CNTR_MASK)
#define HAL_TICKER_TICKS_TO_US(x) ((uint32_t)(x))
#define HAL_TICKER_REMAINDER(x)   (0U)


/*===========================================================================
 * 配置参数
 *===========================================================================*/

/* 广播间隔 (ms) */
#define ADV_INTERVAL_MS  100

/* T_IFS = 150 μs */
#define T_IFS_US         150

/* ADV RX 超时 (μs) */
#define ADV_RX_TIMEOUT_US  600

/* BLE 定时常量 */
#define WIN_DELAY_LEGACY            1250  /* transmitWindowDelay (μs) */
#define CONN_INT_UNIT_US            1250  /* connInterval unit (1.25ms) */
#define EVENT_JITTER_US             16    /* Active clock jitter margin (μs) */
#define EVENT_TICKER_RES_MARGIN_US  31    /* RTC tick resolution ~30.52μs ceil */
#define ADDR_US_1M                  40    /* Preamble(8)+AA(32) for 1M PHY */
#define RTC0_CMP_OFFSET_MIN         3     /* NRF_RTC0 CC 最小比较偏移 */

#define ADV_NAME         "1stAnch"

/* TX/RX ramp-up 延迟 (μs): fast ramp-up ≈ 40 μs */
#define RX_RAMP_US       40
#define TX_RAMP_US       40

/* Chain delay: RADIO END 事件相对于实际空中包结束的延迟
 * nRF52832 1M PHY: RX chain delay = 9.4μs (ceil→10), TX chain delay = 0.6μs (ceil→1) */
#define RX_CHAIN_DELAY_1M_US  10
#define TX_CHAIN_DELAY_US      1

/*===========================================================================
 * PPI 通道分配 (SW TIFS)
 *===========================================================================*/
#define DPPI_CH_TIMER_CLEAR  0   /* RADIO PHYEND -> TIMER CLEAR */
#define DPPI_CH_RXEN         1   /* TIMER CC[0] -> RADIO RXEN */
#define DPPI_CH_TXEN         2   /* TIMER CC[1] -> RADIO TXEN */

#define CC_IDX_RXEN  0   /* Timer CC[0]: TX→RX 转换 */
#define CC_IDX_TXEN  1   /* Timer CC[1]: RX→TX 转换 */

#define LOCAL_SCA_PPM 50

/*===========================================================================
 * 连接参数结构体
 *===========================================================================*/
struct conn_param {
	uint8_t  access_addr[4];
	uint8_t  crc_init[3];
	uint8_t  win_size;
	uint16_t win_offset;
	uint16_t interval;
	uint16_t latency;
	uint16_t timeout;
	uint8_t  chan_map[PDU_CHANNEL_MAP_SIZE];
	uint8_t  hop;
	uint8_t  sca;
	uint8_t  chan_count;
	uint8_t  peer_addr[BDADDR_SIZE];
};

/*===========================================================================
 * 锚点追踪结构体
 *===========================================================================*/
struct anchor_tracker {
	uint32_t initial_anchor_rtc;     /* 首次计算出的锚点 RTC tick */
	uint32_t initial_anchor_us;      /* 首次锚点的 μs 偏移量 */
	uint32_t current_anchor_rtc;     /* 当前锚点 RTC tick */
};

/*===========================================================================
 * 全局变量声明 (定义在 main.c)
 *===========================================================================*/

extern const uint8_t adv_addr[BDADDR_SIZE];
extern const uint8_t adv_data[];
#define ADV_DATA_LEN 14  /* sizeof(adv_data) */

extern struct conn_param conn_params;

/* 连接态变量 */
extern uint8_t tx_sn;
extern uint8_t rx_nesn;
extern uint16_t conn_event_counter;
extern uint8_t last_unmapped_chan;

extern struct pdu_data tx_pdu_buf;

/* PDU 缓冲区 */
extern struct pdu_adv pdu_adv_ind;
extern struct pdu_adv pdu_adv_rx;
extern struct pdu_data pdu_data_rx;

/* CONNECT_IND 接收时刻 */
extern uint32_t connect_end_rtc;

/* SCA PPM 映射表 */
extern const uint16_t sca_ppm_table[];

/* 锚点追踪 */
extern struct anchor_tracker anchor;

/* 统计 */
extern volatile uint32_t adv_event_count;
extern volatile uint32_t conn_event_rx_ok;
extern volatile uint32_t conn_event_rx_timeout;

#endif /* BLE_COMMON_H */
```

## src/conn.c
```c
/*
 * BLE PHY First Anchor Demo — 连接态: 首次连接事件
 *
 * 本文件实现了锚点计算和单个连接事件的执行:
 *
 * ★ conn_first_event() 的流程:
 *   1. 从 CONNECT_IND 参数计算首次锚点 A0
 *   2. 用 chan_sel_1() 计算第一个数据信道
 *   3. 用 radio_tmr_start() 配置 RTC0→TIMER0→PPI→RXEN 硬件链
 *   4. 执行一个 RX→TX 连接事件
 *   5. 打印详细的锚点计算过程
 *
 * ★ 硬件定时链 (零 CPU 延迟):
 *
 *   RTC0 CC[2] match ──PPI──> TIMER0 START
 *   TIMER0 CC[0]=remainder ──PPI──> RADIO RXEN
 *   RADIO RXEN → 40μs ramp → RX START
 *
 *   这条链让 Radio 在精确的锚点时刻开始 RX,
 *   无需 CPU 参与, 消除了中断延迟和任务调度抖动。
 *
 * SPDX-License-Identifier: Apache-2.0
 */

#include "conn.h"
#include "hal_radio.h"
#include "ll_pdu.h"

/*===========================================================================
 * 单个连接事件
 *
 * 与 06_phy_anchor 的 conn_event() 相同, 但不处理 LL Control PDU。
 *===========================================================================*/
static bool conn_event(uint32_t ticks_at_start, uint32_t remainder_ps,
		       uint32_t hcto_add)
{
	/* 检查目标 RTC tick 是否在未来 */
	uint32_t ahead = (ticks_at_start - ticker_now()) &
			 HAL_TICKER_CNTR_MASK;
	if (ahead > (HAL_TICKER_CNTR_MASK >> 1) ||
	    ahead < RTC0_CMP_OFFSET_MIN) {
		(void)chan_sel_1();
		conn_event_rx_timeout++;
		conn_event_counter++;
		return false;
	}

	uint8_t chan = chan_sel_1();
	data_chan_set(chan);

	radio_irq_disable();
	radio_status_reset();

	/* 清理上一个事件遗留的 HAL PPI/Timer 状态 */
	radio_tmr_status_reset();

	radio_shorts_trx_set();

	dppi_disable_switch();

	/* 设置 Timer1 CC[1] for RX→TX 转换 */
	sw_timer_cc_set(CC_IDX_TXEN, T_IFS_US - TX_RAMP_US - RX_CHAIN_DELAY_1M_US);

	sw_timer_start();

	radio_pkt_rx_set(&pdu_data_rx);

	/* 停止 TIMER0 + 清除 RTC0 比较事件 (防止遗留干扰) */

	/* ★ 传锚点给硬件: radio_tmr_start 配置 RTC0→TIMER0→PPI→RXEN */
	uint32_t remainder_us = radio_tmr_start(0, ticks_at_start,
						remainder_ps);

	radio_tmr_aa_capture();
	radio_tmr_aa_save(0);

	/* HCTO: 如果在锚点 + HCTO 时间内没收到包头, 自动 DISABLE Radio */
	uint32_t hcto = remainder_us + hcto_add +
			radio_rx_ready_delay_get(0, 0) +
			ADDR_US_1M +
			radio_rx_chain_delay_get(0, 0);
	radio_tmr_hcto_configure(hcto);

	radio_tmr_end_capture();

	/* 等待 RX 完成或 HCTO 超时 */
	{
		uint32_t safety = 0;

		while (NRF_RADIO->EVENTS_DISABLED == 0) {
			radio_tmr_stamp_poll();
			if (radio_hcto_expired() || ++safety > 5000000) {
				printk("!STUCK RX! ST=%u\n", NRF_RADIO->STATE);
				NRF_RADIO->TASKS_DISABLE = 1;
				while (NRF_RADIO->EVENTS_DISABLED == 0) {
				}
				conn_event_rx_timeout++;
				conn_event_counter++;
				return false;
			}
		}
	}
	NRF_RADIO->EVENTS_DISABLED = 0;

	if (!radio_is_done()) {
		radio_ensure_disabled();
		conn_event_rx_timeout++;
		conn_event_counter++;
		return false;
	}

	if (!radio_crc_is_valid()) {
		radio_ensure_disabled();
		conn_event_rx_timeout++;
		conn_event_counter++;
		return false;
	}

	conn_event_rx_ok++;

	/*==============================================================
	 * SW TIFS: RX→TX 转换
	 *==============================================================*/

	sw_timer_clear_compare(CC_IDX_TXEN);
	sw_timer_clear_compare(CC_IDX_RXEN);

	/* 准备 TX: 空 PDU */
	build_empty_pdu(&tx_pdu_buf);
	radio_pkt_tx_set(&tx_pdu_buf);

	/* 启用 PPI_CH_TXEN */
	dppi_enable_txen();

	radio_event_end_clear();
	NRF_RADIO->EVENTS_DISABLED = 0;

	/* 等待 TX 完成 */
	{
		uint32_t safety = 0;

		while (NRF_RADIO->EVENTS_DISABLED == 0) {
			if (++safety > 2000000) {
				printk("!STUCK TX! ST=%u\n", NRF_RADIO->STATE);
				NRF_RADIO->TASKS_DISABLE = 1;
				while (NRF_RADIO->EVENTS_DISABLED == 0) {
				}
				break;
			}
		}
	}

	NRF_RADIO->EVENTS_DISABLED = 0;

	dppi_disable_switch();
	NRF_RADIO->SHORTS = 0;

	printk("[CONN] #%u ch=%u RX OK, TX empty PDU sent\n",
	       conn_event_counter, chan);

	conn_event_counter++;
	return true;
}

/*===========================================================================
 * 首次连接事件 — 锚点计算 + 单次 RX/TX
 *
 * ★ 这是本 Demo 的核心: 展示锚点如何从 CONNECT_IND 参数计算出来
 *
 * 公式 (BLE Core Spec Vol 6, Part B, 4.5.1):
 *   A0 = T0 + transmitWindowOffset + transmitWindowDelay
 *
 * 工程实现加了提前量 (margin):
 *   conn_offset_us = winOffset×1250 + 1250 - margins
 *
 * 减去 margins 是为了让 Radio 提前开 RX, 宁可早到也不能迟到
 *===========================================================================*/
void conn_first_event(void)
{
	/* 初始化连接状态 */
	tx_sn = 0;
	rx_nesn = 0;
	conn_event_counter = 0;
	last_unmapped_chan = 0;
	conn_event_rx_ok = 0;
	conn_event_rx_timeout = 0;

	memset(&anchor, 0, sizeof(anchor));

	radio_configure_conn();

	/* ==== 连接参数计算 ==== */
	uint32_t conn_interval_us = (uint32_t)conn_params.interval * CONN_INT_UNIT_US;
	uint32_t win_size_us = (uint32_t)conn_params.win_size * CONN_INT_UNIT_US;

	/* Window Widening 参数 (仅用于计算, 本例程不动态累积) */
	uint16_t master_sca_ppm = sca_ppm_table[conn_params.sca & 0x07];
	uint32_t combined_sca_ppm = (uint32_t)master_sca_ppm + LOCAL_SCA_PPM;
	uint32_t ww_periodic_us = DIV_ROUND_UP(
		combined_sca_ppm * conn_interval_us, 1000000);

	/* ★ 首次锚点偏移计算 */
	uint32_t conn_offset_us = (uint32_t)conn_params.win_offset * CONN_INT_UNIT_US
				+ WIN_DELAY_LEGACY
				- EVENT_TICKER_RES_MARGIN_US
				- EVENT_JITTER_US
				- radio_rx_ready_delay_get(0, 0)
				- ww_periodic_us;

	anchor.initial_anchor_us = conn_offset_us;

	/* ★ 转换为 RTC ticks + 皮秒余量 (亚 tick 精度) */
	uint32_t offset_ticks = HAL_TICKER_US_TO_TICKS(conn_offset_us);
	uint32_t offset_remainder_ps = HAL_TICKER_REMAINDER(conn_offset_us);

	uint32_t interval_ticks = HAL_TICKER_US_TO_TICKS(conn_interval_us);
	uint32_t interval_remainder_ps = HAL_TICKER_REMAINDER(conn_interval_us);

	/* 首次锚点的绝对 RTC tick */
	uint32_t first_anchor_rtc = (connect_end_rtc + offset_ticks) &
				    HAL_TICKER_CNTR_MASK;

	anchor.initial_anchor_rtc = first_anchor_rtc;
	anchor.current_anchor_rtc = first_anchor_rtc;

	/* HCTO 窗口 (首次事件用 win_size) */
	uint32_t hcto_add = ((EVENT_JITTER_US +
			      EVENT_TICKER_RES_MARGIN_US +
			      ww_periodic_us) << 1) +
			    win_size_us;

	/* ==== 执行首次连接事件 ==== */
	bool rx_ok = conn_event(first_anchor_rtc, offset_remainder_ps, hcto_add);

	printk("\n========== First Connection Event ==========\n");
	printk("  Result: %s\n", rx_ok ? "RX OK" : "RX MISS");
	printk("  RX OK count:     %u\n", conn_event_rx_ok);
	printk("  RX timeout count: %u\n", conn_event_rx_timeout);
	printk("=============================================\n");

	/* 清理 */
	NRF_RADIO->SHORTS = 0;
	radio_irq_disable();

	/* 打印详细的锚点计算过程 (连接事件结束后打印, 避免影响定时) */
	print_connect_ind();
	print_anchor_calculation(conn_offset_us,
				 offset_ticks,
				 offset_remainder_ps,
				 interval_ticks,
				 interval_remainder_ps,
				 master_sca_ppm,
				 combined_sca_ppm,
				 ww_periodic_us,
				 conn_interval_us);
}
```

## src/hal_radio.c
```c
/*
 * BLE PHY HCI Demo — HAL
 *
 * 目标板: nRF54L15DK
 *   TIMER10 + DPPIC10 : 软件 TIFS (与 02_active_scan 相同)
 *   TIMER20 @ 1 MHz   : 连接事件时基 (nRF54L15 没有 RTC0)
 *
 * SPDX-License-Identifier: Apache-2.0
 */

#include "hal_radio.h"

#include <hal/nrf_radio.h>
#include <hal/nrf_timer.h>
#include <hal/nrf_dppi.h>

#define SW_TIMER   NRF_TIMER10
#define SW_DPPIC   NRF_DPPIC10
#define TICK_TIMER NRF_TIMER20

/* TIMER10 PCLK=32 MHz, prescaler 5 → 1 MHz */
#define SW_TIMER_PRESCALER \
	NRF_TIMER_PRESCALER_CALCULATE(NRF_TIMER_BASE_FREQUENCY_GET(SW_TIMER), 1000000)

/* TIMER20 PCLK=16 MHz, prescaler 4 → 1 MHz */
#define TICK_TIMER_PRESCALER \
	NRF_TIMER_PRESCALER_CALCULATE(NRF_TIMER_BASE_FREQUENCY_GET(TICK_TIMER), 1000000)

static bool tmr_ready_latched;
static bool tmr_aa_latched;
static uint32_t tmr_ready_us;
static uint32_t tmr_aa_us;
static uint32_t hcto_deadline;
static bool hcto_active;

static void radio_aa_crc_set(uint32_t aa, uint32_t crc_iv)
{
	NRF_RADIO->PREFIX0 = (aa >> 24) & 0xFFUL;
	NRF_RADIO->BASE0 = (aa & 0x00FFFFFFUL) << 8;

	NRF_RADIO->CRCCNF = (RADIO_CRCCNF_LEN_Three << RADIO_CRCCNF_LEN_Pos) |
			    (RADIO_CRCCNF_SKIPADDR_Skip << RADIO_CRCCNF_SKIPADDR_Pos);
	NRF_RADIO->CRCPOLY = PDU_CRC_POLYNOMIAL;
	NRF_RADIO->CRCINIT = crc_iv;
}

static void radio_pkt_common(uint8_t maxlen)
{
	radio_irq_disable();
	NRF_RADIO->SHORTS = 0;

	NRF_RADIO->MODE = RADIO_MODE_MODE_Ble_1Mbit << RADIO_MODE_MODE_Pos;
	NRF_RADIO->TXPOWER = RADIO_TXPOWER_TXPOWER_0dBm;

	NRF_RADIO->PCNF0 = (8UL << RADIO_PCNF0_LFLEN_Pos) |
			   (1UL << RADIO_PCNF0_S0LEN_Pos) |
			   (RADIO_PCNF0_PLEN_8bit << RADIO_PCNF0_PLEN_Pos);

	NRF_RADIO->PCNF1 = ((uint32_t)maxlen << RADIO_PCNF1_MAXLEN_Pos) |
			   (0UL << RADIO_PCNF1_STATLEN_Pos) |
			   (3UL << RADIO_PCNF1_BALEN_Pos) |
			   (RADIO_PCNF1_ENDIAN_Little << RADIO_PCNF1_ENDIAN_Pos);

	NRF_RADIO->TXADDRESS = 0;
	NRF_RADIO->RXADDRESSES =
		RADIO_RXADDRESSES_ADDR0_Enabled << RADIO_RXADDRESSES_ADDR0_Pos;

	NRF_RADIO->TIFS = 0;
	nrf_radio_fast_ramp_up_enable_set(NRF_RADIO, true);
}

void hfclk_start(void)
{
	NRF_CLOCK->EVENTS_XOSTARTED = 0;
	NRF_CLOCK->TASKS_XOSTART = 1;
	while (NRF_CLOCK->EVENTS_XOSTARTED == 0) {
	}
	printk("HFCLK (HFXO) started\n");
}

void rtc0_start(void)
{
	nrf_timer_task_trigger(TICK_TIMER, NRF_TIMER_TASK_STOP);
	nrf_timer_task_trigger(TICK_TIMER, NRF_TIMER_TASK_CLEAR);
	nrf_timer_mode_set(TICK_TIMER, NRF_TIMER_MODE_TIMER);
	nrf_timer_bit_width_set(TICK_TIMER, NRF_TIMER_BIT_WIDTH_32);
	nrf_timer_prescaler_set(TICK_TIMER, TICK_TIMER_PRESCALER);
	nrf_timer_task_trigger(TICK_TIMER, NRF_TIMER_TASK_START);
	printk("Ticker (TIMER20) started: 1 MHz\n");
}

uint32_t ticker_now(void)
{
	nrf_timer_task_trigger(TICK_TIMER, NRF_TIMER_TASK_CAPTURE0);
	return nrf_timer_cc_get(TICK_TIMER, NRF_TIMER_CC_CHANNEL0);
}

void radio_irq_disable(void)
{
	NRF_RADIO->INTENCLR00 = 0xFFFFFFFFUL;
	NRF_RADIO->INTENCLR01 = 0xFFFFFFFFUL;
}

void radio_shorts_trx_set(void)
{
	NRF_RADIO->SHORTS = RADIO_SHORTS_READY_START_Msk |
			    RADIO_SHORTS_PHYEND_DISABLE_Msk;
}

void radio_ensure_disabled(void)
{
	NRF_RADIO->SHORTS = 0;
	dppi_disable_switch();
	nrf_timer_task_trigger(SW_TIMER, NRF_TIMER_TASK_STOP);
	hcto_active = false;

	if (NRF_RADIO->STATE != RADIO_STATE_STATE_Disabled) {
		NRF_RADIO->EVENTS_DISABLED = 0;
		NRF_RADIO->TASKS_DISABLE = 1;
		while (NRF_RADIO->EVENTS_DISABLED == 0) {
		}
	}
}

void radio_configure_adv(void)
{
	radio_pkt_common(PDU_AC_LEG_PAYLOAD_SIZE_MAX);
	radio_aa_crc_set(PDU_AC_ACCESS_ADDR, PDU_AC_CRC_IV);
	printk("Radio configured: ADV 1M (nRF54L15)\n");
}

void radio_configure_conn(void)
{
	uint32_t crc_iv = conn_params.crc_init[0] |
			  ((uint32_t)conn_params.crc_init[1] << 8) |
			  ((uint32_t)conn_params.crc_init[2] << 16);

	radio_pkt_common(PDU_DC_PAYLOAD_SIZE_MIN);
	radio_aa_crc_set(sys_get_le32(conn_params.access_addr), crc_iv);
	printk("Radio configured: CONN 1M (nRF54L15)\n");
}

void sw_switch_timer_configure(void)
{
	nrf_timer_task_trigger(SW_TIMER, NRF_TIMER_TASK_STOP);
	nrf_timer_task_trigger(SW_TIMER, NRF_TIMER_TASK_CLEAR);
	nrf_timer_int_disable(SW_TIMER, 0xFFFFFFFFUL);

	for (int i = 0; i < 8; i++) {
		nrf_timer_event_clear(SW_TIMER, nrf_timer_compare_event_get(i));
	}

	nrf_timer_mode_set(SW_TIMER, NRF_TIMER_MODE_TIMER);
	nrf_timer_bit_width_set(SW_TIMER, NRF_TIMER_BIT_WIDTH_16);
	nrf_timer_prescaler_set(SW_TIMER, SW_TIMER_PRESCALER);

	printk("SW_SWITCH_TIMER (TIMER10) configured: 1 MHz, 16-bit\n");
}

void dppi_configure(void)
{
	nrf_radio_publish_set(NRF_RADIO, NRF_RADIO_EVENT_PHYEND, DPPI_CH_TIMER_CLEAR);
	nrf_timer_subscribe_set(SW_TIMER, NRF_TIMER_TASK_CLEAR, DPPI_CH_TIMER_CLEAR);

	nrf_timer_publish_set(SW_TIMER, nrf_timer_compare_event_get(CC_IDX_RXEN),
			      DPPI_CH_RXEN);
	nrf_radio_subscribe_set(NRF_RADIO, NRF_RADIO_TASK_RXEN, DPPI_CH_RXEN);

	nrf_timer_publish_set(SW_TIMER, nrf_timer_compare_event_get(CC_IDX_TXEN),
			      DPPI_CH_TXEN);
	nrf_radio_subscribe_set(NRF_RADIO, NRF_RADIO_TASK_TXEN, DPPI_CH_TXEN);

	nrf_dppi_channels_enable(SW_DPPIC, BIT(DPPI_CH_TIMER_CLEAR));
	nrf_dppi_channels_disable(SW_DPPIC, BIT(DPPI_CH_RXEN) | BIT(DPPI_CH_TXEN));

	printk("DPPI configured (PHYEND→CLEAR, CC→RXEN/TXEN)\n");
}

void radio_freq_chan_set(uint32_t freq_off)
{
	NRF_RADIO->FREQUENCY = freq_off;
}

void radio_whiten_iv_set(uint8_t iv)
{
	NRF_RADIO->DATAWHITE = RADIO_DATAWHITE_ResetValue | iv;
	NRF_RADIO->PCNF1 |= RADIO_PCNF1_WHITEEN_Msk;
}

void radio_pkt_tx_set(void *pkt)
{
	NRF_RADIO->PACKETPTR = (uint32_t)pkt;
}

void radio_pkt_rx_set(void *pkt)
{
	NRF_RADIO->PACKETPTR = (uint32_t)pkt;
}

void radio_status_reset(void)
{
	NRF_RADIO->EVENTS_READY = 0;
	NRF_RADIO->EVENTS_ADDRESS = 0;
	NRF_RADIO->EVENTS_END = 0;
	NRF_RADIO->EVENTS_PHYEND = 0;
	NRF_RADIO->EVENTS_DISABLED = 0;
}

bool radio_crc_is_valid(void)
{
	return (NRF_RADIO->CRCSTATUS & RADIO_CRCSTATUS_CRCSTATUS_Msk) ==
	       (RADIO_CRCSTATUS_CRCSTATUS_CRCOk << RADIO_CRCSTATUS_CRCSTATUS_Pos);
}

bool radio_is_done(void)
{
	return NRF_RADIO->EVENTS_PHYEND != 0;
}

void sw_timer_cc_set(uint8_t cc_idx, uint32_t us)
{
	nrf_timer_cc_set(SW_TIMER, (nrf_timer_cc_channel_t)cc_idx, us);
}

void sw_timer_start(void)
{
	nrf_timer_task_trigger(SW_TIMER, NRF_TIMER_TASK_CLEAR);
	nrf_timer_task_trigger(SW_TIMER, NRF_TIMER_TASK_START);
}

void sw_timer_clear_compare(uint8_t cc_idx)
{
	nrf_timer_event_clear(SW_TIMER, nrf_timer_compare_event_get(cc_idx));
	(void)nrf_timer_event_check(SW_TIMER, nrf_timer_compare_event_get(cc_idx));
}

void dppi_enable_rxen(void)
{
	nrf_dppi_channels_enable(SW_DPPIC, BIT(DPPI_CH_RXEN));
}

void dppi_enable_txen(void)
{
	nrf_dppi_channels_enable(SW_DPPIC, BIT(DPPI_CH_TXEN));
}

void dppi_disable_switch(void)
{
	nrf_dppi_channels_disable(SW_DPPIC, BIT(DPPI_CH_RXEN) | BIT(DPPI_CH_TXEN));
}

bool radio_event_end_check(void)
{
	return NRF_RADIO->EVENTS_PHYEND != 0;
}

void radio_event_end_clear(void)
{
	NRF_RADIO->EVENTS_PHYEND = 0;
	NRF_RADIO->EVENTS_END = 0;
}

void data_chan_set(uint8_t chan)
{
	uint32_t freq;

	if (chan <= 10) {
		freq = 4 + (chan * 2U);
	} else if (chan <= 36) {
		freq = 28 + ((chan - 11) * 2U);
	} else {
		return;
	}

	radio_freq_chan_set(freq);
	radio_whiten_iv_set(chan);
}

uint32_t radio_tmr_start(uint8_t trx, uint32_t ticks_start, uint32_t remainder)
{
	ARG_UNUSED(remainder);

	while (((ticks_start - ticker_now()) & HAL_TICKER_CNTR_MASK) <=
	       (HAL_TICKER_CNTR_MASK >> 1)) {
	}

	tmr_ready_latched = false;
	tmr_aa_latched = false;
	tmr_ready_us = 0;
	tmr_aa_us = 0;

	if (trx == 0) {
		NRF_RADIO->TASKS_RXEN = 1;
	} else {
		NRF_RADIO->TASKS_TXEN = 1;
	}

	return 0;
}

void radio_tmr_status_reset(void)
{
	hcto_active = false;
	tmr_ready_latched = false;
	tmr_aa_latched = false;
}

void radio_tmr_aa_capture(void)
{
}

void radio_tmr_aa_save(uint32_t aa)
{
	ARG_UNUSED(aa);
}

void radio_tmr_end_capture(void)
{
}

void radio_tmr_hcto_configure(uint32_t hcto_us)
{
	hcto_deadline = ticker_now() + hcto_us;
	hcto_active = true;
}

void radio_tmr_stamp_poll(void)
{
	if (!tmr_ready_latched && NRF_RADIO->EVENTS_READY) {
		tmr_ready_us = ticker_now();
		tmr_ready_latched = true;
	}
	if (!tmr_aa_latched && NRF_RADIO->EVENTS_ADDRESS) {
		tmr_aa_us = ticker_now();
		tmr_aa_latched = true;
	}
}

bool radio_hcto_expired(void)
{
	if (!hcto_active) {
		return false;
	}
	return (int32_t)(ticker_now() - hcto_deadline) >= 0;
}

uint32_t radio_tmr_aa_get(void)
{
	return tmr_aa_us;
}

uint32_t radio_tmr_ready_get(void)
{
	return tmr_ready_us;
}

uint32_t radio_rx_ready_delay_get(uint8_t phy, uint8_t flags)
{
	ARG_UNUSED(phy);
	ARG_UNUSED(flags);
	return RX_RAMP_US;
}

uint32_t radio_rx_chain_delay_get(uint8_t phy, uint8_t flags)
{
	ARG_UNUSED(phy);
	ARG_UNUSED(flags);
	return RX_CHAIN_DELAY_1M_US;
}
```

## src/hal_radio.h
```c
/*
 * BLE PHY HCI Demo — HAL: Radio / TIMER10 / DPPIC10 / TIMER20
 *
 * 目标板: nRF54L15DK。写法对齐 02_active_scan。
 *
 * SPDX-License-Identifier: Apache-2.0
 */

#ifndef HAL_RADIO_INIT_H
#define HAL_RADIO_INIT_H

#include "ble_common.h"

void hfclk_start(void);
void rtc0_start(void);
void sw_switch_timer_configure(void);
void dppi_configure(void);

void radio_ensure_disabled(void);
void radio_configure_adv(void);
void radio_configure_conn(void);
void data_chan_set(uint8_t chan);

void radio_irq_disable(void);
void radio_shorts_trx_set(void);
void radio_freq_chan_set(uint32_t freq_off);
void radio_whiten_iv_set(uint8_t iv);
void radio_pkt_tx_set(void *pkt);
void radio_pkt_rx_set(void *pkt);
void radio_status_reset(void);
bool radio_crc_is_valid(void);
bool radio_is_done(void);

void sw_timer_cc_set(uint8_t cc_idx, uint32_t us);
void sw_timer_start(void);
void sw_timer_clear_compare(uint8_t cc_idx);

void dppi_enable_rxen(void);
void dppi_enable_txen(void);
void dppi_disable_switch(void);

bool radio_event_end_check(void);
void radio_event_end_clear(void);

uint32_t ticker_now(void);

uint32_t radio_tmr_start(uint8_t trx, uint32_t ticks_start, uint32_t remainder);
void radio_tmr_status_reset(void);
void radio_tmr_aa_capture(void);
void radio_tmr_aa_save(uint32_t aa);
void radio_tmr_end_capture(void);
void radio_tmr_hcto_configure(uint32_t hcto_us);
void radio_tmr_stamp_poll(void);
bool radio_hcto_expired(void);
uint32_t radio_tmr_aa_get(void);
uint32_t radio_tmr_ready_get(void);
uint32_t radio_rx_ready_delay_get(uint8_t phy, uint8_t flags);
uint32_t radio_rx_chain_delay_get(uint8_t phy, uint8_t flags);

#endif /* HAL_RADIO_INIT_H */
```
