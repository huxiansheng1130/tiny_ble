## CMakeLists.txt
```
# SPDX-License-Identifier: Apache-2.0

cmake_minimum_required(VERSION 3.20.0)
find_package(Zephyr REQUIRED HINTS $ENV{ZEPHYR_BASE})
project(ble_phy_connect_ind)

target_sources(app PRIVATE
  src/main.c
  src/hal_radio.c
  src/ll_pdu.c
  src/adv.c
)
```

## prj.conf
```kconfig
# BLE PHY CONNECT_IND Demo
# 解析连接请求: 从 CONNECT_IND 中提取连接参数

CONFIG_GPIO=y
CONFIG_SERIAL=y
CONFIG_CONSOLE=y
CONFIG_UART_CONSOLE=y
CONFIG_PRINTK=y

# 直接操作 RADIO (nRF54L15)
CONFIG_BT=n
CONFIG_CLOCK_CONTROL=y
```

## src/main.c
```c
/*
 * BLE PHY CONNECT_IND 解析 Demo
 *
 * 本 Demo 专注于 BLE 连接建立的第一步 —— 接收和解析 CONNECT_IND。
 *
 * ┌ ─ ─ ─ ─ ─ ─ ─ ─ ─ ─ ─ ─ ─ ─ ─ ─ ─ ─ ─ ─ ─ ─ ─ ─ ─ ─ ─ ─ ─ ─ ─ ┐
 * │ 什么是 CONNECT_IND?                                                   │
 * │                                                                       │
 * │ CONNECT_IND 是 Master 发给 Slave 的连接请求包, 包含建立连接所需的     │
 * │ 全部参数: Access Address, CRC 初始值, 连接间隔, 跳频参数等。          │
 * │                                                                       │
 * │ Core Spec Vol 6, Part B, Section 2.3.3.1:                             │
 * │   InitA(6) + AdvA(6) + LLData(22) = 34 字节                          │
 * │                                                                       │
 * │ LLData 包含 12 个字段:                                                │
 * │   AA, CRCInit, WinSize, WinOffset, Interval, Latency, Timeout,       │
 * │   ChM, Hop, SCA                                                       │
 * └ ─ ─ ─ ─ ─ ─ ─ ─ ─ ─ ─ ─ ─ ─ ─ ─ ─ ─ ─ ─ ─ ─ ─ ─ ─ ─ ─ ─ ─ ─ ─ ┘
 *
 * 时序:
 *
 *   Slave                               Master
 *    │                                    │
 *    │──── ADV_IND (ch 37/38/39) ───────>│
 *    │                                    │
 *    │<──── CONNECT_IND (T_IFS=150μs) ───│
 *    │        [T0 = RTC0 timestamp]       │
 *    │                                    │
 *    │  解析 LLData → print_connect_ind() │
 *    │                                    │
 *    │  (本例程不进入连接态, 打印后回到广播)│
 *
 * 代码结构:
 *   ble_common.h  — 公共类型、常量 (新增 struct conn_param)
 *   hal_radio.c/h — HAL 层 (新增 rtc0_start)
 *   ll_pdu.c/h    — PDU 构造 (新增 CONNECT_IND 解析与打印)
 *   adv.c/h       — 广播态 (改为等待 CONNECT_IND, 不再处理 SCAN_REQ)
 *   main.c        — 主状态机: ADV → CONNECT_IND → 打印 → ADV
 *
 * SPDX-License-Identifier: Apache-2.0
 */

#include "ble_common.h"
#include "hal_radio.h"
#include "ll_pdu.h"
#include "adv.h"

/*===========================================================================
 * 全局变量定义
 *===========================================================================*/

const uint8_t adv_addr[BDADDR_SIZE] = {
	0x11, 0x22, 0x33, 0x44, 0x55, 0x66
};

const uint8_t adv_data[] = {
	0x02, 0x01, 0x06,
	0x08, 0x09, 'C', 'o', 'n', 'n', 'I', 'n', 'd'
};

struct conn_param conn_params;

/* PDU 缓冲区 */
struct pdu_adv pdu_adv_ind __aligned(4);
struct pdu_adv pdu_adv_rx __aligned(4);

/* CONNECT_IND 接收时刻 (NRF_RTC0 Counter) — 这就是 "T0" */
uint32_t connect_end_rtc;

/* SCA PPM 映射表 (BLE Core Spec Vol 6, Part B, 4.5.7, Table 4.1) */
const uint16_t sca_ppm_table[] = {500, 250, 150, 100, 75, 50, 30, 20};

/* 统计 */
volatile uint32_t adv_event_count;

/*===========================================================================
 * 主函数
 *===========================================================================*/
int main(void)
{
	printk("\n");
	printk("===================================================\n");
	printk("  BLE PHY CONNECT_IND Demo\n");
	printk("  解析连接请求中的 12 个参数字段\n");
	printk("===================================================\n");
	printk("Device: %s  Addr: %02X:%02X:%02X:%02X:%02X:%02X\n",
	       ADV_NAME,
	       adv_addr[5], adv_addr[4], adv_addr[3],
	       adv_addr[2], adv_addr[1], adv_addr[0]);
	printk("\n");

	hfclk_start();
	rtc0_start();
	sw_switch_timer_configure();
	dppi_configure();

	while (1) {
		printk("[STATE] Entering ADVERTISING state\n");
		adv_event_count = 0;

		radio_configure_adv();
		build_adv_ind_pdu();

		bool connected = false;

		while (!connected) {
			int ret = adv_event();

			if (ret == 1) {
				connected = true;
			} else {
				k_msleep(ADV_INTERVAL_MS);
			}
		}

		/* ★ 收到 CONNECT_IND! 打印解析结果 */
		print_connect_ind();

		printk("\n[STATE] CONNECT_IND parsed. "
		       "(Not entering connection state in this demo)\n");
		printk("[STATE] Returning to advertising...\n\n");

		radio_ensure_disabled();
		k_msleep(100);
	}

	return 0;
}
```

## src/adv.c
```c
/*
 * BLE PHY CONNECT_IND Demo — 广播态: ADV_IND 发送与 CONNECT_IND 接收
 *
 * 相比 02_tifs_scan 的 adv.c, 关键变化:
 *   - TX ADV_IND 后等待的不再是 SCAN_REQ, 而是 CONNECT_IND
 *   - RX 完成后立即读取 ticker_now() 捕获 T0
 *   - 验证成功后调用 parse_connect_ind() 提取参数
 *   - 返回值: 1=收到 CONNECT_IND, 0=未收到
 *
 * SPDX-License-Identifier: Apache-2.0
 */

#include "adv.h"
#include "hal_radio.h"
#include "ll_pdu.h"

/*===========================================================================
 * 广播信道处理
 *===========================================================================*/
int adv_on_channel(uint32_t channel)
{
	uint32_t freq;

	switch (channel) {
	case 37: freq = 2;  break;
	case 38: freq = 26; break;
	case 39: freq = 80; break;
	default: return 0;
	}

	radio_freq_chan_set(freq);
	radio_whiten_iv_set(channel);

	radio_irq_disable();

	/*==============================================================
	 * 第 1 阶段: TX ADV_IND (SW TIFS)
	 *
	 * PPI_CH_RXEN 在 TX 期间保持禁用!
	 * TX END 时 PPI_CH_TIMER_CLEAR 清零 Timer1。
	 * TX END 后启用 PPI_CH_RXEN, 110μs 后 RXEN 触发。
	 *==============================================================*/

	radio_pkt_tx_set(&pdu_adv_ind);

	radio_status_reset();
	NRF_RADIO->EVENTS_DISABLED = 0;
	radio_event_end_clear();
	NRF_RADIO->EVENTS_ADDRESS = 0;

	/* SW TIFS: 不使用 DISABLED_RXEN SHORT */
	radio_shorts_trx_set();

	sw_timer_cc_set(CC_IDX_RXEN, T_IFS_US - RX_RAMP_US);
	dppi_disable_switch();

	sw_timer_start();

	NRF_RADIO->TASKS_TXEN = 1;

	/* 等待 TX END */
	while (!radio_event_end_check()) {
	}
	radio_event_end_clear();

	/*==============================================================
	 * TX→RX 转换 (SW TIFS)
	 *
	 * TX END 时 PPI 清零 Timer1, 从 0 开始计数。
	 * 清除陈旧 COMPARE 事件, 切换到 RX 缓冲区, 启用 PPI_CH_RXEN。
	 * 110μs 后 CC[0] 触发 RXEN → 40μs ramp → RX START (T_IFS=150μs)
	 *==============================================================*/

	sw_timer_clear_compare(CC_IDX_RXEN);

	radio_pkt_rx_set(&pdu_adv_rx);

	dppi_enable_rxen();

	/* 等待 TX DISABLED */
	while (NRF_RADIO->EVENTS_DISABLED == 0) {
	}
	NRF_RADIO->EVENTS_DISABLED = 0;

	/*==============================================================
	 * 第 2 阶段: RX 等待 CONNECT_IND
	 *
	 * ★ 必须清除 TX 期间的 ADDRESS 事件!
	 * EVENTS_ADDRESS 在 TX 时被硬件置 1 (AA 发送到空中时),
	 * 若不清除, 后续逻辑会误判为已收到包。
	 *==============================================================*/

	NRF_RADIO->EVENTS_ADDRESS = 0;

	uint32_t timeout_loops = ADV_RX_TIMEOUT_US * 16;
	bool rx_done = false;

	while (timeout_loops > 0) {
		if (NRF_RADIO->EVENTS_DISABLED) {
			rx_done = true;
			break;
		}
		timeout_loops--;
	}

	/* ★ 关键时刻: 立即捕获 T0 — CONNECT_IND 结束时的 RTC0 tick
	 *
	 * 必须在 CRC 检查和 validate 之前读取, 减少软件延迟!
	 * 这个值是整个锚点体系的基准, 所有后续连接事件
	 * 的定时都从这个 T0 开始推算。
	 *
	 * 在 Zephyr 控制器中:
	 *   ftr->ticks_anchor = radio_tmr_start_get() */
	uint32_t rx_end_rtc = ticker_now() & HAL_TICKER_CNTR_MASK;

	if (!rx_done) {
		radio_ensure_disabled();
		return 0;
	}

	dppi_disable_switch();
	NRF_RADIO->SHORTS = 0;

	if (!radio_crc_is_valid()) {
		return 0;
	}

	if (validate_connect_ind(&pdu_adv_rx)) {
		connect_end_rtc = rx_end_rtc;
		parse_connect_ind(&pdu_adv_rx);
		return 1;
	}

	return 0;
}

/*===========================================================================
 * 广播事件
 *===========================================================================*/
int adv_event(void)
{
	static const uint32_t adv_channels[] = {37, 38, 39};

	for (int i = 0; i < 3; i++) {
		int ret = adv_on_channel(adv_channels[i]);

		if (ret == 1) {
			return 1;
		}
	}

	adv_event_count++;
	if (adv_event_count <= 3 || adv_event_count % 50 == 0) {
		printk("[ADV] events: %u (waiting for connection...)\n",
		       adv_event_count);
	}
	return 0;
}
```

## src/ble_common.h
```c
/*
 * BLE PHY CONNECT_IND Demo — 公共类型、常量与全局变量声明
 *
 * 本例程在 02_tifs_scan 基础上增加:
 *   - struct conn_param: CONNECT_IND 解析结果
 *   - RTC0 时间戳: 用于捕获 CONNECT_IND 接收时刻 (T0)
 *   - ADV 逻辑从 SCAN_REQ/SCAN_RSP 简化为只等待 CONNECT_IND
 *
 * SPDX-License-Identifier: Apache-2.0
 */

#ifndef BLE_COMMON_H
#define BLE_COMMON_H

#include <zephyr/kernel.h>
#include <zephyr/sys/printk.h>
#include <zephyr/sys/byteorder.h>
#include <string.h>
#include <stdint.h>
#include <stdbool.h>
#include <soc.h>

/*
 * nRF54L15 没有 nRF52 的 PPI / RTC0，也不使用 Zephyr LL 内部头文件。
 * 硬件路径与 02_active_scan 相同: TIMER10 + DPPIC10 做软件 TIFS，
 * TIMER20 (1 MHz) 做连接时基。
 */

#define BDADDR_SIZE                 6
#define PDU_AC_LEG_DATA_SIZE_MAX    31
#define PDU_AC_LEG_PAYLOAD_SIZE_MAX 37
#define PDU_DC_PAYLOAD_SIZE_MIN     27
#define PDU_AC_ACCESS_ADDR          0x8e89bed6
#define PDU_AC_CRC_IV               0x555555
#define PDU_CRC_POLYNOMIAL          0x00065b
#define PDU_CHANNEL_MAP_SIZE        5

enum pdu_adv_type {
	PDU_ADV_TYPE_ADV_IND = 0x00,
	PDU_ADV_TYPE_DIRECT_IND = 0x01,
	PDU_ADV_TYPE_NONCONN_IND = 0x02,
	PDU_ADV_TYPE_SCAN_REQ = 0x03,
	PDU_ADV_TYPE_SCAN_RSP = 0x04,
	PDU_ADV_TYPE_CONNECT_IND = 0x05,
	PDU_ADV_TYPE_SCAN_IND = 0x06,
};

struct pdu_adv_adv_ind {
	uint8_t addr[BDADDR_SIZE];
	uint8_t data[PDU_AC_LEG_DATA_SIZE_MAX];
} __packed;

struct pdu_adv_connect_ind {
	uint8_t init_addr[BDADDR_SIZE];
	uint8_t adv_addr[BDADDR_SIZE];
	struct {
		uint8_t  access_addr[4];
		uint8_t  crc_init[3];
		uint8_t  win_size;
		uint16_t win_offset;
		uint16_t interval;
		uint16_t latency;
		uint16_t timeout;
		uint8_t  chan_map[PDU_CHANNEL_MAP_SIZE];
		uint8_t  hop:5;
		uint8_t  sca:3;
	} __packed;
} __packed;

struct pdu_adv {
	uint8_t type:4;
	uint8_t rfu:1;
	uint8_t chan_sel:1;
	uint8_t tx_addr:1;
	uint8_t rx_addr:1;
	uint8_t len;
	union {
		uint8_t payload[PDU_AC_LEG_PAYLOAD_SIZE_MAX];
		struct pdu_adv_adv_ind adv_ind;
		struct pdu_adv_connect_ind connect_ind;
	} __packed;
} __packed;

enum pdu_data_llid {
	PDU_DATA_LLID_RESV = 0x00,
	PDU_DATA_LLID_DATA_CONTINUE = 0x01,
	PDU_DATA_LLID_DATA_START = 0x02,
	PDU_DATA_LLID_CTRL = 0x03,
};

enum pdu_data_llctrl_type {
	PDU_DATA_LLCTRL_TYPE_CONN_UPDATE_IND = 0x00,
	PDU_DATA_LLCTRL_TYPE_CHAN_MAP_IND = 0x01,
	PDU_DATA_LLCTRL_TYPE_TERMINATE_IND = 0x02,
	PDU_DATA_LLCTRL_TYPE_UNKNOWN_RSP = 0x07,
	PDU_DATA_LLCTRL_TYPE_FEATURE_REQ = 0x08,
	PDU_DATA_LLCTRL_TYPE_FEATURE_RSP = 0x09,
	PDU_DATA_LLCTRL_TYPE_VERSION_IND = 0x0C,
	PDU_DATA_LLCTRL_TYPE_PER_INIT_FEAT_XCHG = 0x0E,
	PDU_DATA_LLCTRL_TYPE_PING_REQ = 0x12,
	PDU_DATA_LLCTRL_TYPE_PING_RSP = 0x13,
	PDU_DATA_LLCTRL_TYPE_LENGTH_REQ = 0x14,
	PDU_DATA_LLCTRL_TYPE_LENGTH_RSP = 0x15,
};

struct pdu_data_llctrl_conn_update_ind {
	uint8_t  win_size;
	uint16_t win_offset;
	uint16_t interval;
	uint16_t latency;
	uint16_t timeout;
	uint16_t instant;
} __packed;

struct pdu_data_llctrl_chan_map_ind {
	uint8_t  chm[PDU_CHANNEL_MAP_SIZE];
	uint16_t instant;
} __packed;

struct pdu_data_llctrl_unknown_rsp {
	uint8_t type;
} __packed;

struct pdu_data_llctrl_feature_rsp {
	uint8_t features[8];
} __packed;

struct pdu_data_llctrl_version_ind {
	uint8_t  version_number;
	uint16_t company_id;
	uint16_t sub_version_number;
} __packed;

struct pdu_data_llctrl_length_rsp {
	uint16_t max_rx_octets;
	uint16_t max_rx_time;
	uint16_t max_tx_octets;
	uint16_t max_tx_time;
} __packed;

struct pdu_data_llctrl {
	uint8_t opcode;
	union {
		struct pdu_data_llctrl_conn_update_ind conn_update_ind;
		struct pdu_data_llctrl_chan_map_ind chan_map_ind;
		struct pdu_data_llctrl_unknown_rsp unknown_rsp;
		struct pdu_data_llctrl_feature_rsp feature_rsp;
		struct pdu_data_llctrl_version_ind version_ind;
		struct pdu_data_llctrl_length_rsp length_rsp;
	} __packed;
} __packed;

struct pdu_data {
	uint8_t ll_id:2;
	uint8_t nesn:1;
	uint8_t sn:1;
	uint8_t md:1;
	uint8_t rfu:3;
	uint8_t len;
	union {
		struct pdu_data_llctrl llctrl;
		uint8_t lldata[PDU_DC_PAYLOAD_SIZE_MIN];
	} __packed;
} __packed;

/* TIMER20 @ 1 MHz: 1 tick = 1 us, 32-bit */
#define HAL_TICKER_CNTR_CLK_UNIT_FSEC 1000000000UL
#define HAL_TICKER_CNTR_MASK          0xFFFFFFFFUL
#define HAL_TICKER_FSEC_PER_USEC      1000000000UL
#define HAL_TICKER_PSEC_PER_USEC      1000000UL
#define HAL_TICKER_FSEC_PER_PSEC      1000UL

#define HAL_TICKER_US_TO_TICKS(x) (((uint32_t)(x)) & HAL_TICKER_CNTR_MASK)
#define HAL_TICKER_TICKS_TO_US(x) ((uint32_t)(x))
#define HAL_TICKER_REMAINDER(x)   (0U)


/*===========================================================================
 * 配置参数
 *===========================================================================*/

/* 广播间隔 (ms) */
#define ADV_INTERVAL_MS  100

/* T_IFS = 150 μs */
#define T_IFS_US         150

/* ADV RX 超时 (μs) */
#define ADV_RX_TIMEOUT_US  600

/* BLE 定时常量 */
#define CONN_INT_UNIT_US  1250  /* connInterval unit (1.25ms) */

#define ADV_NAME         "ConnInd"

/* TX/RX ramp-up 延迟 (μs): fast ramp-up ≈ 40 μs */
#define RX_RAMP_US       40
#define TX_RAMP_US       40
#define RX_CHAIN_DELAY_1M_US  10

/*===========================================================================
 * PPI 通道分配 (SW TIFS)
 *===========================================================================*/
#define DPPI_CH_TIMER_CLEAR  0   /* RADIO PHYEND -> TIMER CLEAR */
#define DPPI_CH_RXEN         1   /* TIMER CC[0] -> RADIO RXEN */
#define DPPI_CH_TXEN         2   /* TIMER CC[1] -> RADIO TXEN */

#define CC_IDX_RXEN  0   /* Timer CC[0]: TX→RX 转换 */
#define CC_IDX_TXEN  1   /* Timer CC[1]: RX→TX 转换 */

/*===========================================================================
 * 连接参数结构体
 *===========================================================================*/
struct conn_param {
	uint8_t  access_addr[4];
	uint8_t  crc_init[3];
	uint8_t  win_size;
	uint16_t win_offset;
	uint16_t interval;
	uint16_t latency;
	uint16_t timeout;
	uint8_t  chan_map[PDU_CHANNEL_MAP_SIZE];
	uint8_t  hop;
	uint8_t  sca;
	uint8_t  chan_count;
	uint8_t  peer_addr[BDADDR_SIZE];
};

/*===========================================================================
 * 全局变量声明 (定义在 main.c)
 *===========================================================================*/

extern const uint8_t adv_addr[BDADDR_SIZE];
extern const uint8_t adv_data[];
#define ADV_DATA_LEN 14  /* sizeof(adv_data) */

extern struct conn_param conn_params;

/* PDU 缓冲区 */
extern struct pdu_adv pdu_adv_ind;
extern struct pdu_adv pdu_adv_rx;

/* CONNECT_IND 接收时刻 (NRF_RTC0 Counter) — 这就是 "T0", 锚点的起始基准 */
extern uint32_t connect_end_rtc;

/* SCA PPM 映射表 */
extern const uint16_t sca_ppm_table[];

/* 统计 */
extern volatile uint32_t adv_event_count;

#endif /* BLE_COMMON_H */
```
