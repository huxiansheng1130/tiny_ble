## CMakeLists.txt
```
# SPDX-License-Identifier: Apache-2.0

cmake_minimum_required(VERSION 3.20.0)
find_package(Zephyr REQUIRED HINTS $ENV{ZEPHYR_BASE})
project(ble_phy_slave_latency)

target_sources(app PRIVATE
  src/main.c
  src/hal_radio.c
  src/ll_pdu.c
  src/adv.c
  src/conn.c
  src/l2cap.c
)
```

## prj.conf
```kconfig
# BLE PHY Slave Latency Demo
# 演示从机延迟 (Slave Latency) 机制

CONFIG_GPIO=y
CONFIG_SERIAL=y
CONFIG_CONSOLE=y
CONFIG_UART_CONSOLE=y
CONFIG_PRINTK=y

# 直接操作 RADIO (nRF54L15)
CONFIG_BT=n
CONFIG_CLOCK_CONTROL=y
```

## src/main.c
```c
/*
 * BLE PHY Slave Latency (从机延迟) Demo
 *
 * 本 Demo 在 07_phy_data_channel 基础上增加了 Slave Latency 功能:
 *
 * ┌─────────────────────────────────────────────────────────────────┐
 * │  Slave Latency 是什么?                                          │
 * │                                                                 │
 * │  正常连接中, Slave 每个 connInterval 都必须唤醒射频。           │
 * │  当 CONNECT_IND 中 connSlaveLatency > 0 时:                     │
 * │    Slave 允许最多跳过 connSlaveLatency 个连接事件不监听,        │
 * │    大幅降低射频功耗。                                           │
 * │                                                                 │
 * │  约束:                                                          │
 * │    1. 有数据要发 → 必须监听 (不能跳过)                         │
 * │    2. 连续跳过达到 latency 上限 → 必须监听                     │
 * │    3. WW 在跳过期间按比例增长                                   │
 * │    4. 信道选择即使跳过也必须推进                                │
 * └─────────────────────────────────────────────────────────────────┘
 *
 * 时间线示意 (latency=3):
 *
 *   Event:  #0    #1    #2    #3    #4    #5    #6    #7
 *   Action: LISTEN skip  skip  skip  LISTEN skip  skip  skip
 *   WW:     0     +1p   +2p   +3p   0     +1p   +2p   +3p
 *
 *   (p = ww_periodic_us, LISTEN 成功后 WW 重置)
 *
 * SPDX-License-Identifier: Apache-2.0
 */

#include "ble_common.h"
#include "hal_radio.h"
#include "ll_pdu.h"
#include "adv.h"
#include "conn.h"
#include "l2cap.h"

/*===========================================================================
 * 全局变量定义
 *===========================================================================*/

const uint8_t adv_addr[BDADDR_SIZE] = {
	0x11, 0x22, 0x33, 0x44, 0x55, 0x66
};

const uint8_t adv_data[] = {
	0x02, 0x01, 0x06,
	0x06, 0x09, 'S', 'L', 'a', 't', 'e'
};

struct conn_param conn_params;

uint8_t tx_sn;
uint8_t rx_nesn;
uint16_t conn_event_counter;
uint8_t last_unmapped_chan;
volatile bool conn_terminated;

struct pdu_data tx_pdu_buf __aligned(4);
bool tx_pdu_pending;

struct pdu_adv pdu_adv_ind __aligned(4);
struct pdu_adv pdu_adv_rx __aligned(4);
struct pdu_data pdu_data_rx __aligned(4);

uint32_t connect_end_rtc;
const uint16_t sca_ppm_table[] = {500, 250, 150, 100, 75, 50, 30, 20};

struct anchor_tracker anchor;
struct latency_tracker lat;

volatile uint32_t adv_event_count;
volatile uint32_t conn_event_rx_ok;
volatile uint32_t conn_event_rx_timeout;
volatile uint32_t conn_event_rx_crc_err;

uint32_t last_rx_aa_us;
uint32_t last_rx_ready_us;

struct l2cap_reassembly l2cap_reasm;
struct tx_queue data_tx_q;
uint32_t l2cap_rx_count;
uint32_t l2cap_tx_count;

int main(void)
{
	printk("\n");
	printk("===================================================\n");
	printk("  BLE PHY Slave Latency Demo\n");
	printk("  演示从机延迟 (Slave Latency) 省电机制\n");
	printk("===================================================\n");
	printk("Device: %s  Addr: %02X:%02X:%02X:%02X:%02X:%02X\n",
	       ADV_NAME,
	       adv_addr[5], adv_addr[4], adv_addr[3],
	       adv_addr[2], adv_addr[1], adv_addr[0]);
	printk("\n");

	hfclk_start();
	rtc0_start();
	sw_switch_timer_configure();
	dppi_configure();

	while (1) {
		printk("[STATE] Entering ADVERTISING state\n");
		adv_event_count = 0;

		radio_configure_adv();
		build_adv_ind_pdu();

		bool connected = false;
		while (!connected) {
			int ret = adv_event();
			if (ret == 1) {
				connected = true;
			} else {
				k_msleep(ADV_INTERVAL_MS);
			}
		}

		conn_loop();

		printk("[STATE] Connection lost, returning to advertising...\n\n");
		radio_ensure_disabled();
		k_msleep(100);
	}

	return 0;
}
```

## src/ble_common.h
```c
/*
 * BLE PHY Slave Latency Demo — 公共类型、常量与全局变量声明
 *
 * SPDX-License-Identifier: Apache-2.0
 */

#ifndef BLE_COMMON_H
#define BLE_COMMON_H

#include <zephyr/kernel.h>
#include <zephyr/sys/printk.h>
#include <zephyr/sys/byteorder.h>
#include <string.h>
#include <stdint.h>
#include <stdbool.h>
#include <soc.h>

/*
 * nRF54L15 没有 nRF52 的 PPI / RTC0，也不使用 Zephyr LL 内部头文件。
 * 硬件路径与 02_active_scan 相同: TIMER10 + DPPIC10 做软件 TIFS，
 * TIMER20 (1 MHz) 做连接时基。
 */

#define BDADDR_SIZE                 6
#define PDU_AC_LEG_DATA_SIZE_MAX    31
#define PDU_AC_LEG_PAYLOAD_SIZE_MAX 37
#define PDU_DC_PAYLOAD_SIZE_MIN     27
#define PDU_AC_ACCESS_ADDR          0x8e89bed6
#define PDU_AC_CRC_IV               0x555555
#define PDU_CRC_POLYNOMIAL          0x00065b
#define PDU_CHANNEL_MAP_SIZE        5

enum pdu_adv_type {
	PDU_ADV_TYPE_ADV_IND = 0x00,
	PDU_ADV_TYPE_DIRECT_IND = 0x01,
	PDU_ADV_TYPE_NONCONN_IND = 0x02,
	PDU_ADV_TYPE_SCAN_REQ = 0x03,
	PDU_ADV_TYPE_SCAN_RSP = 0x04,
	PDU_ADV_TYPE_CONNECT_IND = 0x05,
	PDU_ADV_TYPE_SCAN_IND = 0x06,
};

struct pdu_adv_adv_ind {
	uint8_t addr[BDADDR_SIZE];
	uint8_t data[PDU_AC_LEG_DATA_SIZE_MAX];
} __packed;

struct pdu_adv_connect_ind {
	uint8_t init_addr[BDADDR_SIZE];
	uint8_t adv_addr[BDADDR_SIZE];
	struct {
		uint8_t  access_addr[4];
		uint8_t  crc_init[3];
		uint8_t  win_size;
		uint16_t win_offset;
		uint16_t interval;
		uint16_t latency;
		uint16_t timeout;
		uint8_t  chan_map[PDU_CHANNEL_MAP_SIZE];
		uint8_t  hop:5;
		uint8_t  sca:3;
	} __packed;
} __packed;

struct pdu_adv {
	uint8_t type:4;
	uint8_t rfu:1;
	uint8_t chan_sel:1;
	uint8_t tx_addr:1;
	uint8_t rx_addr:1;
	uint8_t len;
	union {
		uint8_t payload[PDU_AC_LEG_PAYLOAD_SIZE_MAX];
		struct pdu_adv_adv_ind adv_ind;
		struct pdu_adv_connect_ind connect_ind;
	} __packed;
} __packed;

enum pdu_data_llid {
	PDU_DATA_LLID_RESV = 0x00,
	PDU_DATA_LLID_DATA_CONTINUE = 0x01,
	PDU_DATA_LLID_DATA_START = 0x02,
	PDU_DATA_LLID_CTRL = 0x03,
};

enum pdu_data_llctrl_type {
	PDU_DATA_LLCTRL_TYPE_CONN_UPDATE_IND = 0x00,
	PDU_DATA_LLCTRL_TYPE_CHAN_MAP_IND = 0x01,
	PDU_DATA_LLCTRL_TYPE_TERMINATE_IND = 0x02,
	PDU_DATA_LLCTRL_TYPE_UNKNOWN_RSP = 0x07,
	PDU_DATA_LLCTRL_TYPE_FEATURE_REQ = 0x08,
	PDU_DATA_LLCTRL_TYPE_FEATURE_RSP = 0x09,
	PDU_DATA_LLCTRL_TYPE_VERSION_IND = 0x0C,
	PDU_DATA_LLCTRL_TYPE_PER_INIT_FEAT_XCHG = 0x0E,
	PDU_DATA_LLCTRL_TYPE_PING_REQ = 0x12,
	PDU_DATA_LLCTRL_TYPE_PING_RSP = 0x13,
	PDU_DATA_LLCTRL_TYPE_LENGTH_REQ = 0x14,
	PDU_DATA_LLCTRL_TYPE_LENGTH_RSP = 0x15,
};

struct pdu_data_llctrl_conn_update_ind {
	uint8_t  win_size;
	uint16_t win_offset;
	uint16_t interval;
	uint16_t latency;
	uint16_t timeout;
	uint16_t instant;
} __packed;

struct pdu_data_llctrl_chan_map_ind {
	uint8_t  chm[PDU_CHANNEL_MAP_SIZE];
	uint16_t instant;
} __packed;

struct pdu_data_llctrl_unknown_rsp {
	uint8_t type;
} __packed;

struct pdu_data_llctrl_feature_rsp {
	uint8_t features[8];
} __packed;

struct pdu_data_llctrl_version_ind {
	uint8_t  version_number;
	uint16_t company_id;
	uint16_t sub_version_number;
} __packed;

struct pdu_data_llctrl_length_rsp {
	uint16_t max_rx_octets;
	uint16_t max_rx_time;
	uint16_t max_tx_octets;
	uint16_t max_tx_time;
} __packed;

struct pdu_data_llctrl {
	uint8_t opcode;
	union {
		struct pdu_data_llctrl_conn_update_ind conn_update_ind;
		struct pdu_data_llctrl_chan_map_ind chan_map_ind;
		struct pdu_data_llctrl_unknown_rsp unknown_rsp;
		struct pdu_data_llctrl_feature_rsp feature_rsp;
		struct pdu_data_llctrl_version_ind version_ind;
		struct pdu_data_llctrl_length_rsp length_rsp;
	} __packed;
} __packed;

struct pdu_data {
	uint8_t ll_id:2;
	uint8_t nesn:1;
	uint8_t sn:1;
	uint8_t md:1;
	uint8_t rfu:3;
	uint8_t len;
	union {
		struct pdu_data_llctrl llctrl;
		uint8_t lldata[PDU_DC_PAYLOAD_SIZE_MIN];
	} __packed;
} __packed;

/* TIMER20 @ 1 MHz: 1 tick = 1 us, 32-bit */
#define HAL_TICKER_CNTR_CLK_UNIT_FSEC 1000000000UL
#define HAL_TICKER_CNTR_MASK          0xFFFFFFFFUL
#define HAL_TICKER_FSEC_PER_USEC      1000000000UL
#define HAL_TICKER_PSEC_PER_USEC      1000000UL
#define HAL_TICKER_FSEC_PER_PSEC      1000UL

#define HAL_TICKER_US_TO_TICKS(x) (((uint32_t)(x)) & HAL_TICKER_CNTR_MASK)
#define HAL_TICKER_TICKS_TO_US(x) ((uint32_t)(x))
#define HAL_TICKER_REMAINDER(x)   (0U)


/*===========================================================================
 * 配置参数
 *===========================================================================*/

#define ADV_INTERVAL_MS  100
#define T_IFS_US         150
#define ADV_RX_TIMEOUT_US  600

#define WIN_DELAY_LEGACY            1250
#define CONN_INT_UNIT_US            1250
#define EVENT_JITTER_US             16
#define EVENT_TICKER_RES_MARGIN_US  31
#define ADDR_US_1M                  40
#define RTC0_CMP_OFFSET_MIN         3

#define ADV_NAME         "SLat"

#define RX_RAMP_US       40
#define TX_RAMP_US       40

#define RX_CHAIN_DELAY_1M_US  10
#define TX_CHAIN_DELAY_US      1

#define DPPI_CH_TIMER_CLEAR  0   /* RADIO PHYEND -> TIMER CLEAR */
#define DPPI_CH_RXEN         1   /* TIMER CC[0] -> RADIO RXEN */
#define DPPI_CH_TXEN         2   /* TIMER CC[1] -> RADIO TXEN */

#define CC_IDX_RXEN  0
#define CC_IDX_TXEN  1

#define LOCAL_SCA_PPM 50

/* L2CAP */
#define L2CAP_CID_ATT       0x0004
#define L2CAP_CID_SIG       0x0005
#define L2CAP_CID_SMP       0x0006
#define L2CAP_HDR_SIZE      4
#define L2CAP_MAX_PAYLOAD   512
#define LL_DATA_MTU_DEFAULT 27

/*===========================================================================
 * 连接参数结构体
 *===========================================================================*/
struct conn_param {
	uint8_t  access_addr[4];
	uint8_t  crc_init[3];
	uint8_t  win_size;
	uint16_t win_offset;
	uint16_t interval;
	uint16_t latency;
	uint16_t timeout;
	uint8_t  chan_map[PDU_CHANNEL_MAP_SIZE];
	uint8_t  hop;
	uint8_t  sca;
	uint8_t  chan_count;
	uint8_t  peer_addr[BDADDR_SIZE];
};

/*===========================================================================
 * 锚点追踪结构体
 *===========================================================================*/
struct anchor_tracker {
	uint32_t initial_anchor_rtc;
	uint32_t initial_anchor_us;
	uint32_t current_anchor_rtc;
	uint32_t last_rx_anchor_rtc;
	uint32_t ww_current_us;
	uint32_t ww_periodic_us;
	uint32_t ww_max_us;
	uint32_t win_size_event_us;
	uint32_t anchor_update_count;
	uint32_t consecutive_misses;
	uint32_t max_consecutive_misses;
};

/*===========================================================================
 * Slave Latency 追踪
 *===========================================================================*/
struct latency_tracker {
	uint16_t latency_max;      /* connSlaveLatency from CONNECT_IND */
	uint16_t latency_used;     /* 当前连续跳过的事件数 */
	uint32_t events_skipped;   /* 总跳过事件数 (统计) */
	uint32_t events_listened;  /* 总监听事件数 (统计) */
};

/*===========================================================================
 * L2CAP 重组缓冲区
 *===========================================================================*/
struct l2cap_reassembly {
	uint8_t  buf[L2CAP_MAX_PAYLOAD + L2CAP_HDR_SIZE];
	uint16_t expected_len;
	uint16_t received_len;
	bool     in_progress;
};

#define TX_QUEUE_SIZE  4

struct tx_frag {
	uint8_t  data[LL_DATA_MTU_DEFAULT];
	uint8_t  len;
	uint8_t  llid;
};

struct tx_queue {
	struct tx_frag frags[TX_QUEUE_SIZE];
	uint8_t head;
	uint8_t tail;
	uint8_t count;
};

/*===========================================================================
 * 全局变量声明
 *===========================================================================*/

extern const uint8_t adv_addr[BDADDR_SIZE];
extern const uint8_t adv_data[];
#define ADV_DATA_LEN 12

extern struct conn_param conn_params;

extern uint8_t tx_sn;
extern uint8_t rx_nesn;
extern uint16_t conn_event_counter;
extern uint8_t last_unmapped_chan;
extern volatile bool conn_terminated;

extern struct pdu_data tx_pdu_buf;
extern bool tx_pdu_pending;

extern struct pdu_adv pdu_adv_ind;
extern struct pdu_adv pdu_adv_rx;
extern struct pdu_data pdu_data_rx;

extern uint32_t connect_end_rtc;
extern const uint16_t sca_ppm_table[];
extern struct anchor_tracker anchor;
extern struct latency_tracker lat;

extern volatile uint32_t adv_event_count;
extern volatile uint32_t conn_event_rx_ok;
extern volatile uint32_t conn_event_rx_timeout;
extern volatile uint32_t conn_event_rx_crc_err;

extern uint32_t last_rx_aa_us;
extern uint32_t last_rx_ready_us;

extern struct l2cap_reassembly l2cap_reasm;
extern struct tx_queue data_tx_q;
extern uint32_t l2cap_rx_count;
extern uint32_t l2cap_tx_count;

#endif /* BLE_COMMON_H */
```

## src/conn.c
```c
/*
 * BLE PHY Slave Latency Demo — 连接态: Slave Latency 跳过连接事件
 *
 * 相比 07_phy_data_channel 的变化:
 *   1. 实现 Slave Latency: Slave 允许跳过最多 connSlaveLatency 个连接事件
 *   2. 跳过时仍然推进锚点 (ticks + remainder 正常累积)
 *   3. WW 在跳过期间按比例增长: ww = periodic × (latency_used + 1)
 *   4. 有数据要发或 latency 到期时必须唤醒
 *
 * SPDX-License-Identifier: Apache-2.0
 */

#include "conn.h"
#include "hal_radio.h"
#include "ll_pdu.h"
#include "l2cap.h"

/*===========================================================================
 * 判断是否可以跳过当前连接事件
 *
 * BLE Core Spec Vol 6, Part B, 4.5.2:
 *   Slave 可以不监听最多 connSlaveLatency 个连续的连接事件,
 *   但以下情况必须监听:
 *     1. 有数据要发送 (TX 队列非空 / LL Control 待回复)
 *     2. 已经连续跳过 connSlaveLatency 个事件
 *     3. 即将到达 supervision timeout 的安全边界
 *     4. MD 位指示 Master 有更多数据
 *===========================================================================*/
static bool can_skip_event(void)
{
	/* 还没用完 latency 配额 */
	if (lat.latency_used >= lat.latency_max) {
		return false;
	}

	/* 有数据要发 — 必须唤醒 */
	if (data_tx_q.count > 0 || tx_pdu_pending) {
		return false;
	}

	return true;
}

/*===========================================================================
 * 单个连接事件 (与 04 相同)
 *===========================================================================*/
static bool conn_event(uint32_t ticks_at_start, uint32_t remainder_ps,
		       uint32_t hcto_add)
{
	uint32_t ahead = (ticks_at_start - ticker_now()) &
			 HAL_TICKER_CNTR_MASK;
	if (ahead > (HAL_TICKER_CNTR_MASK >> 1) ||
	    ahead < RTC0_CMP_OFFSET_MIN) {
		(void)chan_sel_1();
		conn_event_rx_timeout++;
		conn_event_counter++;
		return false;
	}

	uint8_t chan = chan_sel_1();
	data_chan_set(chan);

	radio_irq_disable();
	radio_status_reset();
	radio_tmr_status_reset();

	radio_shorts_trx_set();

	dppi_disable_switch();

	sw_timer_cc_set(CC_IDX_TXEN, T_IFS_US - TX_RAMP_US - RX_CHAIN_DELAY_1M_US);

	sw_timer_start();

	radio_pkt_rx_set(&pdu_data_rx);


	uint32_t remainder_us = radio_tmr_start(0, ticks_at_start,
						remainder_ps);

	radio_tmr_aa_capture();
	radio_tmr_aa_save(0);

	uint32_t hcto = remainder_us + hcto_add +
			radio_rx_ready_delay_get(0, 0) +
			ADDR_US_1M +
			radio_rx_chain_delay_get(0, 0);
	radio_tmr_hcto_configure(hcto);
	radio_tmr_end_capture();

	{
		uint32_t safety = 0;
		while (NRF_RADIO->EVENTS_DISABLED == 0) {
			radio_tmr_stamp_poll();
			if (radio_hcto_expired() || ++safety > 5000000) {
				NRF_RADIO->TASKS_DISABLE = 1;
				while (NRF_RADIO->EVENTS_DISABLED == 0) {
				}
				conn_event_rx_timeout++;
				conn_event_counter++;
				return false;
			}
		}
	}
	NRF_RADIO->EVENTS_DISABLED = 0;

	if (!radio_is_done()) {
		radio_ensure_disabled();
		conn_event_rx_timeout++;
		conn_event_counter++;
		return false;
	}

	if (!radio_crc_is_valid()) {
		radio_ensure_disabled();
		conn_event_rx_crc_err++;
		conn_event_counter++;
		return false;
	}

	conn_event_rx_ok++;

	last_rx_aa_us = radio_tmr_aa_get();
	last_rx_ready_us = radio_tmr_ready_get();

	/* RX→TX */
	sw_timer_clear_compare(CC_IDX_TXEN);
	sw_timer_clear_compare(CC_IDX_RXEN);

	if (pdu_data_rx.nesn != tx_sn) {
		tx_sn = pdu_data_rx.nesn;
	}
	bool new_packet = false;
	if (pdu_data_rx.sn == rx_nesn) {
		new_packet = true;
		rx_nesn ^= 1;
	}

	tx_pdu_pending = false;
	if (new_packet && pdu_data_rx.len > 0) {
		if (pdu_data_rx.ll_id == PDU_DATA_LLID_CTRL) {
			tx_pdu_pending = handle_ll_control(&pdu_data_rx);
		} else if (pdu_data_rx.ll_id == PDU_DATA_LLID_DATA_START ||
			   pdu_data_rx.ll_id == PDU_DATA_LLID_DATA_CONTINUE) {
			bool complete = l2cap_rx_fragment(
				pdu_data_rx.ll_id,
				pdu_data_rx.lldata,
				pdu_data_rx.len);
			if (complete) {
				l2cap_process_complete();
			}
		}
	}

	if (tx_pdu_pending) {
		tx_pdu_buf.nesn = rx_nesn;
		tx_pdu_buf.sn   = tx_sn;
		radio_pkt_tx_set(&tx_pdu_buf);
	} else if (l2cap_tx_dequeue(&tx_pdu_buf)) {
		tx_pdu_buf.nesn = rx_nesn;
		tx_pdu_buf.sn   = tx_sn;
		tx_pdu_pending = true;
		radio_pkt_tx_set(&tx_pdu_buf);
	} else {
		build_empty_pdu(&tx_pdu_buf);
		radio_pkt_tx_set(&tx_pdu_buf);
	}

	dppi_enable_txen();

	radio_event_end_clear();
	NRF_RADIO->EVENTS_DISABLED = 0;

	{
		uint32_t safety = 0;
		while (NRF_RADIO->EVENTS_DISABLED == 0) {
			if (++safety > 2000000) {
				NRF_RADIO->TASKS_DISABLE = 1;
				while (NRF_RADIO->EVENTS_DISABLED == 0) {
				}
				break;
			}
		}
	}
	NRF_RADIO->EVENTS_DISABLED = 0;

	dppi_disable_switch();
	NRF_RADIO->SHORTS = 0;

	if (tx_pdu_pending) {
		tx_sn ^= 1;
	}

	conn_event_counter++;
	return true;
}

/*===========================================================================
 * 连接态主循环 — Slave Latency 演示
 *
 * ★ Slave Latency 的核心逻辑:
 *
 * 正常连接中, Slave 每个 connInterval 都必须唤醒射频监听 Master。
 * 当 connSlaveLatency > 0 时, Slave 允许"偷懒":
 *   - 最多连续跳过 connSlaveLatency 个连接事件不监听
 *   - 跳过期间锚点仍正常递推, 信道选择仍推进 (chan_sel_1)
 *   - WW 按跳过的总时间累积 (不是单个 interval)
 *   - 一旦有数据要发, 或 latency 配额用完, 必须立刻唤醒
 *
 * 省电效果:
 *   latency=0: 每 30ms 醒一次
 *   latency=4: 最多每 150ms (5×30ms) 才醒一次
 *              射频功耗降为 1/5
 *===========================================================================*/
void conn_loop(void)
{
	tx_sn = 0;
	rx_nesn = 0;
	conn_event_counter = 0;
	last_unmapped_chan = 0;
	conn_terminated = false;
	tx_pdu_pending = false;
	conn_event_rx_ok = 0;
	conn_event_rx_timeout = 0;
	conn_event_rx_crc_err = 0;

	memset(&anchor, 0, sizeof(anchor));
	memset(&lat, 0, sizeof(lat));
	l2cap_init();

	lat.latency_max = conn_params.latency;

	radio_configure_conn();
	print_connect_ind();

	printk("[LATENCY] connSlaveLatency = %u (may skip up to %u events)\n",
	       lat.latency_max, lat.latency_max);

	uint32_t conn_interval_us = (uint32_t)conn_params.interval * CONN_INT_UNIT_US;
	uint32_t win_size_us = (uint32_t)conn_params.win_size * CONN_INT_UNIT_US;

	uint16_t master_sca_ppm = sca_ppm_table[conn_params.sca & 0x07];
	uint32_t combined_sca_ppm = (uint32_t)master_sca_ppm + LOCAL_SCA_PPM;
	uint32_t ww_periodic_us = DIV_ROUND_UP(
		combined_sca_ppm * conn_interval_us, 1000000);
	uint32_t ww_max_us = (conn_interval_us >> 1) - T_IFS_US;

	anchor.ww_periodic_us = ww_periodic_us;
	anchor.ww_max_us = ww_max_us;

	uint32_t ww_event_us = 0;
	uint32_t win_size_event_us = win_size_us;
	anchor.win_size_event_us = win_size_us;

	uint32_t conn_offset_us = (uint32_t)conn_params.win_offset * CONN_INT_UNIT_US
				+ WIN_DELAY_LEGACY
				- EVENT_TICKER_RES_MARGIN_US
				- EVENT_JITTER_US
				- radio_rx_ready_delay_get(0, 0)
				- ww_periodic_us;

	uint32_t offset_ticks = HAL_TICKER_US_TO_TICKS(conn_offset_us);
	uint32_t offset_remainder_ps = HAL_TICKER_REMAINDER(conn_offset_us);

	uint32_t interval_ticks = HAL_TICKER_US_TO_TICKS(conn_interval_us);
	uint32_t interval_remainder_ps = HAL_TICKER_REMAINDER(conn_interval_us);

	uint32_t ps_per_tick = HAL_TICKER_CNTR_CLK_UNIT_FSEC /
			       HAL_TICKER_FSEC_PER_PSEC;

	uint32_t next_event_rtc = (connect_end_rtc + offset_ticks) &
				  HAL_TICKER_CNTR_MASK;
	uint32_t next_event_remainder_ps = offset_remainder_ps;

	anchor.initial_anchor_rtc = next_event_rtc;
	anchor.current_anchor_rtc = next_event_rtc;
	anchor.last_rx_anchor_rtc = connect_end_rtc;

	uint32_t supervision_timeout_us = (uint32_t)conn_params.timeout * 10000;
	uint32_t last_rx_rtc = connect_end_rtc;

	while (!conn_terminated) {
		/* ★ Slave Latency 判断: 跳过还是监听? */
		bool skip_this_event = false;

		if (lat.latency_max > 0 && can_skip_event()) {
			skip_this_event = true;
			lat.latency_used++;
			lat.events_skipped++;

			/* 跳过时: 仍需推进信道选择 (Core Spec 要求) */
			(void)chan_sel_1();
			conn_event_counter++;
		} else {
			lat.latency_used = 0;
			lat.events_listened++;
		}

		if (!skip_this_event) {
			/* ★ WW 累积: 如果之前跳过了 N 个事件,
			 * WW 需要按 (N+1) × ww_periodic 计算 */
			ww_event_us += ww_periodic_us;
			if (ww_event_us > ww_max_us) {
				ww_event_us = ww_max_us;
			}
			anchor.ww_current_us = ww_event_us;

			uint32_t hcto_add = ((EVENT_JITTER_US +
					      EVENT_TICKER_RES_MARGIN_US +
					      ww_event_us) << 1) +
					    win_size_event_us;

			anchor.current_anchor_rtc = next_event_rtc;

			bool rx_ok = conn_event(next_event_rtc,
						next_event_remainder_ps,
						hcto_add);

			if (rx_ok) {
				uint32_t actual_s2a = last_rx_aa_us -
						      last_rx_ready_us;
				int32_t drift_us = (int32_t)actual_s2a -
					(int32_t)(EVENT_JITTER_US +
						  EVENT_TICKER_RES_MARGIN_US +
						  ADDR_US_1M);

				int64_t adj_ps = (int64_t)next_event_remainder_ps +
						 (int64_t)drift_us * 1000000LL;

				while (adj_ps >= (int64_t)ps_per_tick) {
					adj_ps -= ps_per_tick;
					next_event_rtc = (next_event_rtc + 1) &
							 HAL_TICKER_CNTR_MASK;
				}
				while (adj_ps < 0) {
					adj_ps += ps_per_tick;
					next_event_rtc = (next_event_rtc - 1) &
							 HAL_TICKER_CNTR_MASK;
				}
				next_event_remainder_ps = (uint32_t)adj_ps;

				last_rx_rtc = next_event_rtc;
				anchor.last_rx_anchor_rtc = next_event_rtc;
				anchor.anchor_update_count++;
				anchor.consecutive_misses = 0;

				ww_event_us = 0;
				win_size_event_us = 0;
			} else {
				anchor.consecutive_misses++;
				if (anchor.consecutive_misses >
				    anchor.max_consecutive_misses) {
					anchor.max_consecutive_misses =
						anchor.consecutive_misses;
				}

				uint32_t elapsed_ticks =
					(next_event_rtc - last_rx_rtc) &
					HAL_TICKER_CNTR_MASK;
				uint32_t elapsed_us =
					HAL_TICKER_TICKS_TO_US(elapsed_ticks);

				if (elapsed_us >= supervision_timeout_us) {
					printk("[CONN] Supervision timeout!\n");
					break;
				}
			}
		} else {
			/* ★ 跳过的事件: WW 仍需累积 */
			ww_event_us += ww_periodic_us;
			if (ww_event_us > ww_max_us) {
				ww_event_us = ww_max_us;
			}
		}

		/* 锚点递推 (无论是否跳过, 时间都在前进) */
		next_event_rtc = (next_event_rtc + interval_ticks) &
				 HAL_TICKER_CNTR_MASK;
		next_event_remainder_ps += interval_remainder_ps;
		if (next_event_remainder_ps >= ps_per_tick) {
			next_event_remainder_ps -= ps_per_tick;
			next_event_rtc = (next_event_rtc + 1) &
					 HAL_TICKER_CNTR_MASK;
		}

		uint32_t current_event = conn_event_counter;

		if (current_event <= 10 ||
		    current_event % 50 == 0 ||
		    anchor.consecutive_misses > 3) {
			printk("[CONN] #%u %s | ww=%u lat_used=%u/%u | "
			       "rx=%u skip=%u listen=%u\n",
			       current_event,
			       skip_this_event ? "SKIP" :
			       (conn_event_rx_ok == current_event ? "OK" : "MISS"),
			       anchor.ww_current_us,
			       lat.latency_used, lat.latency_max,
			       conn_event_rx_ok,
			       lat.events_skipped, lat.events_listened);
		}
	}

	NRF_RADIO->SHORTS = 0;
	radio_irq_disable();

	printk("\n========== Connection Summary ==========\n");
	printk("  Total events:     %u\n", conn_event_counter);
	printk("  Events listened:  %u\n", lat.events_listened);
	printk("  Events skipped:   %u\n", lat.events_skipped);
	printk("  RX OK:            %u\n", conn_event_rx_ok);
	printk("  RX timeout:       %u\n", conn_event_rx_timeout);
	printk("  RX CRC error:     %u\n", conn_event_rx_crc_err);
	printk("  Anchor updates:   %u\n", anchor.anchor_update_count);
	printk("  Max consec miss:  %u\n", anchor.max_consecutive_misses);
	printk("  Slave Latency:    %u (configured)\n", lat.latency_max);
	printk("  Skip ratio:       %u/%u = %u%%\n",
	       lat.events_skipped, conn_event_counter,
	       conn_event_counter > 0 ?
	       (lat.events_skipped * 100) / conn_event_counter : 0);
	printk("=========================================\n");
}
```
