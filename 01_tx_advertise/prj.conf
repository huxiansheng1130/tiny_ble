## CMakeLists.txt
```
# SPDX-License-Identifier: Apache-2.0

cmake_minimum_required(VERSION 3.20.0)
find_package(Zephyr REQUIRED HINTS $ENV{ZEPHYR_BASE})
project(ble_phy_raw_tx)

target_sources(app PRIVATE
  src/main.c
  src/hal_radio.c
)
```

## prj.conf
```kconfig
# BLE PHY Raw TX Demo — nRF54L15
# 直接操作 RADIO，不依赖 SoftDevice / BT_LL_SW_SPLIT

CONFIG_GPIO=y
CONFIG_SERIAL=y
CONFIG_CONSOLE=y
CONFIG_UART_CONSOLE=y
CONFIG_PRINTK=y

CONFIG_BT=n

CONFIG_CLOCK_CONTROL=y
```

## boards/nrf54l15dk_nrf54l15_cpuapp.overlay
```dts
/*
 * nRF54L15：直接使用 RADIO。
 */
&radio {
	status = "okay";
};
```

## src/ble_common.h
```c
/*
 * BLE PHY Raw TX Demo — nRF54L15
 *
 * SPDX-License-Identifier: Apache-2.0
 */

#ifndef BLE_COMMON_H
#define BLE_COMMON_H

#include <zephyr/kernel.h>
#include <zephyr/sys/printk.h>
#include <zephyr/sys/byteorder.h>
#include <string.h>
#include <stdint.h>
#include <stdbool.h>
#include <soc.h>

#define BDADDR_SIZE                 6
#define PDU_AC_LEG_DATA_SIZE_MAX    31
#define PDU_AC_LEG_PAYLOAD_SIZE_MAX 37
#define PDU_AC_ACCESS_ADDR          0x8e89bed6
#define PDU_AC_CRC_IV               0x555555
#define PDU_CRC_POLYNOMIAL          0x00065b

enum pdu_adv_type {
	PDU_ADV_TYPE_ADV_IND = 0x00,
	PDU_ADV_TYPE_DIRECT_IND = 0x01,
	PDU_ADV_TYPE_NONCONN_IND = 0x02,
	PDU_ADV_TYPE_SCAN_REQ = 0x03,
	PDU_ADV_TYPE_SCAN_RSP = 0x04,
	PDU_ADV_TYPE_CONNECT_IND = 0x05,
	PDU_ADV_TYPE_SCAN_IND = 0x06,
};

struct pdu_adv_adv_ind {
	uint8_t addr[BDADDR_SIZE];
	uint8_t data[PDU_AC_LEG_DATA_SIZE_MAX];
} __packed;

struct pdu_adv {
	uint8_t type:4;
	uint8_t rfu:1;
	uint8_t chan_sel:1;
	uint8_t tx_addr:1;
	uint8_t rx_addr:1;
	uint8_t len;
	union {
		uint8_t payload[PDU_AC_LEG_PAYLOAD_SIZE_MAX];
		struct pdu_adv_adv_ind adv_ind;
	} __packed;
} __packed;

extern const uint8_t adv_addr[BDADDR_SIZE];
extern struct pdu_adv pdu;

#endif /* BLE_COMMON_H */
```

## src/hal_radio.c
```c
/*
 * BLE PHY Raw TX Demo — HAL (nRF54L15)
 *
 * 直接写 RADIO 寄存器，不依赖 Zephyr Controller HAL。
 * nRF54L15 用 PHYEND→DISABLE，没有 nRF52 的 END_DISABLE shortcut。
 *
 * SPDX-License-Identifier: Apache-2.0
 */

#include "hal_radio.h"

#include <hal/nrf_radio.h>

void hfclk_start(void)
{
	NRF_CLOCK->EVENTS_XOSTARTED = 0;
	NRF_CLOCK->TASKS_XOSTART = 1;
	while (NRF_CLOCK->EVENTS_XOSTARTED == 0) {
	}
	printk("HFCLK (HFXO) started\n");
}

void radio_configure(void)
{
	NRF_RADIO->INTENCLR00 = 0xFFFFFFFFUL;
	NRF_RADIO->INTENCLR01 = 0xFFFFFFFFUL;
	NRF_RADIO->SHORTS = 0;

	NRF_RADIO->MODE = RADIO_MODE_MODE_Ble_1Mbit << RADIO_MODE_MODE_Pos;
	NRF_RADIO->TXPOWER = RADIO_TXPOWER_TXPOWER_0dBm;

	NRF_RADIO->PCNF0 = (8UL << RADIO_PCNF0_LFLEN_Pos) |
			   (1UL << RADIO_PCNF0_S0LEN_Pos) |
			   (RADIO_PCNF0_PLEN_8bit << RADIO_PCNF0_PLEN_Pos);

	NRF_RADIO->PCNF1 = ((uint32_t)PDU_AC_LEG_PAYLOAD_SIZE_MAX << RADIO_PCNF1_MAXLEN_Pos) |
			   (0UL << RADIO_PCNF1_STATLEN_Pos) |
			   (3UL << RADIO_PCNF1_BALEN_Pos) |
			   (RADIO_PCNF1_ENDIAN_Little << RADIO_PCNF1_ENDIAN_Pos);

	NRF_RADIO->TXADDRESS = 0;
	NRF_RADIO->RXADDRESSES =
		RADIO_RXADDRESSES_ADDR0_Enabled << RADIO_RXADDRESSES_ADDR0_Pos;
	NRF_RADIO->PREFIX0 = (PDU_AC_ACCESS_ADDR >> 24) & 0xFFUL;
	NRF_RADIO->BASE0 = (PDU_AC_ACCESS_ADDR & 0x00FFFFFFUL) << 8;

	NRF_RADIO->CRCCNF = (RADIO_CRCCNF_LEN_Three << RADIO_CRCCNF_LEN_Pos) |
			    (RADIO_CRCCNF_SKIPADDR_Skip << RADIO_CRCCNF_SKIPADDR_Pos);
	NRF_RADIO->CRCPOLY = PDU_CRC_POLYNOMIAL;
	NRF_RADIO->CRCINIT = PDU_AC_CRC_IV;

	nrf_radio_fast_ramp_up_enable_set(NRF_RADIO, true);

	printk("Radio configured: BLE 1M (nRF54L15)\n");
}

void send_on_channel(uint32_t channel)
{
	uint32_t freq;

	switch (channel) {
	case 37: freq = 2;  break;
	case 38: freq = 26; break;
	case 39: freq = 80; break;
	default: return;
	}

	NRF_RADIO->FREQUENCY = freq;
	NRF_RADIO->DATAWHITE = RADIO_DATAWHITE_ResetValue | channel;
	NRF_RADIO->PCNF1 |= RADIO_PCNF1_WHITEEN_Msk;
	NRF_RADIO->PACKETPTR = (uint32_t)&pdu;

	NRF_RADIO->EVENTS_READY = 0;
	NRF_RADIO->EVENTS_ADDRESS = 0;
	NRF_RADIO->EVENTS_END = 0;
	NRF_RADIO->EVENTS_PHYEND = 0;
	NRF_RADIO->EVENTS_DISABLED = 0;

	NRF_RADIO->SHORTS = RADIO_SHORTS_READY_START_Msk |
			    RADIO_SHORTS_PHYEND_DISABLE_Msk;

	NRF_RADIO->TASKS_TXEN = 1;

	while (NRF_RADIO->EVENTS_DISABLED == 0) {
	}

	NRF_RADIO->SHORTS = 0;
}
```
