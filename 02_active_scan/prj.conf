## CMakeLists.txt
```
# SPDX-License-Identifier: Apache-2.0

cmake_minimum_required(VERSION 3.20.0)
find_package(Zephyr REQUIRED HINTS $ENV{ZEPHYR_BASE})
project(ble_phy_tifs_sw)

target_sources(app PRIVATE
  src/main.c
  src/hal_radio.c
  src/ll_pdu.c
  src/adv.c
)
```

## prj.conf
```kconfig
# BLE PHY SW TIFS Demo — nRF54L15
# TIMER10 + DPPIC10 软件 TIFS (不依赖 SoftDevice / BT_LL_SW_SPLIT)

CONFIG_GPIO=y
CONFIG_SERIAL=y
CONFIG_CONSOLE=y
CONFIG_UART_CONSOLE=y
CONFIG_PRINTK=y

# 直接操作 RADIO，关闭蓝牙协议栈
CONFIG_BT=n

# HFCLK / onoff
CONFIG_CLOCK_CONTROL=y
```

## boards/nrf52dk_nrf52832.overlay
```dts
/*
 * NCS 默认启用 SoftDevice Controller (nordic,bt-hci-sdc)。
 * 本 Demo 依赖 Zephyr 开源 LL (BT_LL_SW_SPLIT) 的 radio HAL，
 * 因此切回 zephyr,bt-hci-ll-sw-split。
 */
/ {
	chosen {
		zephyr,bt-hci = &bt_hci_controller;
	};
};

&bt_hci_sdc {
	status = "disabled";
};

&bt_hci_controller {
	status = "okay";
};
```

## boards/nrf54l15dk_nrf54l15_cpuapp.overlay
```dts
/*
 * 启用与 RADIO 同域的 TIMER10 / DPPIC10，供软件 TIFS 使用。
 */
&timer10 {
	status = "okay";
};

&dppic10 {
	status = "okay";
};

&radio {
	status = "okay";
};
```

## src/main.c
```c
/*
 * BLE PHY 软件 TIFS (SW TIFS) Demo — nRF54L15
 *
 * 使用 TIMER10 + DPPIC10 硬件互联实现软件 TIFS 切换
 * (对应 nRF52 上 TIMER1 + PPI 的教学路径)。
 *
 * SPDX-License-Identifier: Apache-2.0
 */

#include "ble_common.h"
#include "hal_radio.h"
#include "ll_pdu.h"
#include "adv.h"

/* MSB=0xC0 → Random Static Address（与 tiny_ble 一致） */
const uint8_t adv_addr[BDADDR_SIZE] = {
	0x11, 0x22, 0x33, 0x44, 0x55, 0xC0
};

struct pdu_adv pdu_adv_ind __aligned(4);
struct pdu_adv pdu_scan_rsp __aligned(4);
struct pdu_adv pdu_rx_buf __aligned(4);

volatile uint32_t adv_event_count;
volatile uint32_t scan_req_count;
volatile uint32_t scan_rsp_count;

int main(void)
{
	printk("\n=== BLE PHY SW TIFS Demo (nRF54L15) ===\n");
	printk("广播名: %s  (搜这个)\n", ADV_NAME);
	printk("使用 TIMER10 + DPPIC10 实现软件 TIFS 定时\n\n");

	hfclk_start();
	radio_configure();
	sw_switch_timer_configure();
	dppi_configure();
	build_adv_ind_pdu();
	build_scan_rsp_pdu();

	adv_init();
	adv_start();

	printk("Advertising started (SW TIFS: TIMER10 + DPPI)\n\n");

	while (1) {
		k_sleep(K_SECONDS(5));
		printk("[Main] alive — adv: %u, scan_req: %u, scan_rsp: %u\n",
		       adv_event_count, scan_req_count, scan_rsp_count);
	}

	return 0;
}
```

## src/adv.c
```c
/*
 * BLE PHY 软件 TIFS Demo — 广播状态机 (nRF54L15: TIMER10 + DPPI)
 *
 * SPDX-License-Identifier: Apache-2.0
 */

#include "adv.h"
#include "hal_radio.h"
#include "ll_pdu.h"

static struct k_timer adv_timer;
static struct k_work  adv_work;

static void adv_on_channel(uint32_t channel)
{
	radio_set_channel(channel);

	/*==============================================================
	 * 第 1 阶段: TX ADV_IND
	 *==============================================================*/
	radio_packetptr_set(&pdu_adv_ind);
	radio_status_reset();
	radio_shorts_trx_set();

	/*
	 * CC[0] TX→RX: T_IFS - RX_RAMP = 110μs
	 * CC[1] RX→TX: T_IFS - TX_RAMP - RX_CHAIN = 100μs
	 */
	sw_timer_cc_set(CC_IDX_RXEN, T_IFS_US - RX_RAMP_US);
	sw_timer_cc_set(CC_IDX_TXEN, T_IFS_US - TX_RAMP_US - RX_CHAIN_DELAY_US);

	dppi_disable_switch();
	sw_timer_start();
	radio_tx_enable();

	/* 与 tiny_ble 相同：等 DISABLED（SHORTS: PHYEND→DISABLE） */
	while (!radio_event_disabled_check()) {
	}
	radio_event_disabled_clear();
	radio_event_end_clear();

	/*==============================================================
	 * 第 1.5 阶段: TX→RX (SW TIFS)
	 *==============================================================*/
	sw_timer_clear_compare(CC_IDX_RXEN);
	sw_timer_clear_compare(CC_IDX_TXEN);

	radio_packetptr_set(&pdu_rx_buf);
	radio_shorts_trx_set();
	dppi_enable_rxen();

	/*==============================================================
	 * 第 2 阶段: RX SCAN_REQ
	 *==============================================================*/
	radio_event_address_clear();

	{
		uint32_t start = k_cycle_get_32();
		uint32_t timeout = k_us_to_cyc_ceil32(RX_TIMEOUT_US);

		while (!radio_event_address_check()) {
			if ((k_cycle_get_32() - start) > timeout) {
				radio_ensure_disabled();
				return;
			}
		}
	}

	dppi_disable_switch();
	dppi_enable_txen();

	while (!radio_event_end_check()) {
	}
	radio_event_end_clear();

	sw_timer_clear_compare(CC_IDX_TXEN);
	sw_timer_clear_compare(CC_IDX_RXEN);

	if (!radio_crc_ok() || !validate_scan_req(&pdu_rx_buf)) {
		radio_ensure_disabled();
		return;
	}

	scan_req_count++;

	/*==============================================================
	 * 第 3 阶段: TX SCAN_RSP (DPPI 自动 TXEN)
	 *==============================================================*/
	radio_packetptr_set(&pdu_scan_rsp);
	radio_shorts_trx_set();
	radio_event_end_clear();
	radio_event_disabled_clear();

	while (!radio_event_disabled_check()) {
	}

	dppi_disable_switch();
	radio_shorts_clear();
	scan_rsp_count++;
}

void adv_worker(struct k_work *work)
{
	ARG_UNUSED(work);

	adv_on_channel(37);
	adv_on_channel(38);
	adv_on_channel(39);

	adv_event_count++;

	if (adv_event_count <= 3 || adv_event_count % 10 == 0) {
		printk("[SW-TIFS] events: %u | SCAN_REQ rx: %u | SCAN_RSP tx: %u\n",
		       adv_event_count, scan_req_count, scan_rsp_count);
	}
}

void adv_timer_expiry(struct k_timer *timer)
{
	ARG_UNUSED(timer);
	k_work_submit(&adv_work);
}

void adv_init(void)
{
	k_work_init(&adv_work, adv_worker);
	k_timer_init(&adv_timer, adv_timer_expiry, NULL);
}

void adv_start(void)
{
	k_timer_start(&adv_timer, K_NO_WAIT, K_MSEC(ADV_INTERVAL_MS));
}
```

## src/ble_common.h
```c
/*
 * BLE PHY 软件 TIFS Demo — 公共类型、常量与全局变量声明
 * 目标平台: nRF54L15 (TIMER10 + DPPIC10)
 *
 * SPDX-License-Identifier: Apache-2.0
 */

#ifndef BLE_COMMON_H
#define BLE_COMMON_H

#include <zephyr/kernel.h>
#include <zephyr/sys/printk.h>
#include <zephyr/sys/byteorder.h>
#include <string.h>
#include <stdbool.h>
#include <stdint.h>

/*===========================================================================
 * Legacy Advertising PDU (精简自 Zephyr controller pdu.h)
 *===========================================================================*/

#define BDADDR_SIZE                 6
#define PDU_AC_LEG_DATA_SIZE_MAX    31
#define PDU_AC_LEG_PAYLOAD_SIZE_MAX 37
#define PDU_AC_ACCESS_ADDR          0x8e89bed6
#define PDU_AC_CRC_IV               0x555555
#define PDU_CRC_POLYNOMIAL          0x00065b

enum pdu_adv_type {
	PDU_ADV_TYPE_ADV_IND = 0x00,
	PDU_ADV_TYPE_DIRECT_IND = 0x01,
	PDU_ADV_TYPE_NONCONN_IND = 0x02,
	PDU_ADV_TYPE_SCAN_REQ = 0x03,
	PDU_ADV_TYPE_SCAN_RSP = 0x04,
	PDU_ADV_TYPE_CONNECT_IND = 0x05,
	PDU_ADV_TYPE_SCAN_IND = 0x06,
};

struct pdu_adv_adv_ind {
	uint8_t addr[BDADDR_SIZE];
	uint8_t data[PDU_AC_LEG_DATA_SIZE_MAX];
} __packed;

struct pdu_adv_scan_rsp {
	uint8_t addr[BDADDR_SIZE];
	uint8_t data[PDU_AC_LEG_DATA_SIZE_MAX];
} __packed;

struct pdu_adv_scan_req {
	uint8_t scan_addr[BDADDR_SIZE];
	uint8_t adv_addr[BDADDR_SIZE];
} __packed;

struct pdu_adv {
	uint8_t type:4;
	uint8_t rfu:1;
	uint8_t chan_sel:1;
	uint8_t tx_addr:1;
	uint8_t rx_addr:1;
	uint8_t len;
	union {
		uint8_t payload[PDU_AC_LEG_PAYLOAD_SIZE_MAX];
		struct pdu_adv_adv_ind adv_ind;
		struct pdu_adv_scan_req scan_req;
		struct pdu_adv_scan_rsp scan_rsp;
	} __packed;
} __packed;

/*===========================================================================
 * 配置参数
 *===========================================================================*/

#define ADV_INTERVAL_MS  100

/* T_IFS: BLE 规范帧间间隔 = 150 μs */
#define T_IFS_US         150

/* nRF54L Fast Ramp-Up ≈ 40 μs */
#define RX_RAMP_US       40
#define TX_RAMP_US       40

/* RX chain delay (μs): 空口最后 bit → END/PHYEND ≈ 10 μs (1M PHY) */
#define RX_CHAIN_DELAY_US  10

#define RX_TIMEOUT_US    500
#define ADV_NAME         "ZephyrRaw"

/*===========================================================================
 * DPPI / TIMER 通道分配 (RADIO 同域: TIMER10 + DPPIC10)
 *===========================================================================*/
#define DPPI_CH_TIMER_CLEAR  0   /* RADIO PHYEND → TIMER CLEAR */
#define DPPI_CH_RXEN         1   /* TIMER CC[0] → RADIO RXEN */
#define DPPI_CH_TXEN         2   /* TIMER CC[1] → RADIO TXEN */

#define CC_IDX_RXEN  0
#define CC_IDX_TXEN  1

/*===========================================================================
 * 全局变量声明 (定义在 main.c)
 *===========================================================================*/

extern const uint8_t adv_addr[BDADDR_SIZE];

extern struct pdu_adv pdu_adv_ind;
extern struct pdu_adv pdu_scan_rsp;
extern struct pdu_adv pdu_rx_buf;

extern volatile uint32_t adv_event_count;
extern volatile uint32_t scan_req_count;
extern volatile uint32_t scan_rsp_count;

#endif /* BLE_COMMON_H */
```

## src/hal_radio.c
```c
/*
 * BLE PHY 软件 TIFS Demo — HAL
 *
 * 目标板: nRF54L15DK (TIMER10 + DPPIC10)
 * 若误选 nRF52 会给出明确编译错误。
 *
 * SPDX-License-Identifier: Apache-2.0
 */

#include "hal_radio.h"

#include <soc.h>
#include <hal/nrf_radio.h>
#include <hal/nrf_timer.h>
#include <hal/nrf_clock.h>
#include <hal/nrf_dppi.h>

#define SW_TIMER   NRF_TIMER10
#define SW_DPPIC   NRF_DPPIC10

/* HFXO=32MHz, PRESCALER=5 → 1MHz (1μs) */
#define SW_TIMER_PRESCALER  5

/*===========================================================================
 * 启动 HFXO —— 与 tiny_ble 相同
 *===========================================================================*/
void hfclk_start(void)
{
	NRF_CLOCK->EVENTS_XOSTARTED = 0;
	NRF_CLOCK->TASKS_XOSTART = 1;
	while (NRF_CLOCK->EVENTS_XOSTARTED == 0) {
	}
	printk("HFCLK (HFXO) started\n");
}

/*===========================================================================
 * 配置 RADIO —— 寄存器写法对齐 tiny_ble
 *===========================================================================*/
void radio_configure(void)
{
	NRF_RADIO->INTENCLR00 = 0xFFFFFFFFUL;
	NRF_RADIO->INTENCLR01 = 0xFFFFFFFFUL;
	NRF_RADIO->SHORTS = 0;

	NRF_RADIO->MODE = RADIO_MODE_MODE_Ble_1Mbit << RADIO_MODE_MODE_Pos;
	NRF_RADIO->TXPOWER = RADIO_TXPOWER_TXPOWER_0dBm;

	NRF_RADIO->PCNF0 = (8UL << RADIO_PCNF0_LFLEN_Pos) |
			   (1UL << RADIO_PCNF0_S0LEN_Pos) |
			   (RADIO_PCNF0_PLEN_8bit << RADIO_PCNF0_PLEN_Pos);

	NRF_RADIO->PCNF1 = ((uint32_t)PDU_AC_LEG_PAYLOAD_SIZE_MAX << RADIO_PCNF1_MAXLEN_Pos) |
			   (0UL << RADIO_PCNF1_STATLEN_Pos) |
			   (3UL << RADIO_PCNF1_BALEN_Pos) |
			   (RADIO_PCNF1_ENDIAN_Little << RADIO_PCNF1_ENDIAN_Pos);

	NRF_RADIO->TXADDRESS = 0;
	NRF_RADIO->RXADDRESSES =
		RADIO_RXADDRESSES_ADDR0_Enabled << RADIO_RXADDRESSES_ADDR0_Pos;
	NRF_RADIO->PREFIX0 = (PDU_AC_ACCESS_ADDR >> 24) & 0xFFUL;
	NRF_RADIO->BASE0 = (PDU_AC_ACCESS_ADDR & 0x00FFFFFFUL) << 8;

	NRF_RADIO->CRCCNF = (RADIO_CRCCNF_LEN_Three << RADIO_CRCCNF_LEN_Pos) |
			    (RADIO_CRCCNF_SKIPADDR_Skip << RADIO_CRCCNF_SKIPADDR_Pos);
	NRF_RADIO->CRCPOLY = PDU_CRC_POLYNOMIAL;
	NRF_RADIO->CRCINIT = PDU_AC_CRC_IV;

	nrf_radio_fast_ramp_up_enable_set(NRF_RADIO, true);

	printk("Radio configured: BLE 1M (nRF54L15 / tiny_ble style)\n");
}

void sw_switch_timer_configure(void)
{
	nrf_timer_task_trigger(SW_TIMER, NRF_TIMER_TASK_STOP);
	nrf_timer_task_trigger(SW_TIMER, NRF_TIMER_TASK_CLEAR);
	nrf_timer_int_disable(SW_TIMER, 0xFFFFFFFFUL);

	for (int i = 0; i < 8; i++) {
		nrf_timer_event_clear(SW_TIMER, nrf_timer_compare_event_get(i));
	}

	nrf_timer_mode_set(SW_TIMER, NRF_TIMER_MODE_TIMER);
	nrf_timer_bit_width_set(SW_TIMER, NRF_TIMER_BIT_WIDTH_16);
	nrf_timer_prescaler_set(SW_TIMER, SW_TIMER_PRESCALER);

	printk("SW_SWITCH_TIMER (TIMER10) configured: 1MHz, 16-bit\n");
}

void dppi_configure(void)
{
	nrf_radio_publish_set(NRF_RADIO, NRF_RADIO_EVENT_PHYEND, DPPI_CH_TIMER_CLEAR);
	nrf_timer_subscribe_set(SW_TIMER, NRF_TIMER_TASK_CLEAR, DPPI_CH_TIMER_CLEAR);

	nrf_timer_publish_set(SW_TIMER, nrf_timer_compare_event_get(CC_IDX_RXEN),
			      DPPI_CH_RXEN);
	nrf_radio_subscribe_set(NRF_RADIO, NRF_RADIO_TASK_RXEN, DPPI_CH_RXEN);

	nrf_timer_publish_set(SW_TIMER, nrf_timer_compare_event_get(CC_IDX_TXEN),
			      DPPI_CH_TXEN);
	nrf_radio_subscribe_set(NRF_RADIO, NRF_RADIO_TASK_TXEN, DPPI_CH_TXEN);

	nrf_dppi_channels_enable(SW_DPPIC, BIT(DPPI_CH_TIMER_CLEAR));
	nrf_dppi_channels_disable(SW_DPPIC, BIT(DPPI_CH_RXEN) | BIT(DPPI_CH_TXEN));

	printk("DPPI configured (PHYEND→CLEAR, CC→RXEN/TXEN)\n");
}

void radio_ensure_disabled(void)
{
	NRF_RADIO->SHORTS = 0;
	nrf_dppi_channels_disable(SW_DPPIC, BIT(DPPI_CH_RXEN) | BIT(DPPI_CH_TXEN));
	nrf_timer_task_trigger(SW_TIMER, NRF_TIMER_TASK_STOP);

	if (NRF_RADIO->STATE != RADIO_STATE_STATE_Disabled) {
		NRF_RADIO->EVENTS_DISABLED = 0;
		NRF_RADIO->TASKS_DISABLE = 1;
		while (NRF_RADIO->EVENTS_DISABLED == 0) {
		}
	}
}

void radio_set_channel(uint8_t ble_channel)
{
	uint32_t freq_off;

	switch (ble_channel) {
	case 37: freq_off = 2;  break;
	case 38: freq_off = 26; break;
	case 39: freq_off = 80; break;
	default: return;
	}

	NRF_RADIO->FREQUENCY = freq_off;
	NRF_RADIO->DATAWHITE = RADIO_DATAWHITE_ResetValue | ble_channel;
	NRF_RADIO->PCNF1 |= RADIO_PCNF1_WHITEEN_Msk;
}

void radio_packetptr_set(void *pkt)
{
	NRF_RADIO->PACKETPTR = (uint32_t)pkt;
}

void radio_status_reset(void)
{
	NRF_RADIO->EVENTS_READY = 0;
	NRF_RADIO->EVENTS_ADDRESS = 0;
	NRF_RADIO->EVENTS_END = 0;
	NRF_RADIO->EVENTS_PHYEND = 0;
	NRF_RADIO->EVENTS_DISABLED = 0;
}

void radio_shorts_trx_set(void)
{
	NRF_RADIO->SHORTS = RADIO_SHORTS_READY_START_Msk |
			    RADIO_SHORTS_PHYEND_DISABLE_Msk;
}

void radio_shorts_clear(void)
{
	NRF_RADIO->SHORTS = 0;
}

void radio_tx_enable(void)
{
	NRF_RADIO->TASKS_TXEN = 1;
}

bool radio_crc_ok(void)
{
	return (NRF_RADIO->CRCSTATUS & RADIO_CRCSTATUS_CRCSTATUS_Msk) ==
	       (RADIO_CRCSTATUS_CRCSTATUS_CRCOk << RADIO_CRCSTATUS_CRCSTATUS_Pos);
}

void sw_timer_cc_set(uint8_t cc_idx, uint32_t us)
{
	nrf_timer_cc_set(SW_TIMER, (nrf_timer_cc_channel_t)cc_idx, us);
}

void sw_timer_start(void)
{
	nrf_timer_task_trigger(SW_TIMER, NRF_TIMER_TASK_CLEAR);
	nrf_timer_task_trigger(SW_TIMER, NRF_TIMER_TASK_START);
}

void sw_timer_stop(void)
{
	nrf_timer_task_trigger(SW_TIMER, NRF_TIMER_TASK_STOP);
}

void sw_timer_clear_compare(uint8_t cc_idx)
{
	nrf_timer_event_clear(SW_TIMER, nrf_timer_compare_event_get(cc_idx));
	(void)nrf_timer_event_check(SW_TIMER, nrf_timer_compare_event_get(cc_idx));
}

void dppi_enable_rxen(void)
{
	nrf_dppi_channels_enable(SW_DPPIC, BIT(DPPI_CH_RXEN));
}

void dppi_enable_txen(void)
{
	nrf_dppi_channels_enable(SW_DPPIC, BIT(DPPI_CH_TXEN));
}

void dppi_disable_switch(void)
{
	nrf_dppi_channels_disable(SW_DPPIC, BIT(DPPI_CH_RXEN) | BIT(DPPI_CH_TXEN));
}

bool radio_event_end_check(void)
{
	return NRF_RADIO->EVENTS_PHYEND != 0;
}

void radio_event_end_clear(void)
{
	NRF_RADIO->EVENTS_PHYEND = 0;
}

bool radio_event_disabled_check(void)
{
	return NRF_RADIO->EVENTS_DISABLED != 0;
}

void radio_event_disabled_clear(void)
{
	NRF_RADIO->EVENTS_DISABLED = 0;
}

bool radio_event_address_check(void)
{
	return NRF_RADIO->EVENTS_ADDRESS != 0;
}

void radio_event_address_clear(void)
{
	NRF_RADIO->EVENTS_ADDRESS = 0;
}
```

## src/hal_radio.h
```c
/*
 * BLE PHY 软件 TIFS Demo — HAL: Radio / TIMER10 / DPPIC10
 *
 * SPDX-License-Identifier: Apache-2.0
 */

#ifndef HAL_RADIO_INIT_H
#define HAL_RADIO_INIT_H

#include "ble_common.h"

void hfclk_start(void);
void radio_configure(void);
void sw_switch_timer_configure(void);
void dppi_configure(void);
void radio_ensure_disabled(void);

/* 运行时辅助 */
void radio_set_channel(uint8_t ble_channel);
void radio_packetptr_set(void *pkt);
void radio_status_reset(void);
void radio_shorts_trx_set(void);
void radio_shorts_clear(void);
void radio_tx_enable(void);
bool radio_crc_ok(void);

void sw_timer_cc_set(uint8_t cc_idx, uint32_t us);
void sw_timer_start(void);
void sw_timer_stop(void);
void sw_timer_clear_compare(uint8_t cc_idx);

void dppi_enable_rxen(void);
void dppi_enable_txen(void);
void dppi_disable_switch(void);

bool radio_event_end_check(void);
void radio_event_end_clear(void);
bool radio_event_disabled_check(void);
void radio_event_disabled_clear(void);
bool radio_event_address_check(void);
void radio_event_address_clear(void);

#endif /* HAL_RADIO_INIT_H */
```

## src/ll_pdu.c
```c
/*
 * BLE PHY 软件 TIFS Demo — 链路层 PDU 构造与校验
 *
 * SPDX-License-Identifier: Apache-2.0
 */

#include "ll_pdu.h"

/*===========================================================================
 * AD 数据
 *===========================================================================*/
/* 与桌面 tiny_ble 同名，方便手机搜索确认 */
static const uint8_t adv_data[] = {
	0x02, 0x01, 0x06,
	0x0A, 0x09, 'Z', 'e', 'p', 'h', 'y', 'r', 'R', 'a', 'w'
};
#define ADV_DATA_LEN sizeof(adv_data)

static const uint8_t scan_rsp_data[] = {
	0x0A, 0x09, 'Z', 'e', 'p', 'h', 'y', 'r', 'R', 'a', 'w'
};
#define SCAN_RSP_DATA_LEN sizeof(scan_rsp_data)

/*===========================================================================
 * 构造 PDU
 *===========================================================================*/
void build_adv_ind_pdu(void)
{
	memset(&pdu_adv_ind, 0, sizeof(pdu_adv_ind));
	pdu_adv_ind.type    = PDU_ADV_TYPE_ADV_IND;
	pdu_adv_ind.tx_addr = 1;
	pdu_adv_ind.rx_addr = 0;
	pdu_adv_ind.len     = BDADDR_SIZE + ADV_DATA_LEN;
	memcpy(pdu_adv_ind.adv_ind.addr, adv_addr, BDADDR_SIZE);
	memcpy(pdu_adv_ind.adv_ind.data, adv_data, ADV_DATA_LEN);
	printk("ADV_IND PDU built: type=0x%02X len=%d\n",
	       pdu_adv_ind.type, pdu_adv_ind.len);
}

void build_scan_rsp_pdu(void)
{
	memset(&pdu_scan_rsp, 0, sizeof(pdu_scan_rsp));
	pdu_scan_rsp.type    = PDU_ADV_TYPE_SCAN_RSP;
	pdu_scan_rsp.tx_addr = 1;
	pdu_scan_rsp.rx_addr = 0;
	pdu_scan_rsp.len     = BDADDR_SIZE + SCAN_RSP_DATA_LEN;
	memcpy(pdu_scan_rsp.scan_rsp.addr, adv_addr, BDADDR_SIZE);
	memcpy(pdu_scan_rsp.scan_rsp.data, scan_rsp_data, SCAN_RSP_DATA_LEN);
	printk("SCAN_RSP PDU built: type=0x%02X len=%d\n",
	       pdu_scan_rsp.type, pdu_scan_rsp.len);
}

/*===========================================================================
 * 验证 SCAN_REQ
 *===========================================================================*/
bool validate_scan_req(const struct pdu_adv *rx_pdu)
{
	if (rx_pdu->type != PDU_ADV_TYPE_SCAN_REQ) {
		return false;
	}
	if (rx_pdu->len != sizeof(struct pdu_adv_scan_req)) {
		return false;
	}
	if (memcmp(rx_pdu->scan_req.adv_addr, adv_addr, BDADDR_SIZE) != 0) {
		return false;
	}
	return true;
}
```
