## CMakeLists.txt
```
# SPDX-License-Identifier: Apache-2.0

cmake_minimum_required(VERSION 3.20.0)
find_package(Zephyr REQUIRED HINTS $ENV{ZEPHYR_BASE})

project(ble_phy_hci)

target_sources(app PRIVATE
  src/main.c
  src/hal_radio.c
  src/adv.c
  src/conn.c
  src/ll_pdu.c
  src/l2cap.c
  src/hci.c
)
```

## prj.conf
```kconfig
# BLE PHY HCI Transport Demo — nRF54L15
# TIMER10 + DPPIC10 软件 TIFS，直接操作 RADIO (不依赖 BT_LL_SW_SPLIT)
# HCI 占用 UART，调试输出走 RTT

CONFIG_USE_SEGGER_RTT=y
CONFIG_RTT_CONSOLE=y
CONFIG_UART_CONSOLE=n

CONFIG_GPIO=y
CONFIG_SERIAL=y
CONFIG_CONSOLE=y
CONFIG_PRINTK=y

CONFIG_BT=n

CONFIG_CLOCK_CONTROL=y

# UART for HCI H4
CONFIG_UART_INTERRUPT_DRIVEN=y
```

## boards/nrf54l15dk_nrf54l15_cpuapp.overlay
```dts
/*
 * 启用与 RADIO 同域的 TIMER10 / DPPIC10，以及连接时基 TIMER20。
 */
&timer10 {
	status = "okay";
};

&dppic10 {
	status = "okay";
};

&radio {
	status = "okay";
};

&timer20 {
	status = "okay";
};
```

## src/main.c
```c
/*
 * BLE PHY HCI Transport (HCI H4 UART) Demo
 *
 * 本 Demo 在 09_phy_ll_procedures 基础上增加了 HCI H4 传输层:
 *
 * ┌─────────────────────────────────────────────────────────────────┐
 * │  HCI (Host Controller Interface) 是什么?                       │
 * │                                                                 │
 * │  BLE 的分层架构中, Host 和 Controller 可以运行在不同芯片上。   │
 * │  HCI 定义了它们之间的通信规范:                                 │
 * │    - Command:  Host → Controller (如 Reset, 设置广播参数)      │
 * │    - Event:    Controller → Host (如 连接完成, 广播报告)       │
 * │    - ACL Data: 双向 (应用数据)                                 │
 * │                                                                 │
 * │  H4 是 HCI 在 UART 上最简单的封装格式:                         │
 * │    每个包前面加一个字节的 Packet Indicator:                     │
 * │    0x01 = Command, 0x02 = ACL, 0x04 = Event                   │
 * │                                                                 │
 * │  本 Demo 可以通过 Linux btattach 命令驱动:                     │
 * │    sudo btattach -B /dev/ttyUSB0 -S 115200 -P h4              │
 * │    sudo hciconfig hci0 up                                      │
 * │    hcitool lescan                                               │
 * └─────────────────────────────────────────────────────────────────┘
 *
 * SPDX-License-Identifier: Apache-2.0
 */

#include "ble_common.h"
#include "hal_radio.h"
#include "ll_pdu.h"
#include "adv.h"
#include "conn.h"
#include "l2cap.h"
#include "hci.h"

/*===========================================================================
 * 全局变量定义
 *===========================================================================*/

const uint8_t adv_addr[BDADDR_SIZE] = {
	0x11, 0x22, 0x33, 0x44, 0x55, 0x66
};

/* ★ 在 HCI 模式下, adv_data 由 Host 通过 LE_Set_Advertising_Data 设置
 * 默认提供一组初始数据, 以便无 Host 时也能广播 */
uint8_t adv_data[ADV_DATA_LEN_MAX] = {
	0x02, 0x01, 0x06,
	0x08, 0x09, 'H', 'C', 'I', '-', 'B', 'L', 'E'
};
uint8_t adv_data_len = 12;

struct conn_param conn_params;

uint8_t tx_sn;
uint8_t rx_nesn;
uint16_t conn_event_counter;
uint8_t last_unmapped_chan;
volatile bool conn_terminated;

struct pdu_data tx_pdu_buf __aligned(4);
bool tx_pdu_pending;

struct pdu_adv pdu_adv_ind __aligned(4);
struct pdu_adv pdu_adv_rx __aligned(4);
struct pdu_data pdu_data_rx __aligned(4);

uint32_t connect_end_rtc;
const uint16_t sca_ppm_table[] = {500, 250, 150, 100, 75, 50, 30, 20};

struct anchor_tracker anchor;
struct latency_tracker lat;

struct ll_proc_conn_update proc_conn_update;
struct ll_proc_chan_map_update proc_chan_map;

volatile uint32_t adv_event_count;
volatile uint32_t conn_event_rx_ok;
volatile uint32_t conn_event_rx_timeout;
volatile uint32_t conn_event_rx_crc_err;

uint32_t last_rx_aa_us;
uint32_t last_rx_ready_us;

struct l2cap_reassembly l2cap_reasm;
struct tx_queue data_tx_q;
uint32_t l2cap_rx_count;
uint32_t l2cap_tx_count;

/* HCI 状态 */
volatile bool hci_adv_enabled;
volatile bool hci_connected;

int main(void)
{
	printk("\n");
	printk("===================================================\n");
	printk("  BLE PHY HCI Transport Demo\n");
	printk("  HCI H4 UART 传输层 + 空中接口\n");
	printk("===================================================\n");
	printk("Device: %s  Addr: %02X:%02X:%02X:%02X:%02X:%02X\n",
	       ADV_NAME,
	       adv_addr[5], adv_addr[4], adv_addr[3],
	       adv_addr[2], adv_addr[1], adv_addr[0]);
	printk("\n");

	hfclk_start();
	rtc0_start();
	sw_switch_timer_configure();
	dppi_configure();

	/* ★ 初始化 HCI UART 传输层 */
	h4_init();

	printk("[HCI] Waiting for Host commands on UART...\n");
	printk("[HCI] (Auto-advertise enabled as fallback)\n");

	/*
	 * ★ 主循环:
	 *
	 * 两种模式并存:
	 *   1. HCI 驱动模式: Host 通过 UART 发 HCI_LE_Set_Advertise_Enable
	 *      来启动广播, 一切由 Host 控制
	 *   2. 自动广播模式: 如果 Host 未发命令, 自动开始广播作为 fallback
	 *
	 * 无论哪种模式, 连接建立后都会:
	 *   - 通过 UART 向 Host 发送 LE Connection Complete Event
	 *   - 空中收到的数据转发为 HCI ACL Data
	 *   - Host 发来的 HCI ACL Data 在空中发出
	 */
	bool auto_adv_started = false;
	uint32_t boot_time = k_uptime_get_32();

	while (1) {
		/* 持续处理 HCI 命令 */
		h4_process();

		/*
		 * 如果 Host 在 3 秒内没有发 LE_Set_Advertise_Enable,
		 * 自动开始广播 (方便无 Host 时测试)
		 */
		bool should_adv = hci_adv_enabled;
		if (!should_adv && !auto_adv_started &&
		    (k_uptime_get_32() - boot_time) > 3000) {
			printk("[HCI] No Host detected, auto-advertising...\n");
			auto_adv_started = true;
			should_adv = true;
		}
		if (!should_adv && auto_adv_started) {
			should_adv = true;
		}

		if (!should_adv) {
			k_msleep(10);
			continue;
		}

		printk("[STATE] Entering ADVERTISING state\n");
		adv_event_count = 0;

		radio_configure_adv();
		build_adv_ind_pdu();

		bool connected = false;
		while (!connected) {
			h4_process();

			/* 如果 Host 禁用了广播, 停止 */
			if (!hci_adv_enabled && !auto_adv_started) {
				break;
			}

			int ret = adv_event();
			if (ret == 1) {
				connected = true;
			} else {
				k_msleep(ADV_INTERVAL_MS);
			}
		}

		if (connected) {
			conn_loop();

			printk("[STATE] Connection lost, returning...\n\n");
			radio_ensure_disabled();
			auto_adv_started = false;
			boot_time = k_uptime_get_32();
			k_msleep(100);
		}
	}

	return 0;
}
```

## src/adv.c
```c
/*
 * BLE PHY Data Channel Demo — 广播态: ADV_IND 发送与 CONNECT_IND 接收
 * (与 06_phy_anchor 相同)
 *
 * SPDX-License-Identifier: Apache-2.0
 */

#include "adv.h"
#include "hal_radio.h"
#include "ll_pdu.h"

int adv_on_channel(uint32_t channel)
{
	uint32_t freq;

	switch (channel) {
	case 37: freq = 2;  break;
	case 38: freq = 26; break;
	case 39: freq = 80; break;
	default: return 0;
	}

	radio_freq_chan_set(freq);
	radio_whiten_iv_set(channel);

	radio_irq_disable();

	radio_pkt_tx_set(&pdu_adv_ind);
	radio_status_reset();
	NRF_RADIO->EVENTS_DISABLED = 0;
	NRF_RADIO->EVENTS_ADDRESS = 0;

	radio_shorts_trx_set();

	sw_timer_cc_set(CC_IDX_RXEN, T_IFS_US - RX_RAMP_US);
	dppi_disable_switch();

	sw_timer_start();

	NRF_RADIO->TASKS_TXEN = 1;

	while (!radio_event_end_check()) {
	}
	radio_event_end_clear();

	sw_timer_clear_compare(CC_IDX_RXEN);

	radio_pkt_rx_set(&pdu_adv_rx);
	dppi_enable_rxen();

	while (NRF_RADIO->EVENTS_DISABLED == 0) {
	}
	NRF_RADIO->EVENTS_DISABLED = 0;

	NRF_RADIO->EVENTS_ADDRESS = 0;

	uint32_t timeout_loops = ADV_RX_TIMEOUT_US * 16;
	bool rx_done = false;

	while (timeout_loops > 0) {
		if (NRF_RADIO->EVENTS_DISABLED) {
			rx_done = true;
			break;
		}
		timeout_loops--;
	}

	uint32_t rx_end_rtc = ticker_now() & HAL_TICKER_CNTR_MASK;

	if (!rx_done) {
		radio_ensure_disabled();
		return 0;
	}

	dppi_disable_switch();
	NRF_RADIO->SHORTS = 0;

	if (!radio_crc_is_valid()) {
		return 0;
	}

	if (validate_connect_ind(&pdu_adv_rx)) {
		connect_end_rtc = rx_end_rtc;
		parse_connect_ind(&pdu_adv_rx);
		return 1;
	}

	return 0;
}

int adv_event(void)
{
	static const uint32_t adv_channels[] = {37, 38, 39};

	for (int i = 0; i < 3; i++) {
		int ret = adv_on_channel(adv_channels[i]);
		if (ret == 1) {
			return 1;
		}
	}

	adv_event_count++;
	if (adv_event_count <= 3 || adv_event_count % 50 == 0) {
		printk("[ADV] events: %u (waiting for connection...)\n",
		       adv_event_count);
	}
	return 0;
}
```

## src/ble_common.h
```c
/*
 * BLE PHY HCI Demo — 公共类型、常量与全局变量声明
 *
 * 相比 09_phy_ll_procedures 的变化:
 *   1. 新增 HCI 相关常量 (Opcode, Event Code, Packet Indicator)
 *   2. 新增 HCI RX/TX 缓冲区大小定义
 *   3. 新增 HCI 状态机状态枚举
 *
 * SPDX-License-Identifier: Apache-2.0
 */

#ifndef BLE_COMMON_H
#define BLE_COMMON_H

#include <zephyr/kernel.h>
#include <zephyr/sys/printk.h>
#include <zephyr/sys/byteorder.h>
#include <string.h>
#include <stdint.h>
#include <stdbool.h>
#include <soc.h>

/*
 * nRF54L15 没有 nRF52 的 PPI / RTC0，也不使用 Zephyr LL 内部头文件。
 * 硬件路径与 02_active_scan 相同: TIMER10 + DPPIC10 做软件 TIFS，
 * TIMER20 (1 MHz) 做连接时基。
 */

#define BDADDR_SIZE                 6
#define PDU_AC_LEG_DATA_SIZE_MAX    31
#define PDU_AC_LEG_PAYLOAD_SIZE_MAX 37
#define PDU_DC_PAYLOAD_SIZE_MIN     27
#define PDU_AC_ACCESS_ADDR          0x8e89bed6
#define PDU_AC_CRC_IV               0x555555
#define PDU_CRC_POLYNOMIAL          0x00065b
#define PDU_CHANNEL_MAP_SIZE        5

enum pdu_adv_type {
	PDU_ADV_TYPE_ADV_IND = 0x00,
	PDU_ADV_TYPE_DIRECT_IND = 0x01,
	PDU_ADV_TYPE_NONCONN_IND = 0x02,
	PDU_ADV_TYPE_SCAN_REQ = 0x03,
	PDU_ADV_TYPE_SCAN_RSP = 0x04,
	PDU_ADV_TYPE_CONNECT_IND = 0x05,
	PDU_ADV_TYPE_SCAN_IND = 0x06,
};

struct pdu_adv_adv_ind {
	uint8_t addr[BDADDR_SIZE];
	uint8_t data[PDU_AC_LEG_DATA_SIZE_MAX];
} __packed;

struct pdu_adv_connect_ind {
	uint8_t init_addr[BDADDR_SIZE];
	uint8_t adv_addr[BDADDR_SIZE];
	struct {
		uint8_t  access_addr[4];
		uint8_t  crc_init[3];
		uint8_t  win_size;
		uint16_t win_offset;
		uint16_t interval;
		uint16_t latency;
		uint16_t timeout;
		uint8_t  chan_map[PDU_CHANNEL_MAP_SIZE];
		uint8_t  hop:5;
		uint8_t  sca:3;
	} __packed;
} __packed;

struct pdu_adv {
	uint8_t type:4;
	uint8_t rfu:1;
	uint8_t chan_sel:1;
	uint8_t tx_addr:1;
	uint8_t rx_addr:1;
	uint8_t len;
	union {
		uint8_t payload[PDU_AC_LEG_PAYLOAD_SIZE_MAX];
		struct pdu_adv_adv_ind adv_ind;
		struct pdu_adv_connect_ind connect_ind;
	} __packed;
} __packed;

enum pdu_data_llid {
	PDU_DATA_LLID_RESV = 0x00,
	PDU_DATA_LLID_DATA_CONTINUE = 0x01,
	PDU_DATA_LLID_DATA_START = 0x02,
	PDU_DATA_LLID_CTRL = 0x03,
};

enum pdu_data_llctrl_type {
	PDU_DATA_LLCTRL_TYPE_CONN_UPDATE_IND = 0x00,
	PDU_DATA_LLCTRL_TYPE_CHAN_MAP_IND = 0x01,
	PDU_DATA_LLCTRL_TYPE_TERMINATE_IND = 0x02,
	PDU_DATA_LLCTRL_TYPE_UNKNOWN_RSP = 0x07,
	PDU_DATA_LLCTRL_TYPE_FEATURE_REQ = 0x08,
	PDU_DATA_LLCTRL_TYPE_FEATURE_RSP = 0x09,
	PDU_DATA_LLCTRL_TYPE_VERSION_IND = 0x0C,
	PDU_DATA_LLCTRL_TYPE_PER_INIT_FEAT_XCHG = 0x0E,
	PDU_DATA_LLCTRL_TYPE_PING_REQ = 0x12,
	PDU_DATA_LLCTRL_TYPE_PING_RSP = 0x13,
	PDU_DATA_LLCTRL_TYPE_LENGTH_REQ = 0x14,
	PDU_DATA_LLCTRL_TYPE_LENGTH_RSP = 0x15,
};

struct pdu_data_llctrl_conn_update_ind {
	uint8_t  win_size;
	uint16_t win_offset;
	uint16_t interval;
	uint16_t latency;
	uint16_t timeout;
	uint16_t instant;
} __packed;

struct pdu_data_llctrl_chan_map_ind {
	uint8_t  chm[PDU_CHANNEL_MAP_SIZE];
	uint16_t instant;
} __packed;

struct pdu_data_llctrl_unknown_rsp {
	uint8_t type;
} __packed;

struct pdu_data_llctrl_feature_rsp {
	uint8_t features[8];
} __packed;

struct pdu_data_llctrl_version_ind {
	uint8_t  version_number;
	uint16_t company_id;
	uint16_t sub_version_number;
} __packed;

struct pdu_data_llctrl_length_rsp {
	uint16_t max_rx_octets;
	uint16_t max_rx_time;
	uint16_t max_tx_octets;
	uint16_t max_tx_time;
} __packed;

struct pdu_data_llctrl {
	uint8_t opcode;
	union {
		struct pdu_data_llctrl_conn_update_ind conn_update_ind;
		struct pdu_data_llctrl_chan_map_ind chan_map_ind;
		struct pdu_data_llctrl_unknown_rsp unknown_rsp;
		struct pdu_data_llctrl_feature_rsp feature_rsp;
		struct pdu_data_llctrl_version_ind version_ind;
		struct pdu_data_llctrl_length_rsp length_rsp;
	} __packed;
} __packed;

struct pdu_data {
	uint8_t ll_id:2;
	uint8_t nesn:1;
	uint8_t sn:1;
	uint8_t md:1;
	uint8_t rfu:3;
	uint8_t len;
	union {
		struct pdu_data_llctrl llctrl;
		uint8_t lldata[PDU_DC_PAYLOAD_SIZE_MIN];
	} __packed;
} __packed;

/* TIMER20 @ 1 MHz: 1 tick = 1 us, 32-bit */
#define HAL_TICKER_CNTR_CLK_UNIT_FSEC 1000000000UL
#define HAL_TICKER_CNTR_MASK          0xFFFFFFFFUL
#define HAL_TICKER_FSEC_PER_USEC      1000000000UL
#define HAL_TICKER_PSEC_PER_USEC      1000000UL
#define HAL_TICKER_FSEC_PER_PSEC      1000UL

#define HAL_TICKER_US_TO_TICKS(x) (((uint32_t)(x)) & HAL_TICKER_CNTR_MASK)
#define HAL_TICKER_TICKS_TO_US(x) ((uint32_t)(x))
#define HAL_TICKER_REMAINDER(x)   (0U)

/*===========================================================================
 * 配置参数
 *===========================================================================*/

#define ADV_INTERVAL_MS  100
#define T_IFS_US         150
#define ADV_RX_TIMEOUT_US  600

#define WIN_DELAY_LEGACY            1250
#define CONN_INT_UNIT_US            1250
#define EVENT_JITTER_US             16
#define EVENT_TICKER_RES_MARGIN_US  31
#define ADDR_US_1M                  40
#define RTC0_CMP_OFFSET_MIN         3

#define ADV_NAME         "HCI-BLE"

#define RX_RAMP_US       40
#define TX_RAMP_US       40

#define RX_CHAIN_DELAY_1M_US  10
#define TX_CHAIN_DELAY_US      1

/* RADIO 同域: TIMER10 + DPPIC10 */
#define DPPI_CH_TIMER_CLEAR  0
#define DPPI_CH_RXEN         1
#define DPPI_CH_TXEN         2

#define CC_IDX_RXEN  0
#define CC_IDX_TXEN  1

#define LOCAL_SCA_PPM 50

/* L2CAP */
#define L2CAP_CID_ATT       0x0004
#define L2CAP_CID_SIG       0x0005
#define L2CAP_CID_SMP       0x0006
#define L2CAP_HDR_SIZE      4
#define L2CAP_MAX_PAYLOAD   512
#define LL_DATA_MTU_DEFAULT 27

/*===========================================================================
 * HCI 常量
 *===========================================================================*/

/* H4 Packet Indicators */
#define HCI_H4_CMD          0x01
#define HCI_H4_ACL          0x02
#define HCI_H4_EVT          0x04

/* HCI Event Codes */
#define HCI_EVT_DISCONNECT_COMPLETE  0x05
#define HCI_EVT_CMD_COMPLETE         0x0E
#define HCI_EVT_CMD_STATUS           0x0F
#define HCI_EVT_NUM_COMPLETED_PKTS   0x13
#define HCI_EVT_LE_META              0x3E

/* LE Meta Subevent Codes */
#define HCI_LE_SUBEVENT_CONN_COMPLETE  0x01

/* HCI Command OpCodes (OGF | OCF) */
#define HCI_OP_RESET                    0x0C03
#define HCI_OP_SET_EVENT_MASK           0x0C01
#define HCI_OP_READ_LOCAL_VERSION       0x1001
#define HCI_OP_READ_LOCAL_COMMANDS      0x1002
#define HCI_OP_READ_LOCAL_FEATURES      0x1003
#define HCI_OP_READ_BD_ADDR             0x1009
#define HCI_OP_LE_SET_EVENT_MASK        0x2001
#define HCI_OP_LE_READ_BUFFER_SIZE      0x2002
#define HCI_OP_LE_READ_LOCAL_FEATURES   0x2003
#define HCI_OP_LE_SET_ADV_PARAM         0x2006
#define HCI_OP_LE_READ_ADV_TX_POWER     0x2007
#define HCI_OP_LE_SET_ADV_DATA          0x2008
#define HCI_OP_LE_SET_ADV_ENABLE        0x200A
#define HCI_OP_LE_SET_SCAN_PARAM        0x200B
#define HCI_OP_LE_SET_SCAN_ENABLE       0x200C
#define HCI_OP_LE_READ_WHITE_LIST_SIZE  0x200F
#define HCI_OP_LE_READ_SUPP_STATES      0x201C

/* ACL */
#define HCI_ACL_HDR_SIZE   4
#define HCI_ACL_MAX_DATA   256  /* 简化上限 */

/* 连接句柄 (本 Demo 只支持 1 条连接, 固定句柄 0x0000) */
#define HCI_CONN_HANDLE   0x0000

/*===========================================================================
 * 连接参数结构体
 *===========================================================================*/
struct conn_param {
	uint8_t  access_addr[4];
	uint8_t  crc_init[3];
	uint8_t  win_size;
	uint16_t win_offset;
	uint16_t interval;
	uint16_t latency;
	uint16_t timeout;
	uint8_t  chan_map[PDU_CHANNEL_MAP_SIZE];
	uint8_t  hop;
	uint8_t  sca;
	uint8_t  chan_count;
	uint8_t  peer_addr[BDADDR_SIZE];
};

struct anchor_tracker {
	uint32_t initial_anchor_rtc;
	uint32_t initial_anchor_us;
	uint32_t current_anchor_rtc;
	uint32_t last_rx_anchor_rtc;
	uint32_t ww_current_us;
	uint32_t ww_periodic_us;
	uint32_t ww_max_us;
	uint32_t win_size_event_us;
	uint32_t anchor_update_count;
	uint32_t consecutive_misses;
	uint32_t max_consecutive_misses;
};

struct latency_tracker {
	uint16_t latency_max;
	uint16_t latency_used;
	uint32_t events_skipped;
	uint32_t events_listened;
};

struct ll_proc_conn_update {
	bool     pending;
	uint16_t instant;
	uint8_t  win_size;
	uint16_t win_offset;
	uint16_t interval;
	uint16_t latency;
	uint16_t timeout;
};

struct ll_proc_chan_map_update {
	bool     pending;
	uint16_t instant;
	uint8_t  chan_map[PDU_CHANNEL_MAP_SIZE];
};

/*===========================================================================
 * L2CAP
 *===========================================================================*/
struct l2cap_reassembly {
	uint8_t  buf[L2CAP_MAX_PAYLOAD + L2CAP_HDR_SIZE];
	uint16_t expected_len;
	uint16_t received_len;
	bool     in_progress;
};

#define TX_QUEUE_SIZE  4

struct tx_frag {
	uint8_t  data[LL_DATA_MTU_DEFAULT];
	uint8_t  len;
	uint8_t  llid;
};

struct tx_queue {
	struct tx_frag frags[TX_QUEUE_SIZE];
	uint8_t head;
	uint8_t tail;
	uint8_t count;
};

/*===========================================================================
 * 全局变量声明
 *===========================================================================*/

extern const uint8_t adv_addr[BDADDR_SIZE];
extern uint8_t adv_data[];
extern uint8_t adv_data_len;
#define ADV_DATA_LEN_MAX 31

extern struct conn_param conn_params;

extern uint8_t tx_sn;
extern uint8_t rx_nesn;
extern uint16_t conn_event_counter;
extern uint8_t last_unmapped_chan;
extern volatile bool conn_terminated;

extern struct pdu_data tx_pdu_buf;
extern bool tx_pdu_pending;

extern struct pdu_adv pdu_adv_ind;
extern struct pdu_adv pdu_adv_rx;
extern struct pdu_data pdu_data_rx;

extern uint32_t connect_end_rtc;
extern const uint16_t sca_ppm_table[];
extern struct anchor_tracker anchor;
extern struct latency_tracker lat;

extern struct ll_proc_conn_update proc_conn_update;
extern struct ll_proc_chan_map_update proc_chan_map;

extern volatile uint32_t adv_event_count;
extern volatile uint32_t conn_event_rx_ok;
extern volatile uint32_t conn_event_rx_timeout;
extern volatile uint32_t conn_event_rx_crc_err;

extern uint32_t last_rx_aa_us;
extern uint32_t last_rx_ready_us;

extern struct l2cap_reassembly l2cap_reasm;
extern struct tx_queue data_tx_q;
extern uint32_t l2cap_rx_count;
extern uint32_t l2cap_tx_count;

/* HCI 状态 */
extern volatile bool hci_adv_enabled;
extern volatile bool hci_connected;

#endif /* BLE_COMMON_H */
```

## src/conn.c
```c
/*
 * BLE PHY HCI Demo — 连接态: HCI ACL 数据桥接
 *
 * 相比 09_phy_ll_procedures 的核心变化:
 *
 *   1. 空中收到的 L2CAP 数据不再做 echo loopback,
 *      而是通过 hci_send_acl_data() 作为 HCI ACL Data 上报给 Host
 *
 *   2. Host 通过 UART 发来的 HCI ACL Data,
 *      通过 l2cap_tx_enqueue() 送入 TX 队列在空中发出
 *
 *   3. 连接建立时发送 LE Connection Complete Event
 *      连接断开时发送 Disconnection Complete Event
 *
 * SPDX-License-Identifier: Apache-2.0
 */

#include "conn.h"
#include "hal_radio.h"
#include "ll_pdu.h"
#include "l2cap.h"
#include "hci.h"

/*===========================================================================
 * Instant 检查 (与 06 相同)
 *===========================================================================*/
static bool instant_passed(uint16_t instant)
{
	uint16_t diff = instant - conn_event_counter;
	return (diff > 0x7FFF) && (diff != 0);
}

static bool check_apply_conn_update(uint32_t *conn_interval_us,
				    uint32_t *interval_ticks,
				    uint32_t *interval_remainder_ps,
				    uint32_t *supervision_timeout_us,
				    uint32_t combined_sca_ppm)
{
	if (!proc_conn_update.pending) {
		return false;
	}

	if (conn_event_counter != proc_conn_update.instant) {
		if (instant_passed(proc_conn_update.instant)) {
			printk("[LL] ERROR: Connection Update instant passed!\n");
			conn_terminated = true;
		}
		return false;
	}

	printk("[LL] ★ Connection Update at event #%u\n", conn_event_counter);

	conn_params.win_size   = proc_conn_update.win_size;
	conn_params.win_offset = proc_conn_update.win_offset;
	conn_params.interval   = proc_conn_update.interval;
	conn_params.latency    = proc_conn_update.latency;
	conn_params.timeout    = proc_conn_update.timeout;

	lat.latency_max = conn_params.latency;
	lat.latency_used = 0;

	*conn_interval_us = (uint32_t)conn_params.interval * CONN_INT_UNIT_US;
	*interval_ticks = HAL_TICKER_US_TO_TICKS(*conn_interval_us);
	*interval_remainder_ps = HAL_TICKER_REMAINDER(*conn_interval_us);
	*supervision_timeout_us = (uint32_t)conn_params.timeout * 10000;

	anchor.ww_periodic_us = DIV_ROUND_UP(
		combined_sca_ppm * (*conn_interval_us), 1000000);
	anchor.ww_max_us = ((*conn_interval_us) >> 1) - T_IFS_US;
	anchor.win_size_event_us =
		(uint32_t)proc_conn_update.win_size * CONN_INT_UNIT_US;

	proc_conn_update.pending = false;
	return true;
}

static bool check_apply_chan_map_update(void)
{
	if (!proc_chan_map.pending) {
		return false;
	}

	if (conn_event_counter != proc_chan_map.instant) {
		if (instant_passed(proc_chan_map.instant)) {
			printk("[LL] ERROR: Channel Map instant passed!\n");
			conn_terminated = true;
		}
		return false;
	}

	uint8_t new_count = count_ones(proc_chan_map.chan_map,
				       PDU_CHANNEL_MAP_SIZE);
	printk("[LL] ★ Channel Map Update at event #%u (count=%u)\n",
	       conn_event_counter, new_count);

	memcpy(conn_params.chan_map, proc_chan_map.chan_map,
	       PDU_CHANNEL_MAP_SIZE);
	conn_params.chan_count = new_count;

	proc_chan_map.pending = false;
	return true;
}

static bool can_skip_event(void)
{
	if (lat.latency_used >= lat.latency_max) {
		return false;
	}
	if (data_tx_q.count > 0 || tx_pdu_pending) {
		return false;
	}
	if (proc_conn_update.pending || proc_chan_map.pending) {
		return false;
	}
	/* ★ HCI ACL 数据等待发送也不能跳过 */
	if (hci_acl_tx_pending()) {
		return false;
	}
	return true;
}

/*===========================================================================
 * 单个连接事件
 *===========================================================================*/
static bool conn_event(uint32_t ticks_at_start, uint32_t remainder_ps,
		       uint32_t hcto_add)
{
	uint32_t ahead = (ticks_at_start - ticker_now()) &
			 HAL_TICKER_CNTR_MASK;
	if (ahead > (HAL_TICKER_CNTR_MASK >> 1) ||
	    ahead < RTC0_CMP_OFFSET_MIN) {
		(void)chan_sel_1();
		conn_event_rx_timeout++;
		conn_event_counter++;
		return false;
	}

	uint8_t chan = chan_sel_1();
	data_chan_set(chan);

	radio_irq_disable();
	radio_status_reset();
	radio_tmr_status_reset();

	radio_shorts_trx_set();

	dppi_disable_switch();

	sw_timer_cc_set(CC_IDX_TXEN,
			T_IFS_US - TX_RAMP_US - RX_CHAIN_DELAY_1M_US);

	sw_timer_start();

	radio_pkt_rx_set(&pdu_data_rx);

	uint32_t remainder_us = radio_tmr_start(0, ticks_at_start,
						remainder_ps);

	radio_tmr_aa_capture();
	radio_tmr_aa_save(0);

	uint32_t hcto = remainder_us + hcto_add +
			radio_rx_ready_delay_get(0, 0) +
			ADDR_US_1M +
			radio_rx_chain_delay_get(0, 0);
	radio_tmr_hcto_configure(hcto);
	radio_tmr_end_capture();

	{
		uint32_t safety = 0;
		while (NRF_RADIO->EVENTS_DISABLED == 0) {
			radio_tmr_stamp_poll();
			if (radio_hcto_expired() || ++safety > 5000000) {
				NRF_RADIO->TASKS_DISABLE = 1;
				while (NRF_RADIO->EVENTS_DISABLED == 0) {
				}
				break;
			}
		}
	}
	NRF_RADIO->EVENTS_DISABLED = 0;

	if (!radio_is_done()) {
		radio_ensure_disabled();
		conn_event_rx_timeout++;
		conn_event_counter++;
		return false;
	}

	if (!radio_crc_is_valid()) {
		radio_ensure_disabled();
		conn_event_rx_crc_err++;
		conn_event_counter++;
		return false;
	}

	conn_event_rx_ok++;

	last_rx_aa_us = radio_tmr_aa_get();
	last_rx_ready_us = radio_tmr_ready_get();

	/* RX→TX */
	sw_timer_clear_compare(CC_IDX_TXEN);
	sw_timer_clear_compare(CC_IDX_RXEN);

	if (pdu_data_rx.nesn != tx_sn) {
		tx_sn = pdu_data_rx.nesn;
	}
	bool new_packet = false;
	if (pdu_data_rx.sn == rx_nesn) {
		new_packet = true;
		rx_nesn ^= 1;
	}

	tx_pdu_pending = false;
	if (new_packet && pdu_data_rx.len > 0) {
		if (pdu_data_rx.ll_id == PDU_DATA_LLID_CTRL) {
			tx_pdu_pending = handle_ll_control(&pdu_data_rx);
		} else if (pdu_data_rx.ll_id == PDU_DATA_LLID_DATA_START ||
			   pdu_data_rx.ll_id == PDU_DATA_LLID_DATA_CONTINUE) {
			/*
			 * ★ HCI 桥接: 空中收到的数据 → 转发给 Host
			 *
			 * 之前 Demo 是 L2CAP echo loopback,
			 * 现在改为通过 HCI ACL Data 上报给 UART Host。
			 */
			bool is_start = (pdu_data_rx.ll_id ==
					 PDU_DATA_LLID_DATA_START);
			hci_send_acl_data(pdu_data_rx.lldata,
					  pdu_data_rx.len,
					  is_start);
		}
	}

	/* ★ HCI 桥接: Host 发来的 ACL 数据 → 送入 TX 队列以空中发出 */
	if (!tx_pdu_pending && hci_acl_tx_pending()) {
		uint8_t acl_buf[HCI_ACL_MAX_DATA];
		uint16_t acl_len = hci_acl_tx_get(acl_buf, sizeof(acl_buf));
		if (acl_len > 0) {
			l2cap_tx_enqueue(acl_buf, acl_len);
			hci_send_num_completed_pkts(1);
		}
	}

	if (tx_pdu_pending) {
		tx_pdu_buf.nesn = rx_nesn;
		tx_pdu_buf.sn   = tx_sn;
		radio_pkt_tx_set(&tx_pdu_buf);
	} else if (l2cap_tx_dequeue(&tx_pdu_buf)) {
		tx_pdu_buf.nesn = rx_nesn;
		tx_pdu_buf.sn   = tx_sn;
		tx_pdu_pending = true;
		radio_pkt_tx_set(&tx_pdu_buf);
	} else {
		build_empty_pdu(&tx_pdu_buf);
		radio_pkt_tx_set(&tx_pdu_buf);
	}

	dppi_enable_txen();

	radio_event_end_clear();
	NRF_RADIO->EVENTS_DISABLED = 0;

	{
		uint32_t safety = 0;
		while (NRF_RADIO->EVENTS_DISABLED == 0) {
			if (++safety > 2000000) {
				NRF_RADIO->TASKS_DISABLE = 1;
				while (NRF_RADIO->EVENTS_DISABLED == 0) {
				}
				break;
			}
		}
	}
	NRF_RADIO->EVENTS_DISABLED = 0;

	dppi_disable_switch();
	NRF_RADIO->SHORTS = 0;

	if (tx_pdu_pending) {
		tx_sn ^= 1;
	}

	conn_event_counter++;
	return true;
}

/*===========================================================================
 * 连接态主循环 — HCI ACL 桥接
 *===========================================================================*/
void conn_loop(void)
{
	tx_sn = 0;
	rx_nesn = 0;
	conn_event_counter = 0;
	last_unmapped_chan = 0;
	conn_terminated = false;
	tx_pdu_pending = false;
	conn_event_rx_ok = 0;
	conn_event_rx_timeout = 0;
	conn_event_rx_crc_err = 0;

	memset(&anchor, 0, sizeof(anchor));
	memset(&lat, 0, sizeof(lat));
	memset(&proc_conn_update, 0, sizeof(proc_conn_update));
	memset(&proc_chan_map, 0, sizeof(proc_chan_map));
	l2cap_init();

	lat.latency_max = conn_params.latency;
	hci_connected = true;

	radio_configure_conn();
	print_connect_ind();

	/* ★ 向 Host 发送 LE Connection Complete Event */
	hci_send_le_conn_complete();

	uint32_t conn_interval_us = (uint32_t)conn_params.interval * CONN_INT_UNIT_US;
	uint32_t win_size_us = (uint32_t)conn_params.win_size * CONN_INT_UNIT_US;

	uint16_t master_sca_ppm = sca_ppm_table[conn_params.sca & 0x07];
	uint32_t combined_sca_ppm = (uint32_t)master_sca_ppm + LOCAL_SCA_PPM;
	uint32_t ww_periodic_us = DIV_ROUND_UP(
		combined_sca_ppm * conn_interval_us, 1000000);
	uint32_t ww_max_us = (conn_interval_us >> 1) - T_IFS_US;

	anchor.ww_periodic_us = ww_periodic_us;
	anchor.ww_max_us = ww_max_us;

	uint32_t ww_event_us = 0;
	uint32_t win_size_event_us = win_size_us;
	anchor.win_size_event_us = win_size_us;

	uint32_t conn_offset_us = (uint32_t)conn_params.win_offset * CONN_INT_UNIT_US
				+ WIN_DELAY_LEGACY
				- EVENT_TICKER_RES_MARGIN_US
				- EVENT_JITTER_US
				- radio_rx_ready_delay_get(0, 0)
				- ww_periodic_us;

	uint32_t offset_ticks = HAL_TICKER_US_TO_TICKS(conn_offset_us);
	uint32_t offset_remainder_ps = HAL_TICKER_REMAINDER(conn_offset_us);

	uint32_t interval_ticks = HAL_TICKER_US_TO_TICKS(conn_interval_us);
	uint32_t interval_remainder_ps = HAL_TICKER_REMAINDER(conn_interval_us);

	uint32_t ps_per_tick = HAL_TICKER_CNTR_CLK_UNIT_FSEC /
			       HAL_TICKER_FSEC_PER_PSEC;

	uint32_t next_event_rtc = (connect_end_rtc + offset_ticks) &
				  HAL_TICKER_CNTR_MASK;
	uint32_t next_event_remainder_ps = offset_remainder_ps;

	anchor.initial_anchor_rtc = next_event_rtc;
	anchor.current_anchor_rtc = next_event_rtc;
	anchor.last_rx_anchor_rtc = connect_end_rtc;

	uint32_t supervision_timeout_us = (uint32_t)conn_params.timeout * 10000;
	uint32_t last_rx_rtc = connect_end_rtc;

	while (!conn_terminated) {
		/* 处理 HCI 命令 (非阻塞) */
		h4_process();

		/* Instant 检查 */
		(void)check_apply_conn_update(&conn_interval_us,
					      &interval_ticks,
					      &interval_remainder_ps,
					      &supervision_timeout_us,
					      combined_sca_ppm);
		(void)check_apply_chan_map_update();

		/* Slave Latency */
		bool skip_this_event = false;
		if (lat.latency_max > 0 && can_skip_event()) {
			skip_this_event = true;
			lat.latency_used++;
			lat.events_skipped++;
			(void)chan_sel_1();
			conn_event_counter++;
		} else {
			lat.latency_used = 0;
			lat.events_listened++;
		}

		if (!skip_this_event) {
			ww_event_us += ww_periodic_us;
			if (ww_event_us > ww_max_us) {
				ww_event_us = ww_max_us;
			}
			anchor.ww_current_us = ww_event_us;

			uint32_t hcto_add = ((EVENT_JITTER_US +
					      EVENT_TICKER_RES_MARGIN_US +
					      ww_event_us) << 1) +
					    win_size_event_us;

			anchor.current_anchor_rtc = next_event_rtc;

			bool rx_ok = conn_event(next_event_rtc,
						next_event_remainder_ps,
						hcto_add);

			if (rx_ok) {
				uint32_t actual_s2a = last_rx_aa_us -
						      last_rx_ready_us;
				int32_t drift_us = (int32_t)actual_s2a -
					(int32_t)(EVENT_JITTER_US +
						  EVENT_TICKER_RES_MARGIN_US +
						  ADDR_US_1M);

				int64_t adj_ps = (int64_t)next_event_remainder_ps +
						 (int64_t)drift_us * 1000000LL;

				while (adj_ps >= (int64_t)ps_per_tick) {
					adj_ps -= ps_per_tick;
					next_event_rtc = (next_event_rtc + 1) &
							 HAL_TICKER_CNTR_MASK;
				}
				while (adj_ps < 0) {
					adj_ps += ps_per_tick;
					next_event_rtc = (next_event_rtc - 1) &
							 HAL_TICKER_CNTR_MASK;
				}
				next_event_remainder_ps = (uint32_t)adj_ps;

				last_rx_rtc = next_event_rtc;
				anchor.last_rx_anchor_rtc = next_event_rtc;
				anchor.anchor_update_count++;
				anchor.consecutive_misses = 0;

				ww_event_us = 0;
				win_size_event_us = 0;
			} else {
				anchor.consecutive_misses++;
				if (anchor.consecutive_misses >
				    anchor.max_consecutive_misses) {
					anchor.max_consecutive_misses =
						anchor.consecutive_misses;
				}

				uint32_t elapsed_ticks =
					(next_event_rtc - last_rx_rtc) &
					HAL_TICKER_CNTR_MASK;
				uint32_t elapsed_us =
					HAL_TICKER_TICKS_TO_US(elapsed_ticks);

				if (elapsed_us >= supervision_timeout_us) {
					printk("[CONN] Supervision timeout!\n");
					break;
				}
			}
		} else {
			ww_event_us += ww_periodic_us;
			if (ww_event_us > ww_max_us) {
				ww_event_us = ww_max_us;
			}
		}

		next_event_rtc = (next_event_rtc + interval_ticks) &
				 HAL_TICKER_CNTR_MASK;
		next_event_remainder_ps += interval_remainder_ps;
		if (next_event_remainder_ps >= ps_per_tick) {
			next_event_remainder_ps -= ps_per_tick;
			next_event_rtc = (next_event_rtc + 1) &
					 HAL_TICKER_CNTR_MASK;
		}
	}

	NRF_RADIO->SHORTS = 0;
	radio_irq_disable();

	/* ★ 向 Host 发送 Disconnection Complete Event */
	hci_connected = false;
	hci_send_disconnect_complete(0x13); /* Remote User Terminated */

	printk("\n========== Connection Summary (HCI) ==========\n");
	printk("  Total events:     %u\n", conn_event_counter);
	printk("  RX OK:            %u\n", conn_event_rx_ok);
	printk("  RX timeout:       %u\n", conn_event_rx_timeout);
	printk("  RX CRC error:     %u\n", conn_event_rx_crc_err);
	printk("================================================\n");
}
```
