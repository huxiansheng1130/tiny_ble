## CMakeLists.txt
```
# SPDX-License-Identifier: Apache-2.0

cmake_minimum_required(VERSION 3.20.0)
find_package(Zephyr REQUIRED HINTS $ENV{ZEPHYR_BASE})
project(ble_phy_data_channel)

target_sources(app PRIVATE
  src/main.c
  src/hal_radio.c
  src/ll_pdu.c
  src/adv.c
  src/conn.c
  src/l2cap.c
)
```

## prj.conf
```kconfig
# BLE PHY Data Channel Demo
# 演示 L2CAP 基本帧的分片、重组与回环

CONFIG_GPIO=y
CONFIG_SERIAL=y
CONFIG_CONSOLE=y
CONFIG_UART_CONSOLE=y
CONFIG_PRINTK=y

# 直接操作 RADIO (nRF54L15)
CONFIG_BT=n
CONFIG_CLOCK_CONTROL=y
```

## src/main.c
```c
/*
 * BLE PHY Data Channel (数据信道) Demo
 *
 * 本 Demo 在 06_phy_anchor 的基础上增加了 L2CAP 数据通道功能:
 *
 * ┌─────────────────────────────────────────────────────────────────┐
 * │  新增功能                                                       │
 * │                                                                 │
 * │  1. LL Data PDU 收发: 区分 LLID=Start/Continue/Control         │
 * │  2. L2CAP 帧重组: 将多个分片合并为完整的 L2CAP Basic Frame     │
 * │  3. L2CAP 帧分片: 将完整帧拆分为 ≤27 字节的 PDU 分片          │
 * │  4. Echo 回环: 收到的 L2CAP 数据原样发回, 验证数据通道工作     │
 * └─────────────────────────────────────────────────────────────────┘
 *
 * L2CAP Basic Frame 格式:
 *
 *   字节偏移  字段           说明
 *   [0..1]    Length (LE)    Payload 长度 (不含此 4 字节 header)
 *   [2..3]    Channel ID     0x0004=ATT, 0x0005=L2CAP Signaling, 0x0006=SMP
 *   [4..]     Payload        上层数据 (ATT/SMP/...)
 *
 * 空口分片过程 (以 40 字节 ATT 数据为例):
 *
 *   L2CAP Frame: [Length=40] [CID=0x0004] [40 bytes ATT data]
 *   Total = 44 bytes
 *
 *   LL PDU #1: LLID=Start,     len=27, payload=[L2CAP hdr + 前 23 bytes]
 *   LL PDU #2: LLID=Continue,  len=17, payload=[后 17 bytes]
 *
 * 代码结构 (在 03 基础上新增 l2cap 模块):
 *   ble_common.h  — 公共类型 (新增 L2CAP 常量、重组缓冲区、TX 队列)
 *   hal_radio.c/h — HAL 层 (与 03 相同)
 *   ll_pdu.c/h    — 链路层 PDU (新增 LL_LENGTH_RSP)
 *   adv.c/h       — 广播态 (与 03 相同)
 *   conn.c/h      — 连接态 (新增: 数据 PDU 处理、L2CAP 分片发送)
 *   l2cap.c/h     — ★ 新增: L2CAP 帧重组、分片、回环处理
 *   main.c        — 全局变量定义与主状态机
 *
 * SPDX-License-Identifier: Apache-2.0
 */

#include "ble_common.h"
#include "hal_radio.h"
#include "ll_pdu.h"
#include "adv.h"
#include "conn.h"
#include "l2cap.h"

/*===========================================================================
 * 全局变量定义
 *===========================================================================*/

const uint8_t adv_addr[BDADDR_SIZE] = {
	0x11, 0x22, 0x33, 0x44, 0x55, 0x66
};

const uint8_t adv_data[] = {
	0x02, 0x01, 0x06,
	0x08, 0x09, 'D', 'a', 't', 'a', 'C', 'h', 'a'
};

struct conn_param conn_params;

uint8_t tx_sn;
uint8_t rx_nesn;
uint16_t conn_event_counter;
uint8_t last_unmapped_chan;
volatile bool conn_terminated;

struct pdu_data tx_pdu_buf __aligned(4);
bool tx_pdu_pending;

struct pdu_adv pdu_adv_ind __aligned(4);
struct pdu_adv pdu_adv_rx __aligned(4);
struct pdu_data pdu_data_rx __aligned(4);

uint32_t connect_end_rtc;

const uint16_t sca_ppm_table[] = {500, 250, 150, 100, 75, 50, 30, 20};

struct anchor_tracker anchor;

volatile uint32_t adv_event_count;
volatile uint32_t conn_event_rx_ok;
volatile uint32_t conn_event_rx_timeout;
volatile uint32_t conn_event_rx_crc_err;

uint32_t last_rx_aa_us;
uint32_t last_rx_ready_us;

/* L2CAP 重组缓冲区 */
struct l2cap_reassembly l2cap_reasm;

/* 数据 TX 队列 */
struct tx_queue data_tx_q;

/* 数据统计 */
uint32_t l2cap_rx_count;
uint32_t l2cap_tx_count;

/* L2CAP 延迟日志 */
uint16_t l2cap_last_rx_cid;
uint16_t l2cap_last_rx_len;
int      l2cap_last_tx_frags;
bool     l2cap_last_rx_pending;

/*===========================================================================
 * 主函数
 *===========================================================================*/
int main(void)
{
	printk("\n");
	printk("===================================================\n");
	printk("  BLE PHY Data Channel Demo\n");
	printk("  演示 L2CAP 数据帧的分片、重组与回环\n");
	printk("===================================================\n");
	printk("Device: %s  Addr: %02X:%02X:%02X:%02X:%02X:%02X\n",
	       ADV_NAME,
	       adv_addr[5], adv_addr[4], adv_addr[3],
	       adv_addr[2], adv_addr[1], adv_addr[0]);
	printk("\n");
	printk("数据通道功能:\n");
	printk("  1. 接收 LL Data PDU (LLID=Start/Continue)\n");
	printk("  2. 重组为完整 L2CAP Basic Frame\n");
	printk("  3. 拆分为 <=27 字节的 PDU 分片发回 (Echo)\n");
	printk("\n");

	hfclk_start();
	rtc0_start();
	sw_switch_timer_configure();
	dppi_configure();

	while (1) {
		printk("[STATE] Entering ADVERTISING state\n");
		adv_event_count = 0;

		radio_configure_adv();
		build_adv_ind_pdu();

		bool connected = false;
		while (!connected) {
			int ret = adv_event();
			if (ret == 1) {
				connected = true;
			} else {
				k_msleep(ADV_INTERVAL_MS);
			}
		}

		conn_loop();

		printk("[STATE] Connection lost, returning to advertising...\n\n");
		radio_ensure_disabled();
		k_msleep(100);
	}

	return 0;
}
```

## src/ble_common.h
```c
/*
 * BLE PHY Data Channel Demo — 公共类型、常量与全局变量声明
 *
 * SPDX-License-Identifier: Apache-2.0
 */

#ifndef BLE_COMMON_H
#define BLE_COMMON_H

#include <zephyr/kernel.h>
#include <zephyr/sys/printk.h>
#include <zephyr/sys/byteorder.h>
#include <string.h>
#include <stdint.h>
#include <stdbool.h>
#include <soc.h>

/*
 * nRF54L15 没有 nRF52 的 PPI / RTC0，也不使用 Zephyr LL 内部头文件。
 * 硬件路径与 02_active_scan 相同: TIMER10 + DPPIC10 做软件 TIFS，
 * TIMER20 (1 MHz) 做连接时基。
 */

#define BDADDR_SIZE                 6
#define PDU_AC_LEG_DATA_SIZE_MAX    31
#define PDU_AC_LEG_PAYLOAD_SIZE_MAX 37
#define PDU_DC_PAYLOAD_SIZE_MIN     27
#define PDU_AC_ACCESS_ADDR          0x8e89bed6
#define PDU_AC_CRC_IV               0x555555
#define PDU_CRC_POLYNOMIAL          0x00065b
#define PDU_CHANNEL_MAP_SIZE        5

enum pdu_adv_type {
	PDU_ADV_TYPE_ADV_IND = 0x00,
	PDU_ADV_TYPE_DIRECT_IND = 0x01,
	PDU_ADV_TYPE_NONCONN_IND = 0x02,
	PDU_ADV_TYPE_SCAN_REQ = 0x03,
	PDU_ADV_TYPE_SCAN_RSP = 0x04,
	PDU_ADV_TYPE_CONNECT_IND = 0x05,
	PDU_ADV_TYPE_SCAN_IND = 0x06,
};

struct pdu_adv_adv_ind {
	uint8_t addr[BDADDR_SIZE];
	uint8_t data[PDU_AC_LEG_DATA_SIZE_MAX];
} __packed;

struct pdu_adv_connect_ind {
	uint8_t init_addr[BDADDR_SIZE];
	uint8_t adv_addr[BDADDR_SIZE];
	struct {
		uint8_t  access_addr[4];
		uint8_t  crc_init[3];
		uint8_t  win_size;
		uint16_t win_offset;
		uint16_t interval;
		uint16_t latency;
		uint16_t timeout;
		uint8_t  chan_map[PDU_CHANNEL_MAP_SIZE];
		uint8_t  hop:5;
		uint8_t  sca:3;
	} __packed;
} __packed;

struct pdu_adv {
	uint8_t type:4;
	uint8_t rfu:1;
	uint8_t chan_sel:1;
	uint8_t tx_addr:1;
	uint8_t rx_addr:1;
	uint8_t len;
	union {
		uint8_t payload[PDU_AC_LEG_PAYLOAD_SIZE_MAX];
		struct pdu_adv_adv_ind adv_ind;
		struct pdu_adv_connect_ind connect_ind;
	} __packed;
} __packed;

enum pdu_data_llid {
	PDU_DATA_LLID_RESV = 0x00,
	PDU_DATA_LLID_DATA_CONTINUE = 0x01,
	PDU_DATA_LLID_DATA_START = 0x02,
	PDU_DATA_LLID_CTRL = 0x03,
};

enum pdu_data_llctrl_type {
	PDU_DATA_LLCTRL_TYPE_CONN_UPDATE_IND = 0x00,
	PDU_DATA_LLCTRL_TYPE_CHAN_MAP_IND = 0x01,
	PDU_DATA_LLCTRL_TYPE_TERMINATE_IND = 0x02,
	PDU_DATA_LLCTRL_TYPE_UNKNOWN_RSP = 0x07,
	PDU_DATA_LLCTRL_TYPE_FEATURE_REQ = 0x08,
	PDU_DATA_LLCTRL_TYPE_FEATURE_RSP = 0x09,
	PDU_DATA_LLCTRL_TYPE_VERSION_IND = 0x0C,
	PDU_DATA_LLCTRL_TYPE_PER_INIT_FEAT_XCHG = 0x0E,
	PDU_DATA_LLCTRL_TYPE_PING_REQ = 0x12,
	PDU_DATA_LLCTRL_TYPE_PING_RSP = 0x13,
	PDU_DATA_LLCTRL_TYPE_LENGTH_REQ = 0x14,
	PDU_DATA_LLCTRL_TYPE_LENGTH_RSP = 0x15,
};

struct pdu_data_llctrl_conn_update_ind {
	uint8_t  win_size;
	uint16_t win_offset;
	uint16_t interval;
	uint16_t latency;
	uint16_t timeout;
	uint16_t instant;
} __packed;

struct pdu_data_llctrl_chan_map_ind {
	uint8_t  chm[PDU_CHANNEL_MAP_SIZE];
	uint16_t instant;
} __packed;

struct pdu_data_llctrl_unknown_rsp {
	uint8_t type;
} __packed;

struct pdu_data_llctrl_feature_rsp {
	uint8_t features[8];
} __packed;

struct pdu_data_llctrl_version_ind {
	uint8_t  version_number;
	uint16_t company_id;
	uint16_t sub_version_number;
} __packed;

struct pdu_data_llctrl_length_rsp {
	uint16_t max_rx_octets;
	uint16_t max_rx_time;
	uint16_t max_tx_octets;
	uint16_t max_tx_time;
} __packed;

struct pdu_data_llctrl {
	uint8_t opcode;
	union {
		struct pdu_data_llctrl_conn_update_ind conn_update_ind;
		struct pdu_data_llctrl_chan_map_ind chan_map_ind;
		struct pdu_data_llctrl_unknown_rsp unknown_rsp;
		struct pdu_data_llctrl_feature_rsp feature_rsp;
		struct pdu_data_llctrl_version_ind version_ind;
		struct pdu_data_llctrl_length_rsp length_rsp;
	} __packed;
} __packed;

struct pdu_data {
	uint8_t ll_id:2;
	uint8_t nesn:1;
	uint8_t sn:1;
	uint8_t md:1;
	uint8_t rfu:3;
	uint8_t len;
	union {
		struct pdu_data_llctrl llctrl;
		uint8_t lldata[PDU_DC_PAYLOAD_SIZE_MIN];
	} __packed;
} __packed;

/* TIMER20 @ 1 MHz: 1 tick = 1 us, 32-bit */
#define HAL_TICKER_CNTR_CLK_UNIT_FSEC 1000000000UL
#define HAL_TICKER_CNTR_MASK          0xFFFFFFFFUL
#define HAL_TICKER_FSEC_PER_USEC      1000000000UL
#define HAL_TICKER_PSEC_PER_USEC      1000000UL
#define HAL_TICKER_FSEC_PER_PSEC      1000UL

#define HAL_TICKER_US_TO_TICKS(x) (((uint32_t)(x)) & HAL_TICKER_CNTR_MASK)
#define HAL_TICKER_TICKS_TO_US(x) ((uint32_t)(x))
#define HAL_TICKER_REMAINDER(x)   (0U)


/*===========================================================================
 * 配置参数
 *===========================================================================*/

#define ADV_INTERVAL_MS  100
#define T_IFS_US         150
#define ADV_RX_TIMEOUT_US  600

/* BLE 定时常量 */
#define WIN_DELAY_LEGACY            1250
#define CONN_INT_UNIT_US            1250
#define EVENT_JITTER_US             16
#define EVENT_TICKER_RES_MARGIN_US  31
#define ADDR_US_1M                  40
#define RTC0_CMP_OFFSET_MIN         3

#define ADV_NAME         "DataCh"

#define RX_RAMP_US       40
#define TX_RAMP_US       40

#define RX_CHAIN_DELAY_1M_US  10
#define TX_CHAIN_DELAY_US      1

/*===========================================================================
 * PPI 通道分配 (SW TIFS)
 *===========================================================================*/
#define DPPI_CH_TIMER_CLEAR  0   /* RADIO PHYEND -> TIMER CLEAR */
#define DPPI_CH_RXEN         1   /* TIMER CC[0] -> RADIO RXEN */
#define DPPI_CH_TXEN         2   /* TIMER CC[1] -> RADIO TXEN */

#define CC_IDX_RXEN  0
#define CC_IDX_TXEN  1

#define LOCAL_SCA_PPM 50

/*===========================================================================
 * L2CAP 常量
 *===========================================================================*/
#define L2CAP_CID_ATT       0x0004  /* Attribute Protocol */
#define L2CAP_CID_SIG       0x0005  /* L2CAP Signaling */
#define L2CAP_CID_SMP       0x0006  /* Security Manager */
#define L2CAP_HDR_SIZE      4       /* Length(2) + CID(2) */
#define L2CAP_MAX_PAYLOAD   512     /* 最大 L2CAP SDU */

/* LL Data PDU 默认最大 payload = 27 字节 (BLE 4.0/4.1) */
#define LL_DATA_MTU_DEFAULT 27

/*===========================================================================
 * 连接参数结构体
 *===========================================================================*/
struct conn_param {
	uint8_t  access_addr[4];
	uint8_t  crc_init[3];
	uint8_t  win_size;
	uint16_t win_offset;
	uint16_t interval;
	uint16_t latency;
	uint16_t timeout;
	uint8_t  chan_map[PDU_CHANNEL_MAP_SIZE];
	uint8_t  hop;
	uint8_t  sca;
	uint8_t  chan_count;
	uint8_t  peer_addr[BDADDR_SIZE];
};

/*===========================================================================
 * 锚点追踪结构体
 *===========================================================================*/
struct anchor_tracker {
	uint32_t initial_anchor_rtc;
	uint32_t initial_anchor_us;
	uint32_t current_anchor_rtc;
	uint32_t last_rx_anchor_rtc;
	uint32_t ww_current_us;
	uint32_t ww_periodic_us;
	uint32_t ww_max_us;
	uint32_t win_size_event_us;
	uint32_t anchor_update_count;
	uint32_t consecutive_misses;
	uint32_t max_consecutive_misses;
};

/*===========================================================================
 * L2CAP 重组缓冲区
 *===========================================================================*/
struct l2cap_reassembly {
	uint8_t  buf[L2CAP_MAX_PAYLOAD + L2CAP_HDR_SIZE];
	uint16_t expected_len;  /* L2CAP Length 字段值 + 4 (header) */
	uint16_t received_len;  /* 已接收字节数 */
	bool     in_progress;   /* 正在重组 */
};

/*===========================================================================
 * 数据 TX 队列 (简单环形缓冲)
 *===========================================================================*/
#define TX_QUEUE_SIZE  4

struct tx_frag {
	uint8_t  data[LL_DATA_MTU_DEFAULT];
	uint8_t  len;
	uint8_t  llid;  /* PDU_DATA_LLID_DATA_START or _CONTINUE */
};

struct tx_queue {
	struct tx_frag frags[TX_QUEUE_SIZE];
	uint8_t head;
	uint8_t tail;
	uint8_t count;
};

/*===========================================================================
 * 全局变量声明 (定义在 main.c)
 *===========================================================================*/

extern const uint8_t adv_addr[BDADDR_SIZE];
extern const uint8_t adv_data[];
#define ADV_DATA_LEN 14

extern struct conn_param conn_params;

/* 连接态变量 */
extern uint8_t tx_sn;
extern uint8_t rx_nesn;
extern uint16_t conn_event_counter;
extern uint8_t last_unmapped_chan;
extern volatile bool conn_terminated;

extern struct pdu_data tx_pdu_buf;
extern bool tx_pdu_pending;

/* PDU 缓冲区 */
extern struct pdu_adv pdu_adv_ind;
extern struct pdu_adv pdu_adv_rx;
extern struct pdu_data pdu_data_rx;

/* CONNECT_IND 接收时刻 */
extern uint32_t connect_end_rtc;

/* SCA PPM 映射表 */
extern const uint16_t sca_ppm_table[];

/* 锚点追踪 */
extern struct anchor_tracker anchor;

/* 统计 */
extern volatile uint32_t adv_event_count;
extern volatile uint32_t conn_event_rx_ok;
extern volatile uint32_t conn_event_rx_timeout;
extern volatile uint32_t conn_event_rx_crc_err;

/* Drift correction */
extern uint32_t last_rx_aa_us;
extern uint32_t last_rx_ready_us;

/* L2CAP 重组 */
extern struct l2cap_reassembly l2cap_reasm;

/* 数据 TX 队列 */
extern struct tx_queue data_tx_q;

/* 数据统计 */
extern uint32_t l2cap_rx_count;
extern uint32_t l2cap_tx_count;

/* L2CAP 延迟日志 (在 conn_event 结束后打印, 避免阻塞 TIFS) */
extern uint16_t l2cap_last_rx_cid;
extern uint16_t l2cap_last_rx_len;
extern int      l2cap_last_tx_frags;
extern bool     l2cap_last_rx_pending;

#endif /* BLE_COMMON_H */
```

## src/conn.c
```c
/*
 * BLE PHY Data Channel Demo — 连接态: 连接事件、数据 PDU 收发与锚点调度
 *
 * 相比 06_phy_anchor 的变化:
 *   1. conn_event() 现在处理 LL Data PDU (LLID=10/01), 不仅仅是 LL Control
 *   2. 接收到的数据分片送入 L2CAP 重组模块
 *   3. 发送队列: 优先发 LL Control 回复, 其次发 L2CAP 回环数据
 *   4. MD 位支持: 如果 TX 队列还有数据, 设 MD=1 请求连续发送
 *
 * SPDX-License-Identifier: Apache-2.0
 */

#include "conn.h"
#include "hal_radio.h"
#include "ll_pdu.h"
#include "l2cap.h"

/*===========================================================================
 * 单个连接事件
 *===========================================================================*/
static bool conn_event(uint32_t ticks_at_start, uint32_t remainder_ps,
		       uint32_t hcto_add)
{
	uint32_t ahead = (ticks_at_start - ticker_now()) &
			 HAL_TICKER_CNTR_MASK;
	if (ahead > (HAL_TICKER_CNTR_MASK >> 1) ||
	    ahead < RTC0_CMP_OFFSET_MIN) {
		(void)chan_sel_1();
		conn_event_rx_timeout++;
		conn_event_counter++;
		return false;
	}

	uint8_t chan = chan_sel_1();
	data_chan_set(chan);

	radio_irq_disable();
	radio_status_reset();
	radio_tmr_status_reset();

	radio_shorts_trx_set();

	dppi_disable_switch();

	sw_timer_cc_set(CC_IDX_TXEN, T_IFS_US - TX_RAMP_US - RX_CHAIN_DELAY_1M_US);

	sw_timer_start();

	radio_pkt_rx_set(&pdu_data_rx);


	uint32_t remainder_us = radio_tmr_start(0, ticks_at_start,
						remainder_ps);

	radio_tmr_aa_capture();
	radio_tmr_aa_save(0);

	uint32_t hcto = remainder_us + hcto_add +
			radio_rx_ready_delay_get(0, 0) +
			ADDR_US_1M +
			radio_rx_chain_delay_get(0, 0);
	radio_tmr_hcto_configure(hcto);
	radio_tmr_end_capture();

	/* 等待 RX 完成或 HCTO 超时 */
	{
		uint32_t safety = 0;
		while (NRF_RADIO->EVENTS_DISABLED == 0) {
			radio_tmr_stamp_poll();
			if (radio_hcto_expired() || ++safety > 5000000) {
				NRF_RADIO->TASKS_DISABLE = 1;
				while (NRF_RADIO->EVENTS_DISABLED == 0) {
				}
				conn_event_rx_timeout++;
				conn_event_counter++;
				return false;
			}
		}
	}
	NRF_RADIO->EVENTS_DISABLED = 0;

	if (!radio_is_done()) {
		radio_ensure_disabled();
		conn_event_rx_timeout++;
		conn_event_counter++;
		return false;
	}

	if (!radio_crc_is_valid()) {
		radio_ensure_disabled();
		conn_event_rx_crc_err++;
		conn_event_counter++;
		return false;
	}

	conn_event_rx_ok++;

	last_rx_aa_us = radio_tmr_aa_get();
	last_rx_ready_us = radio_tmr_ready_get();

	/*==============================================================
	 * RX→TX 转换 (SW TIFS)
	 *==============================================================*/
	sw_timer_clear_compare(CC_IDX_TXEN);
	sw_timer_clear_compare(CC_IDX_RXEN);

	/* SN/NESN 流控 */
	if (pdu_data_rx.nesn != tx_sn) {
		tx_sn = pdu_data_rx.nesn;
	}
	bool new_packet = false;
	if (pdu_data_rx.sn == rx_nesn) {
		new_packet = true;
		rx_nesn ^= 1;
	}

	/*==============================================================
	 * ★ 数据 PDU 处理 — 本 Demo 的核心新增功能
	 *
	 * LL Data PDU 的 LLID 字段区分数据类型:
	 *   LLID=11 (0x03): LL Control — 链路层控制包
	 *   LLID=10 (0x02): Data Start — L2CAP 帧的第一个分片
	 *   LLID=01 (0x01): Data Continue — L2CAP 帧的后续分片
	 *   LLID=01 + len=0: Empty PDU — 空包 (ACK only)
	 *==============================================================*/
	tx_pdu_pending = false;

	if (new_packet && pdu_data_rx.len > 0) {
		if (pdu_data_rx.ll_id == PDU_DATA_LLID_CTRL) {
			/* LL Control: 与 03 相同的处理 */
			tx_pdu_pending = handle_ll_control(&pdu_data_rx);
		} else if (pdu_data_rx.ll_id == PDU_DATA_LLID_DATA_START ||
			   pdu_data_rx.ll_id == PDU_DATA_LLID_DATA_CONTINUE) {
			/* ★ L2CAP 数据分片: 送入重组模块 */
			bool complete = l2cap_rx_fragment(
				pdu_data_rx.ll_id,
				pdu_data_rx.lldata,
				pdu_data_rx.len);

			if (complete) {
				/* 完整 L2CAP 帧重组完成 → 处理 (echo) */
				l2cap_process_complete();
			}
		}
	}

	/* ★ 准备 TX 包: 优先级
	 *   1. LL Control 回复 (tx_pdu_pending = true)
	 *   2. L2CAP TX 队列中的数据分片
	 *   3. 空包 (ACK only) */
	if (tx_pdu_pending) {
		tx_pdu_buf.nesn = rx_nesn;
		tx_pdu_buf.sn   = tx_sn;
		radio_pkt_tx_set(&tx_pdu_buf);
	} else if (l2cap_tx_dequeue(&tx_pdu_buf)) {
		/* 从 L2CAP TX 队列取出数据分片 */
		tx_pdu_buf.nesn = rx_nesn;
		tx_pdu_buf.sn   = tx_sn;
		tx_pdu_pending = true;
		radio_pkt_tx_set(&tx_pdu_buf);
	} else {
		build_empty_pdu(&tx_pdu_buf);
		radio_pkt_tx_set(&tx_pdu_buf);
	}

	/* 启用 PPI_CH_TXEN */
	dppi_enable_txen();

	radio_event_end_clear();
	NRF_RADIO->EVENTS_DISABLED = 0;

	/* 等待 TX 完成 */
	{
		uint32_t safety = 0;
		while (NRF_RADIO->EVENTS_DISABLED == 0) {
			if (++safety > 2000000) {
				NRF_RADIO->TASKS_DISABLE = 1;
				while (NRF_RADIO->EVENTS_DISABLED == 0) {
				}
				break;
			}
		}
	}
	NRF_RADIO->EVENTS_DISABLED = 0;

	dppi_disable_switch();
	NRF_RADIO->SHORTS = 0;

	if (tx_pdu_pending) {
		tx_sn ^= 1;
	}

	conn_event_counter++;
	return true;
}

/*===========================================================================
 * 连接态主循环
 *===========================================================================*/
void conn_loop(void)
{
	tx_sn = 0;
	rx_nesn = 0;
	conn_event_counter = 0;
	last_unmapped_chan = 0;
	conn_terminated = false;
	tx_pdu_pending = false;
	conn_event_rx_ok = 0;
	conn_event_rx_timeout = 0;
	conn_event_rx_crc_err = 0;

	memset(&anchor, 0, sizeof(anchor));
	l2cap_init();

	radio_configure_conn();
	print_connect_ind();

	uint32_t conn_interval_us = (uint32_t)conn_params.interval * CONN_INT_UNIT_US;
	uint32_t win_size_us = (uint32_t)conn_params.win_size * CONN_INT_UNIT_US;

	uint16_t master_sca_ppm = sca_ppm_table[conn_params.sca & 0x07];
	uint32_t combined_sca_ppm = (uint32_t)master_sca_ppm + LOCAL_SCA_PPM;
	uint32_t ww_periodic_us = DIV_ROUND_UP(
		combined_sca_ppm * conn_interval_us, 1000000);
	uint32_t ww_max_us = (conn_interval_us >> 1) - T_IFS_US;

	anchor.ww_periodic_us = ww_periodic_us;
	anchor.ww_max_us = ww_max_us;

	uint32_t ww_event_us = 0;
	uint32_t win_size_event_us = win_size_us;
	anchor.win_size_event_us = win_size_us;

	uint32_t conn_offset_us = (uint32_t)conn_params.win_offset * CONN_INT_UNIT_US
				+ WIN_DELAY_LEGACY
				- EVENT_TICKER_RES_MARGIN_US
				- EVENT_JITTER_US
				- radio_rx_ready_delay_get(0, 0)
				- ww_periodic_us;

	anchor.initial_anchor_us = conn_offset_us;

	uint32_t offset_ticks = HAL_TICKER_US_TO_TICKS(conn_offset_us);
	uint32_t offset_remainder_ps = HAL_TICKER_REMAINDER(conn_offset_us);

	uint32_t interval_ticks = HAL_TICKER_US_TO_TICKS(conn_interval_us);
	uint32_t interval_remainder_ps = HAL_TICKER_REMAINDER(conn_interval_us);

	uint32_t ps_per_tick = HAL_TICKER_CNTR_CLK_UNIT_FSEC /
			       HAL_TICKER_FSEC_PER_PSEC;

	uint32_t next_event_rtc = (connect_end_rtc + offset_ticks) &
				  HAL_TICKER_CNTR_MASK;
	uint32_t next_event_remainder_ps = offset_remainder_ps;

	anchor.initial_anchor_rtc = next_event_rtc;
	anchor.current_anchor_rtc = next_event_rtc;
	anchor.last_rx_anchor_rtc = connect_end_rtc;

	uint32_t supervision_timeout_us = (uint32_t)conn_params.timeout * 10000;
	uint32_t last_rx_rtc = connect_end_rtc;

	while (!conn_terminated) {
		ww_event_us += ww_periodic_us;
		if (ww_event_us > ww_max_us) {
			ww_event_us = ww_max_us;
		}
		anchor.ww_current_us = ww_event_us;

		uint32_t hcto_add = ((EVENT_JITTER_US +
				      EVENT_TICKER_RES_MARGIN_US +
				      ww_event_us) << 1) +
				    win_size_event_us;

		anchor.current_anchor_rtc = next_event_rtc;

		bool rx_ok = conn_event(next_event_rtc,
					next_event_remainder_ps,
					hcto_add);

		if (rx_ok) {
			uint32_t actual_s2a = last_rx_aa_us - last_rx_ready_us;
			int32_t drift_us = (int32_t)actual_s2a -
				(int32_t)(EVENT_JITTER_US +
					  EVENT_TICKER_RES_MARGIN_US +
					  ADDR_US_1M);

			int64_t adj_ps = (int64_t)next_event_remainder_ps +
					 (int64_t)drift_us * 1000000LL;

			while (adj_ps >= (int64_t)ps_per_tick) {
				adj_ps -= ps_per_tick;
				next_event_rtc = (next_event_rtc + 1) &
						 HAL_TICKER_CNTR_MASK;
			}
			while (adj_ps < 0) {
				adj_ps += ps_per_tick;
				next_event_rtc = (next_event_rtc - 1) &
						 HAL_TICKER_CNTR_MASK;
			}
			next_event_remainder_ps = (uint32_t)adj_ps;

			last_rx_rtc = next_event_rtc;
			anchor.last_rx_anchor_rtc = next_event_rtc;
			anchor.anchor_update_count++;
			anchor.consecutive_misses = 0;

			ww_event_us = 0;
			win_size_event_us = 0;
			anchor.ww_current_us = 0;
			anchor.win_size_event_us = 0;
		} else {
			anchor.consecutive_misses++;
			if (anchor.consecutive_misses > anchor.max_consecutive_misses) {
				anchor.max_consecutive_misses = anchor.consecutive_misses;
			}

			uint32_t elapsed_ticks = (next_event_rtc - last_rx_rtc) &
						 HAL_TICKER_CNTR_MASK;
			uint32_t elapsed_us = HAL_TICKER_TICKS_TO_US(elapsed_ticks);

			if (elapsed_us >= supervision_timeout_us) {
				printk("[CONN] Supervision timeout! no RX for %u us\n",
				       elapsed_us);
				break;
			}
		}

		/* 锚点递推 */
		next_event_rtc = (next_event_rtc + interval_ticks) &
				 HAL_TICKER_CNTR_MASK;
		next_event_remainder_ps += interval_remainder_ps;
		if (next_event_remainder_ps >= ps_per_tick) {
			next_event_remainder_ps -= ps_per_tick;
			next_event_rtc = (next_event_rtc + 1) &
					 HAL_TICKER_CNTR_MASK;
		}

		uint32_t current_event = conn_event_counter;

		if (current_event <= 5 || anchor.consecutive_misses > 3) {
			printk("[CONN] #%u ch=%u %s | ww=%u | rx=%u/%u l2cap_rx=%u tx=%u\n",
			       current_event, last_unmapped_chan,
			       rx_ok ? "OK" : "MISS",
			       anchor.ww_current_us,
			       conn_event_rx_ok, current_event,
			       l2cap_rx_count, l2cap_tx_count);
		}

		/* 延迟打印 L2CAP RX 日志 (在事件结束后, 不影响 TIFS) */
		if (l2cap_last_rx_pending) {
			printk("[L2CAP] RX #%u: CID=0x%04X len=%u",
			       l2cap_rx_count, l2cap_last_rx_cid,
			       l2cap_last_rx_len);
			if (l2cap_last_tx_frags > 0) {
				printk(" → echo %d frags\n",
				       l2cap_last_tx_frags);
			} else {
				printk(" → TX queue full!\n");
			}
			l2cap_last_rx_pending = false;
		}
	}

	NRF_RADIO->SHORTS = 0;
	radio_irq_disable();

	printk("\n========== Connection Summary ==========\n");
	printk("  Total events:   %u\n", conn_event_counter);
	printk("  RX OK:          %u\n", conn_event_rx_ok);
	printk("  RX timeout:     %u\n", conn_event_rx_timeout);
	printk("  RX CRC error:   %u\n", conn_event_rx_crc_err);
	printk("  L2CAP RX:       %u\n", l2cap_rx_count);
	printk("  L2CAP TX echo:  %u\n", l2cap_tx_count);
	printk("  Anchor updates: %u\n", anchor.anchor_update_count);
	printk("  Max consec miss: %u\n", anchor.max_consecutive_misses);
	printk("=========================================\n");
}
```
