## CMakeLists.txt
```
# SPDX-License-Identifier: Apache-2.0

cmake_minimum_required(VERSION 3.20.0)
find_package(Zephyr REQUIRED HINTS $ENV{ZEPHYR_BASE})
project(ble_phy_conn_loop)

target_sources(app PRIVATE
  src/main.c
  src/hal_radio.c
  src/ll_pdu.c
  src/adv.c
  src/conn.c
)
```

## prj.conf
```kconfig
# BLE PHY Connection Loop Demo
# 多事件连接循环: 跳频、SN/NESN 流控、锚点递推、supervision timeout

CONFIG_GPIO=y
CONFIG_SERIAL=y
CONFIG_CONSOLE=y
CONFIG_UART_CONSOLE=y
CONFIG_PRINTK=y

# 直接操作 RADIO (nRF54L15)
CONFIG_BT=n
CONFIG_CLOCK_CONTROL=y
```

## boards/nrf54l15dk_nrf54l15_cpuapp.overlay
```dts
/*
 * nRF54L15: TIMER10 + DPPIC10 做软件 TIFS，TIMER20 做连接时基。
 */
&timer10 {
	status = "okay";
};

&dppic10 {
	status = "okay";
};

&radio {
	status = "okay";
};

&timer20 {
	status = "okay";
};
```

## src/main.c
```c
/*
 * BLE PHY Connection Loop (连接事件循环) Demo
 *
 * 本 Demo 在 04_phy_first_anchor 基础上, 实现了:
 *   1. 多 connInterval 事件循环 (while loop)
 *   2. 锚点递推: next_rtc += interval_ticks + remainder 进位
 *   3. 每事件跳频: chan_sel_1() 计算新数据信道
 *   4. SN/NESN 单 bit 流控 (ACK/新包确认)
 *   5. 基本 supervision timeout 检测
 *
 * 与 06_phy_anchor 的区别:
 *   - Window Widening 固定 (不累积)
 *   - 无 TIMER0 漂移测量与校正
 *   - 无 LL Control PDU 处理
 *   → 连接保持时间有限 (通常 5-15 秒, 取决于晶振精度)
 *
 * 代码结构: 同 04, conn.c 的 conn_first_event() → conn_loop()
 *
 * SPDX-License-Identifier: Apache-2.0
 */

#include "ble_common.h"
#include "hal_radio.h"
#include "ll_pdu.h"
#include "adv.h"
#include "conn.h"

/*===========================================================================
 * 全局变量定义
 *===========================================================================*/

const uint8_t adv_addr[BDADDR_SIZE] = {
	0x11, 0x22, 0x33, 0x44, 0x55, 0x66
};

const uint8_t adv_data[] = {
	0x02, 0x01, 0x06,
	0x08, 0x09, 'C', 'o', 'n', 'L', 'o', 'o', 'p'
};

struct conn_param conn_params;

/* 连接态变量 */
uint8_t tx_sn;
uint8_t rx_nesn;
uint16_t conn_event_counter;
uint8_t last_unmapped_chan;

struct pdu_data tx_pdu_buf __aligned(4);

/* PDU 缓冲区 */
struct pdu_adv pdu_adv_ind __aligned(4);
struct pdu_adv pdu_adv_rx __aligned(4);
struct pdu_data pdu_data_rx __aligned(4);

/* CONNECT_IND 接收时刻 */
uint32_t connect_end_rtc;

/* SCA PPM 映射表 */
const uint16_t sca_ppm_table[] = {500, 250, 150, 100, 75, 50, 30, 20};

/* 锚点追踪 */
struct anchor_tracker anchor;

/* 统计 */
volatile uint32_t adv_event_count;
volatile uint32_t conn_event_rx_ok;
volatile uint32_t conn_event_rx_timeout;
volatile uint32_t conn_event_rx_crc_err;

/*===========================================================================
 * 主函数
 *===========================================================================*/
int main(void)
{
	printk("\n");
	printk("===================================================\n");
	printk("  BLE PHY Connection Loop Demo\n");
	printk("  多事件连接循环: 跳频, SN/NESN, 锚点递推\n");
	printk("===================================================\n");
	printk("Device: %s  Addr: %02X:%02X:%02X:%02X:%02X:%02X\n",
	       ADV_NAME,
	       adv_addr[5], adv_addr[4], adv_addr[3],
	       adv_addr[2], adv_addr[1], adv_addr[0]);
	printk("\n");

	hfclk_start();
	rtc0_start();
	sw_switch_timer_configure();
	dppi_configure();

	while (1) {
		printk("[STATE] Entering ADVERTISING state\n");
		adv_event_count = 0;

		radio_configure_adv();
		build_adv_ind_pdu();

		bool connected = false;

		while (!connected) {
			int ret = adv_event();

			if (ret == 1) {
				connected = true;
			} else {
				k_msleep(ADV_INTERVAL_MS);
			}
		}

		/* ★ 收到 CONNECT_IND! 进入连接态循环 */
		conn_loop();

		printk("[STATE] Connection ended, returning to advertising...\n\n");
		radio_ensure_disabled();
		k_msleep(100);
	}

	return 0;
}
```

## src/adv.c
```c
/*
 * BLE PHY Connection Loop Demo — 广播态: ADV_IND 发送与 CONNECT_IND 接收
 *
 * (与 04_phy_first_anchor 的 adv.c 相同)
 *
 * SPDX-License-Identifier: Apache-2.0
 */

#include "adv.h"
#include "hal_radio.h"
#include "ll_pdu.h"

/*===========================================================================
 * 广播信道处理
 *===========================================================================*/
int adv_on_channel(uint32_t channel)
{
	uint32_t freq;

	switch (channel) {
	case 37: freq = 2;  break;
	case 38: freq = 26; break;
	case 39: freq = 80; break;
	default: return 0;
	}

	radio_freq_chan_set(freq);
	radio_whiten_iv_set(channel);

	radio_irq_disable();

	/*==============================================================
	 * 第 1 阶段: TX ADV_IND (SW TIFS)
	 *==============================================================*/

	radio_pkt_tx_set(&pdu_adv_ind);

	radio_status_reset();
	NRF_RADIO->EVENTS_DISABLED = 0;
	radio_event_end_clear();
	NRF_RADIO->EVENTS_ADDRESS = 0;

	radio_shorts_trx_set();

	sw_timer_cc_set(CC_IDX_RXEN, T_IFS_US - RX_RAMP_US);
	dppi_disable_switch();

	sw_timer_start();

	NRF_RADIO->TASKS_TXEN = 1;

	while (!radio_event_end_check()) {
	}
	radio_event_end_clear();

	/*==============================================================
	 * TX→RX 转换 (SW TIFS)
	 *==============================================================*/

	sw_timer_clear_compare(CC_IDX_RXEN);

	radio_pkt_rx_set(&pdu_adv_rx);

	dppi_enable_rxen();

	while (NRF_RADIO->EVENTS_DISABLED == 0) {
	}
	NRF_RADIO->EVENTS_DISABLED = 0;

	/*==============================================================
	 * 第 2 阶段: RX 等待 CONNECT_IND
	 *==============================================================*/

	NRF_RADIO->EVENTS_ADDRESS = 0;

	uint32_t timeout_loops = ADV_RX_TIMEOUT_US * 16;
	bool rx_done = false;

	while (timeout_loops > 0) {
		if (NRF_RADIO->EVENTS_DISABLED) {
			rx_done = true;
			break;
		}
		timeout_loops--;
	}

	/* ★ 立即捕获 T0 */
	uint32_t rx_end_rtc = ticker_now() & HAL_TICKER_CNTR_MASK;

	if (!rx_done) {
		radio_ensure_disabled();
		return 0;
	}

	dppi_disable_switch();
	NRF_RADIO->SHORTS = 0;

	if (!radio_crc_is_valid()) {
		return 0;
	}

	if (validate_connect_ind(&pdu_adv_rx)) {
		connect_end_rtc = rx_end_rtc;
		parse_connect_ind(&pdu_adv_rx);
		return 1;
	}

	return 0;
}

/*===========================================================================
 * 广播事件
 *===========================================================================*/
int adv_event(void)
{
	static const uint32_t adv_channels[] = {37, 38, 39};

	for (int i = 0; i < 3; i++) {
		int ret = adv_on_channel(adv_channels[i]);

		if (ret == 1) {
			return 1;
		}
	}

	adv_event_count++;
	if (adv_event_count <= 3 || adv_event_count % 50 == 0) {
		printk("[ADV] events: %u (waiting for connection...)\n",
		       adv_event_count);
	}
	return 0;
}
```

## src/ble_common.h
```c
/*
 * BLE PHY Connection Loop Demo — 公共类型、常量与全局变量声明
 *
 * 相比 04_phy_first_anchor 新增:
 *   - anchor_tracker 扩展: consecutive_misses, anchor_update_count 等
 *   - conn_event_rx_crc_err 统计
 *
 * SPDX-License-Identifier: Apache-2.0
 */

#ifndef BLE_COMMON_H
#define BLE_COMMON_H

#include <zephyr/kernel.h>
#include <zephyr/sys/printk.h>
#include <zephyr/sys/byteorder.h>
#include <string.h>
#include <stdint.h>
#include <stdbool.h>
#include <soc.h>

/*
 * nRF54L15 没有 nRF52 的 PPI / RTC0，也不使用 Zephyr LL 内部头文件。
 * 硬件路径与 02_active_scan 相同: TIMER10 + DPPIC10 做软件 TIFS，
 * TIMER20 (1 MHz) 做连接时基。
 */

#define BDADDR_SIZE                 6
#define PDU_AC_LEG_DATA_SIZE_MAX    31
#define PDU_AC_LEG_PAYLOAD_SIZE_MAX 37
#define PDU_DC_PAYLOAD_SIZE_MIN     27
#define PDU_AC_ACCESS_ADDR          0x8e89bed6
#define PDU_AC_CRC_IV               0x555555
#define PDU_CRC_POLYNOMIAL          0x00065b
#define PDU_CHANNEL_MAP_SIZE        5

enum pdu_adv_type {
	PDU_ADV_TYPE_ADV_IND = 0x00,
	PDU_ADV_TYPE_DIRECT_IND = 0x01,
	PDU_ADV_TYPE_NONCONN_IND = 0x02,
	PDU_ADV_TYPE_SCAN_REQ = 0x03,
	PDU_ADV_TYPE_SCAN_RSP = 0x04,
	PDU_ADV_TYPE_CONNECT_IND = 0x05,
	PDU_ADV_TYPE_SCAN_IND = 0x06,
};

struct pdu_adv_adv_ind {
	uint8_t addr[BDADDR_SIZE];
	uint8_t data[PDU_AC_LEG_DATA_SIZE_MAX];
} __packed;

struct pdu_adv_connect_ind {
	uint8_t init_addr[BDADDR_SIZE];
	uint8_t adv_addr[BDADDR_SIZE];
	struct {
		uint8_t  access_addr[4];
		uint8_t  crc_init[3];
		uint8_t  win_size;
		uint16_t win_offset;
		uint16_t interval;
		uint16_t latency;
		uint16_t timeout;
		uint8_t  chan_map[PDU_CHANNEL_MAP_SIZE];
		uint8_t  hop:5;
		uint8_t  sca:3;
	} __packed;
} __packed;

struct pdu_adv {
	uint8_t type:4;
	uint8_t rfu:1;
	uint8_t chan_sel:1;
	uint8_t tx_addr:1;
	uint8_t rx_addr:1;
	uint8_t len;
	union {
		uint8_t payload[PDU_AC_LEG_PAYLOAD_SIZE_MAX];
		struct pdu_adv_adv_ind adv_ind;
		struct pdu_adv_connect_ind connect_ind;
	} __packed;
} __packed;

enum pdu_data_llid {
	PDU_DATA_LLID_RESV = 0x00,
	PDU_DATA_LLID_DATA_CONTINUE = 0x01,
	PDU_DATA_LLID_DATA_START = 0x02,
	PDU_DATA_LLID_CTRL = 0x03,
};

enum pdu_data_llctrl_type {
	PDU_DATA_LLCTRL_TYPE_CONN_UPDATE_IND = 0x00,
	PDU_DATA_LLCTRL_TYPE_CHAN_MAP_IND = 0x01,
	PDU_DATA_LLCTRL_TYPE_TERMINATE_IND = 0x02,
	PDU_DATA_LLCTRL_TYPE_UNKNOWN_RSP = 0x07,
	PDU_DATA_LLCTRL_TYPE_FEATURE_REQ = 0x08,
	PDU_DATA_LLCTRL_TYPE_FEATURE_RSP = 0x09,
	PDU_DATA_LLCTRL_TYPE_VERSION_IND = 0x0C,
	PDU_DATA_LLCTRL_TYPE_PER_INIT_FEAT_XCHG = 0x0E,
	PDU_DATA_LLCTRL_TYPE_PING_REQ = 0x12,
	PDU_DATA_LLCTRL_TYPE_PING_RSP = 0x13,
	PDU_DATA_LLCTRL_TYPE_LENGTH_REQ = 0x14,
	PDU_DATA_LLCTRL_TYPE_LENGTH_RSP = 0x15,
};

struct pdu_data_llctrl_conn_update_ind {
	uint8_t  win_size;
	uint16_t win_offset;
	uint16_t interval;
	uint16_t latency;
	uint16_t timeout;
	uint16_t instant;
} __packed;

struct pdu_data_llctrl_chan_map_ind {
	uint8_t  chm[PDU_CHANNEL_MAP_SIZE];
	uint16_t instant;
} __packed;

struct pdu_data_llctrl_unknown_rsp {
	uint8_t type;
} __packed;

struct pdu_data_llctrl_feature_rsp {
	uint8_t features[8];
} __packed;

struct pdu_data_llctrl_version_ind {
	uint8_t  version_number;
	uint16_t company_id;
	uint16_t sub_version_number;
} __packed;

struct pdu_data_llctrl_length_rsp {
	uint16_t max_rx_octets;
	uint16_t max_rx_time;
	uint16_t max_tx_octets;
	uint16_t max_tx_time;
} __packed;

struct pdu_data_llctrl {
	uint8_t opcode;
	union {
		struct pdu_data_llctrl_conn_update_ind conn_update_ind;
		struct pdu_data_llctrl_chan_map_ind chan_map_ind;
		struct pdu_data_llctrl_unknown_rsp unknown_rsp;
		struct pdu_data_llctrl_feature_rsp feature_rsp;
		struct pdu_data_llctrl_version_ind version_ind;
		struct pdu_data_llctrl_length_rsp length_rsp;
	} __packed;
} __packed;

struct pdu_data {
	uint8_t ll_id:2;
	uint8_t nesn:1;
	uint8_t sn:1;
	uint8_t md:1;
	uint8_t rfu:3;
	uint8_t len;
	union {
		struct pdu_data_llctrl llctrl;
		uint8_t lldata[PDU_DC_PAYLOAD_SIZE_MIN];
	} __packed;
} __packed;

/* TIMER20 @ 1 MHz: 1 tick = 1 us, 32-bit */
#define HAL_TICKER_CNTR_CLK_UNIT_FSEC 1000000000UL
#define HAL_TICKER_CNTR_MASK          0xFFFFFFFFUL
#define HAL_TICKER_FSEC_PER_USEC      1000000000UL
#define HAL_TICKER_PSEC_PER_USEC      1000000UL
#define HAL_TICKER_FSEC_PER_PSEC      1000UL

#define HAL_TICKER_US_TO_TICKS(x) (((uint32_t)(x)) & HAL_TICKER_CNTR_MASK)
#define HAL_TICKER_TICKS_TO_US(x) ((uint32_t)(x))
#define HAL_TICKER_REMAINDER(x)   (0U)


/*===========================================================================
 * 配置参数
 *===========================================================================*/

/* 广播间隔 (ms) */
#define ADV_INTERVAL_MS  100

/* T_IFS = 150 μs */
#define T_IFS_US         150

/* ADV RX 超时 (μs) */
#define ADV_RX_TIMEOUT_US  600

/* BLE 定时常量 */
#define WIN_DELAY_LEGACY            1250  /* transmitWindowDelay (μs) */
#define CONN_INT_UNIT_US            1250  /* connInterval unit (1.25ms) */
#define EVENT_JITTER_US             16    /* Active clock jitter margin (μs) */
#define EVENT_TICKER_RES_MARGIN_US  31    /* RTC tick resolution ~30.52μs ceil */
#define ADDR_US_1M                  40    /* Preamble(8)+AA(32) for 1M PHY */
#define RTC0_CMP_OFFSET_MIN         3     /* NRF_RTC0 CC 最小比较偏移 */

#define ADV_NAME         "ConLoop"

/* TX/RX ramp-up 延迟 (μs): fast ramp-up ≈ 40 μs */
#define RX_RAMP_US       40
#define TX_RAMP_US       40

/* Chain delay: RADIO END 事件相对于实际空中包结束的延迟
 * nRF52832 1M PHY: RX chain delay = 9.4μs (ceil→10), TX chain delay = 0.6μs (ceil→1) */
#define RX_CHAIN_DELAY_1M_US  10
#define TX_CHAIN_DELAY_US      1

/*===========================================================================
 * PPI 通道分配 (SW TIFS)
 *===========================================================================*/
#define DPPI_CH_TIMER_CLEAR  0   /* RADIO PHYEND -> TIMER CLEAR */
#define DPPI_CH_RXEN         1   /* TIMER CC[0] -> RADIO RXEN */
#define DPPI_CH_TXEN         2   /* TIMER CC[1] -> RADIO TXEN */

#define CC_IDX_RXEN  0   /* Timer CC[0]: TX→RX 转换 */
#define CC_IDX_TXEN  1   /* Timer CC[1]: RX→TX 转换 */

#define LOCAL_SCA_PPM 50

/*===========================================================================
 * 连接参数结构体
 *===========================================================================*/
struct conn_param {
	uint8_t  access_addr[4];
	uint8_t  crc_init[3];
	uint8_t  win_size;
	uint16_t win_offset;
	uint16_t interval;
	uint16_t latency;
	uint16_t timeout;
	uint8_t  chan_map[PDU_CHANNEL_MAP_SIZE];
	uint8_t  hop;
	uint8_t  sca;
	uint8_t  chan_count;
	uint8_t  peer_addr[BDADDR_SIZE];
};

/*===========================================================================
 * 锚点追踪结构体
 *
 * 相比 04: 增加了 consecutive_misses 和 anchor_update_count
 * (为 supervision timeout 和统计用)
 *===========================================================================*/
struct anchor_tracker {
	uint32_t initial_anchor_rtc;     /* 首次计算出的锚点 RTC tick */
	uint32_t initial_anchor_us;      /* 首次锚点的 μs 偏移量 */
	uint32_t current_anchor_rtc;     /* 当前锚点 RTC tick */
	uint32_t consecutive_misses;     /* 连续 RX 失败次数 */
	uint32_t max_consecutive_misses; /* 历史最大连续失败 */
	uint32_t anchor_update_count;    /* 锚点更新次数 (= 成功 RX 次数) */
};

/*===========================================================================
 * 全局变量声明 (定义在 main.c)
 *===========================================================================*/

extern const uint8_t adv_addr[BDADDR_SIZE];
extern const uint8_t adv_data[];
#define ADV_DATA_LEN 12  /* sizeof(adv_data): 3 (flags) + 9 (name "ConLoop") */

extern struct conn_param conn_params;

/* 连接态变量 */
extern uint8_t tx_sn;
extern uint8_t rx_nesn;
extern uint16_t conn_event_counter;
extern uint8_t last_unmapped_chan;

extern struct pdu_data tx_pdu_buf;

/* PDU 缓冲区 */
extern struct pdu_adv pdu_adv_ind;
extern struct pdu_adv pdu_adv_rx;
extern struct pdu_data pdu_data_rx;

/* CONNECT_IND 接收时刻 */
extern uint32_t connect_end_rtc;

/* SCA PPM 映射表 */
extern const uint16_t sca_ppm_table[];

/* 锚点追踪 */
extern struct anchor_tracker anchor;

/* 统计 */
extern volatile uint32_t adv_event_count;
extern volatile uint32_t conn_event_rx_ok;
extern volatile uint32_t conn_event_rx_timeout;
extern volatile uint32_t conn_event_rx_crc_err;

#endif /* BLE_COMMON_H */
```

## src/conn.c
```c
/*
 * BLE PHY Connection Loop Demo — 连接态: 多事件连接循环
 *
 * 本文件在 04_phy_first_anchor 基础上扩展了:
 *
 * ★ conn_loop() — 多 connInterval 事件循环:
 *   1. 每个 connInterval 推进锚点: next_rtc += interval_ticks
 *   2. 皮秒余量累积与进位: 防止长期舍入漂移
 *   3. 每事件调用 chan_sel_1() 实现跳频
 *   4. 固定 WW (不累积, 每次事件用 ww_periodic_us)
 *   5. 基本 supervision timeout 检测
 *
 * ★ conn_event() 增强 — SN/NESN 流控:
 *   - RX 成功后检查 SN/NESN 以更新流控状态
 *   - 根据 Master 的 NESN 翻转 tx_sn (ACK 机制)
 *   - 根据 Master 的 SN 翻转 rx_nesn (新包确认)
 *
 * 与 06_phy_anchor 的区别:
 *   - 无动态 Window Widening 累积 (WW 固定)
 *   - 无 TIMER0 漂移测量与校正
 *   - 无 LL Control PDU 处理
 *
 * SPDX-License-Identifier: Apache-2.0
 */

#include "conn.h"
#include "hal_radio.h"
#include "ll_pdu.h"

/*===========================================================================
 * 单个连接事件 (使用 HAL 硬件定时 + SW TIFS)
 *
 * 相比 04 新增: SN/NESN 流控处理
 *===========================================================================*/
static bool conn_event(uint32_t ticks_at_start, uint32_t remainder_ps,
		       uint32_t hcto_add)
{
	/* 检查目标 RTC tick 是否在未来 */
	uint32_t ahead = (ticks_at_start - ticker_now()) &
			 HAL_TICKER_CNTR_MASK;
	if (ahead > (HAL_TICKER_CNTR_MASK >> 1) ||
	    ahead < RTC0_CMP_OFFSET_MIN) {
		(void)chan_sel_1();
		conn_event_rx_timeout++;
		conn_event_counter++;
		return false;
	}

	uint8_t chan = chan_sel_1();
	data_chan_set(chan);

	radio_irq_disable();
	radio_status_reset();

	/* 清理上一个事件遗留的 HAL PPI/Timer 状态 */
	radio_tmr_status_reset();

	radio_shorts_trx_set();

	dppi_disable_switch();

	/* 设置 Timer1 CC[1] for RX→TX 转换 */
	sw_timer_cc_set(CC_IDX_TXEN, T_IFS_US - TX_RAMP_US - RX_CHAIN_DELAY_1M_US);

	sw_timer_start();

	radio_pkt_rx_set(&pdu_data_rx);

	/* 停止 TIMER0 + 清除 RTC0 比较事件 */

	/* ★ 传锚点给硬件: radio_tmr_start 配置 RTC0→TIMER0→PPI→RXEN */
	uint32_t remainder_us = radio_tmr_start(0, ticks_at_start,
						remainder_ps);

	radio_tmr_aa_capture();
	radio_tmr_aa_save(0);

	/* HCTO: 如果在锚点 + HCTO 时间内没收到包头, 自动 DISABLE Radio */
	uint32_t hcto = remainder_us + hcto_add +
			radio_rx_ready_delay_get(0, 0) +
			ADDR_US_1M +
			radio_rx_chain_delay_get(0, 0);
	radio_tmr_hcto_configure(hcto);

	radio_tmr_end_capture();

	/* 等待 RX 完成或 HCTO 超时 */
	{
		uint32_t safety = 0;

		while (NRF_RADIO->EVENTS_DISABLED == 0) {
			radio_tmr_stamp_poll();
			if (radio_hcto_expired() || ++safety > 5000000) {
				printk("!STUCK RX! ST=%u\n", NRF_RADIO->STATE);
				NRF_RADIO->TASKS_DISABLE = 1;
				while (NRF_RADIO->EVENTS_DISABLED == 0) {
				}
				conn_event_rx_timeout++;
				conn_event_counter++;
				return false;
			}
		}
	}
	NRF_RADIO->EVENTS_DISABLED = 0;

	if (!radio_is_done()) {
		radio_ensure_disabled();
		conn_event_rx_timeout++;
		conn_event_counter++;
		return false;
	}

	if (!radio_crc_is_valid()) {
		radio_ensure_disabled();
		conn_event_rx_crc_err++;
		conn_event_counter++;
		return false;
	}

	conn_event_rx_ok++;

	/*==============================================================
	 * SW TIFS: RX→TX 转换
	 *==============================================================*/

	sw_timer_clear_compare(CC_IDX_TXEN);
	sw_timer_clear_compare(CC_IDX_RXEN);

	/* ★ SN/NESN 流控 (本例程新增)
	 *
	 * BLE Core Spec Vol 6, Part B, 4.5.9:
	 *   - Master 的 NESN 告诉 Slave "我期望你的下一个 SN 是什么"
	 *     如果 master NESN != 我的 tx_sn, 说明 master ACK 了我的包
	 *   - Master 的 SN 告诉 Slave "这是我发的第 N 个包"
	 *     如果 master SN == 我的 rx_nesn, 说明这是新包 */
	if (pdu_data_rx.nesn != tx_sn) {
		tx_sn = pdu_data_rx.nesn;
	}

	if (pdu_data_rx.sn == rx_nesn) {
		rx_nesn ^= 1;
	}

	/* 准备 TX: 空 PDU (with updated SN/NESN) */
	build_empty_pdu(&tx_pdu_buf);
	radio_pkt_tx_set(&tx_pdu_buf);

	/* 启用 PPI_CH_TXEN */
	dppi_enable_txen();

	radio_event_end_clear();
	NRF_RADIO->EVENTS_DISABLED = 0;

	/* 等待 TX 完成 */
	{
		uint32_t safety = 0;

		while (NRF_RADIO->EVENTS_DISABLED == 0) {
			if (++safety > 2000000) {
				printk("!STUCK TX! ST=%u\n", NRF_RADIO->STATE);
				NRF_RADIO->TASKS_DISABLE = 1;
				while (NRF_RADIO->EVENTS_DISABLED == 0) {
				}
				break;
			}
		}
	}

	NRF_RADIO->EVENTS_DISABLED = 0;

	dppi_disable_switch();
	NRF_RADIO->SHORTS = 0;

	conn_event_counter++;
	return true;
}

/*===========================================================================
 * 连接态主循环 — 多事件循环
 *
 * ★ 这是本 Demo 的核心: 展示锚点递推和跳频
 *
 * 相比 04_phy_first_anchor:
 *   - while 循环执行多个连接事件
 *   - 每 connInterval 推进锚点: next_rtc += interval_ticks
 *   - 皮秒余量累积与进位
 *   - chan_sel_1() 每事件计算新信道
 *   - 固定 WW (不做累积, 简化逻辑)
 *   - 基本 supervision timeout
 *
 * 相比 06_phy_anchor (缺少的):
 *   - 无动态 Window Widening
 *   - 无 TIMER0 漂移测量与校正
 *   - 无 LL Control PDU 处理
 *===========================================================================*/
void conn_loop(void)
{
	/* 初始化连接状态 */
	tx_sn = 0;
	rx_nesn = 0;
	conn_event_counter = 0;
	last_unmapped_chan = 0;
	conn_event_rx_ok = 0;
	conn_event_rx_timeout = 0;
	conn_event_rx_crc_err = 0;

	memset(&anchor, 0, sizeof(anchor));

	radio_configure_conn();

	/* ==== 连接参数计算 ==== */
	uint32_t conn_interval_us = (uint32_t)conn_params.interval * CONN_INT_UNIT_US;
	uint32_t win_size_us = (uint32_t)conn_params.win_size * CONN_INT_UNIT_US;

	/* Window Widening 参数 */
	uint16_t master_sca_ppm = sca_ppm_table[conn_params.sca & 0x07];
	uint32_t combined_sca_ppm = (uint32_t)master_sca_ppm + LOCAL_SCA_PPM;
	uint32_t ww_periodic_us = DIV_ROUND_UP(
		combined_sca_ppm * conn_interval_us, 1000000);

	/* ★ 首次锚点偏移计算 (同 04) */
	uint32_t conn_offset_us = (uint32_t)conn_params.win_offset * CONN_INT_UNIT_US
				+ WIN_DELAY_LEGACY
				- EVENT_TICKER_RES_MARGIN_US
				- EVENT_JITTER_US
				- radio_rx_ready_delay_get(0, 0)
				- ww_periodic_us;

	anchor.initial_anchor_us = conn_offset_us;

	/* 转换为 RTC ticks + 皮秒余量 */
	uint32_t offset_ticks = HAL_TICKER_US_TO_TICKS(conn_offset_us);
	uint32_t offset_remainder_ps = HAL_TICKER_REMAINDER(conn_offset_us);

	uint32_t interval_ticks = HAL_TICKER_US_TO_TICKS(conn_interval_us);
	uint32_t interval_remainder_ps = HAL_TICKER_REMAINDER(conn_interval_us);

	uint32_t ps_per_tick = HAL_TICKER_CNTR_CLK_UNIT_FSEC /
			       HAL_TICKER_FSEC_PER_PSEC;

	/* 首次锚点的绝对 RTC tick */
	uint32_t next_event_rtc = (connect_end_rtc + offset_ticks) &
				  HAL_TICKER_CNTR_MASK;
	uint32_t next_event_remainder_ps = offset_remainder_ps;

	anchor.initial_anchor_rtc = next_event_rtc;
	anchor.current_anchor_rtc = next_event_rtc;

	/* Supervision timeout */
	uint32_t supervision_timeout_us = (uint32_t)conn_params.timeout * 10000;
	uint32_t last_rx_rtc = connect_end_rtc;

	/* ★ 固定 HCTO 窗口 (不累积 WW)
	 * 与 06 不同: 06 每丢一个包 WW 增长, 这里用固定的 ww_periodic_us */
	uint32_t hcto_add = ((EVENT_JITTER_US +
			      EVENT_TICKER_RES_MARGIN_US +
			      ww_periodic_us) << 1) +
			    win_size_us;

	/* ==== 连接事件循环 ==== */
	while (1) {
		/* 记录当前锚点 */
		anchor.current_anchor_rtc = next_event_rtc;

		/* 执行连接事件 */
		bool rx_ok = conn_event(next_event_rtc,
					next_event_remainder_ps,
					hcto_add);

		if (rx_ok) {
			last_rx_rtc = next_event_rtc;
			anchor.anchor_update_count++;
			anchor.consecutive_misses = 0;
		} else {
			anchor.consecutive_misses++;
			if (anchor.consecutive_misses > anchor.max_consecutive_misses) {
				anchor.max_consecutive_misses = anchor.consecutive_misses;
			}

			/* ★ Supervision timeout 检测
			 *
			 * BLE Core Spec Vol 6, Part B, 4.5.2:
			 *   如果超过 connSupervisionTimeout 没成功收到包 → 断开
			 *
			 * 注意: 这里用固定 WW, 没有漂移校正,
			 * 所以连接保持时间有限 (通常 5-15 秒) */
			uint32_t elapsed_ticks = (next_event_rtc - last_rx_rtc) &
						 HAL_TICKER_CNTR_MASK;
			uint32_t elapsed_us = HAL_TICKER_TICKS_TO_US(elapsed_ticks);

			if (elapsed_us >= supervision_timeout_us) {
				printk("[CONN] Supervision timeout! no RX for %u us\n",
				       elapsed_us);
				break;
			}
		}

		/* ★ 锚点递推: 推进到下一个 connInterval
		 *
		 * next_anchor = current_anchor + interval_ticks
		 *
		 * 关键细节: 皮秒余量累积与进位
		 *   remainder 每次 += interval_remainder
		 *   当 remainder >= 1 tick 的皮秒数时, 进位 +1 tick
		 *   这防止了舍入误差的长期累积 */
		next_event_rtc = (next_event_rtc + interval_ticks) &
				 HAL_TICKER_CNTR_MASK;
		next_event_remainder_ps += interval_remainder_ps;
		if (next_event_remainder_ps >= ps_per_tick) {
			next_event_remainder_ps -= ps_per_tick;
			next_event_rtc = (next_event_rtc + 1) &
					 HAL_TICKER_CNTR_MASK;
		}

		uint32_t current_event = conn_event_counter;

		/* 事件日志: 前 10 个 + 出错事件 + 每 50 个 */
		if (current_event <= 10 ||
		    anchor.consecutive_misses > 3 ||
		    current_event % 50 == 0) {
			printk("[CONN] #%u ch=%u %s | "
			       "rtc=%u | rx=%u/%u miss=%u\n",
			       current_event,
			       last_unmapped_chan,
			       rx_ok ? "OK" : "MISS",
			       anchor.current_anchor_rtc,
			       conn_event_rx_ok,
			       current_event,
			       anchor.consecutive_misses);
		}
	}

	/* 清理 */
	NRF_RADIO->SHORTS = 0;
	radio_irq_disable();

	printk("\n========== Connection Summary ==========\n");
	printk("  Total events:   %u\n", conn_event_counter);
	printk("  RX OK:          %u\n", conn_event_rx_ok);
	printk("  RX timeout:     %u\n", conn_event_rx_timeout);
	printk("  RX CRC error:   %u\n", conn_event_rx_crc_err);
	printk("  Anchor updates: %u\n", anchor.anchor_update_count);
	printk("  Max consecutive misses: %u\n", anchor.max_consecutive_misses);
	printk("=========================================\n");

	/* 连接参数和锚点计算详情 */
	print_connect_ind();
	print_anchor_calculation(conn_offset_us,
				 offset_ticks,
				 offset_remainder_ps,
				 interval_ticks,
				 interval_remainder_ps,
				 master_sca_ppm,
				 combined_sca_ppm,
				 ww_periodic_us,
				 conn_interval_us);
}
```
